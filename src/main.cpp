// SPDX-License-Identifier: MIT
// OM Lite shell: setup + loop + dispatch. The screens live in src/ui/ (Nodes, Chat, the node sheet,
// Info and, since EST-347, Settings). EST-371 moved the Map tab, the toast/notification queue, the
// sound-event choices and the USB commands into their own modules under src/screens/ and
// src/usb_commands.cpp; this file keeps the app state the screens share, the actions and the loop.
// Settings keeps only rows and ids here: every rectangle and pixel is ui/settings_layout.h and
// ui/screen_settings.cpp, and the radio values are MeshCore's NodePrefs through mesh_link.h.
#include <Arduino.h>
#include <FS.h>
#include <LovyanGFX.hpp>
#include <Preferences.h>
#include <SD_MMC.h>
#include <esp32-hal-psram.h>

#include "audio.h"
#include "ble_link.h"
#include "board.h"
#include "cardkb.h"          // EST-412: the Grove CardKB's bus and power
#include "cardkb_logic.h"    // EST-412: the key mapping, the default and the polling gate
#include "keynav_logic.h"    // EST-417: what an arrow does per screen, and the no-wrap tab rule
#include "charge_state.h"   // EST-402: the charging bolt's two-read debounce and its unknown rule
#include "clock_keep.h"     // EST-403: the clock kept in RTC_NOINIT across a warm restart
#include "crash_report.h"
#include "map.h"
#include "mesh_link.h"
#include "channels.h"
#include "fade.h"
#include "frame_metrics.h"
#include "history_store.h"
#include "mem_stats.h"
#include "ota.h"
#include "position.h"
#include "power_log.h"
#include "psram_alloc.h"
#include "radio.h"
#include "radio_fault.h"
#include "rptr_link.h"    // EST-358: the repeater session (scan, login, status, CLI)
#include "rptr_model.h"   // EST-358: the row table, the CLI line builders, the parsers
#include "screen_change.h"
#include "screen_idle.h"   // EST-405: the screen auto-off timer and its two saved values
#include "target.h"
#include "timekeeper.h"
#include "touch_gate.h"
#include "msg_order.h"
#include "om_build.h"
#include "radio_stats.h"
#include "radio_diag.h"
#include "usb_cmd.h"
#include "usb_cmd_logic.h"
#include "usb_frames.h"
#include "usb_touch.h"
#include "wifi_link.h"
#include "fonts.h"
#include "ui/age.h"
#include "ui/compose_text.h"
#include "ui/dm_delivery.h"
#include "ui/emoji.h"
#include "ui/emoji_persist.h"     // EST-399: the Recent row's batched NVS write
#include "ui/emoji_picker.h"
#include "ui/emoji_recent.h"
#include "ui/fonts.h"
#include "ui/layout.h"
#include "ui/long_press.h"
#include "ui/new_node.h"
#include "ui/node_info.h"
#include "ui/map_chrome.h"
#include "ui/map_layers.h"
#include "ui/press_feedback.h"   // EST-390: the ONE pressed-look owner
#include "ui/press_targets.h"    // EST-390: the hit test -> pressed rectangle maps
#include "ui/map_pick.h"   // EST-384: the one picker, shared with the RPTR Position page
#include "ui/rptr_layout.h"
#include "ui/screen_chat.h"
#include "ui/screen_node_info.h"
#include "ui/screen_map.h"
#include "ui/screen_rptr.h"
#include "ui/screen_nodes.h"
#include "ui/screen_settings.h"
#include "ui/settings_actions.h"   // EST-422: the action ids, which of them ask first, the sheet
#include "ui/settings_prefs.h"
#include "ui/tap_rule.h"          // EST-422: the one rule that decides a release is a tap
#include "ui/notify.h"
#include "ui/text_wrap.h"
#include "ui/toast.h"
#include "ui/widgets.h"
#include "screens/map_tab.h"
#include "screens/nodes_tab.h"
#include "screens/rptr_tab.h"
#include "screens/toasts.h"
#include "screens/sound_events.h"
#include "app_shell.h"
// key handling (base64, random, hashtag derivation) lives in channels.cpp      // generated by tools/mkfont.py (DejaVu Sans, 12 and 18 px, 1-bit)

// om_display(), omFrameBegin/End() and omTouch() come from board.h.

// EST-351: the loop task's stack. The USB command path measured ~7.3 KB of the 8 KB default (EST-350);
// one FatFs call nested another 1 KB deep would have been enough. Arduino-ESP32 takes this as a
// function definition at file scope (it overrides the weak getArduinoLoopTaskStackSize), not as a
// -D flag: Arduino.h defines the same name as a macro. status prints the high-water mark and this size.
SET_LOOP_TASK_STACK_SIZE(16384);
static constexpr unsigned kLoopStackSize = 16384;

// EST-351: the old palette and the old tab bar are gone from this file. Every colour, size and
// rectangle comes from src/ui/ (theme.h, layout.h and the screen's own layout header).
// EST-359/361: the sounds themselves live in sound_synth.cpp (one small synth, one shared library).
// This file only decides which event to play and which stored library id each event uses.
using SoundEvent = om::sound::Event;

static bool g_boardOk = false;
static int g_tab = 0;
// EST-412: the CardKB switch, DEFAULT OFF (cardkb_logic.h's rule). It is the user's setting, not the
// probe result: cardkb::found() says whether the keyboard answered at enable. With this false the
// Grove 5 V rail is off and no second I2C bus exists.
static bool g_kbEnabled = om::cardkb::kDefaultEnabled;
static uint32_t g_kbIgnored = 0;   // codes this build did not act on, for the one log line
// Settings (EST-347) keeps only state; every rectangle comes from ui/settings_layout.h and every
// pixel is drawn by ui/screen_settings.cpp. A page is a flat list of SettingRow, so one index drives
// both the drawing and the tap. EST-350: the pages themselves and the history Back walks live in the
// header, so the host test proves the same table the shell uses.
using SetPage = om::ui::SetPage;
static bool g_settings = false;
static om::ui::SettingsTab g_setTab = om::ui::SettingsTab::General;
static SetPage g_setPage = SetPage::GeneralRoot;
static om::ui::SettingsNav g_setNav;   // where Back goes, with the scroll each page was left at
static int g_setScroll = 0;          // px scrolled in the body
static int g_setScroll0 = 0;         // its value when the finger went down
static int g_setMaxScroll = 0;       // the last build's clamp
// EST-384: Settings' own-position map picker, the SAME picker (ui/map_pick.cpp) the RPTR Position
// page draws. The candidate lives here; nothing is committed until Save.
static bool g_ownPick = false;
static int32_t g_ownPickLatE6 = 0;
static int32_t g_ownPickLonE6 = 0;
static int g_ownPickZoom = 15;
static int g_ownPickDragX = 0;
static int g_ownPickDragY = 0;
static bool g_ownPickDragging = false;
static char g_setTitle[40] = "Settings";
static bool g_setSubPage = false;
// EST-363: a page's one commit action in the title row (the sound picker's Use, the time page's Set,
// the custom preset's Apply) instead of a row that scrolls. The id is the SAME action id the row used,
// so the shell's handler and the picker's candidate logic are unchanged; the label is "" for pages
// with no such action, and `on` false draws the key dim because there is nothing new to commit.
static const char* g_setActionLabel = "";
static uint16_t g_setActionId = 0;
static bool g_setActionOn = false;
static constexpr int kNameBufBytes = om::ui::kKeyboardNameMaxBytes + 1;   // 32, MeshCore's own size
static om::ui::SettingsEditor g_setEditor = om::ui::SettingsEditor::None;
static char g_setEditText[64] = "";
static const char* g_setOkLabel = "OK";
// EST-352: the shared keyboard sheet's page for the open editor (letters / 123, shift), and the
// held s/c/z key whose accented letter the release enters.
static bool g_setEditNums = false;
static bool g_setEditShift = false;
static bool g_setEditReveal = false;   // EST-354: the password sheet is showing its text
static int g_setAccentRow = -1;
static int g_setAccentCol = -1;
static uint32_t g_setAccentCp = 0;
static bool g_setAccentPreview = false;
static int g_chanPage = 0;           // the channel whose page is open
// EST-422: ONE confirm sheet for the settings that matter (ui/settings_actions.h holds the list, the
// question and the state machine). EST-399's per-row "tap again" arms are gone: every Delete and
// Forget, every important switch, the preset, the path hash, the node name and the position ask here,
// with Cancel on the left (the default side) and Apply on the right.
static om::ui::ConfirmAsk g_ask;
// The shared editor buffer: a MeshCore name is 31 bytes, a Wi-Fi passphrase 63 (EST-354).
static char g_editBuf[64];
static bool g_editNew = false;       // the name editor is naming a NEW channel
static int g_editCh = 0;             // the channel the name editor renames
static int g_addKind = 0;            // 1 create private, 2 join private, 3 join #tag
static char g_keyText[32];           // base64 key being typed (never printed)
static int g_setSoundEvent = (int)SoundEvent::Message;   // the picker's SoundEvent
static int g_setSoundPending = 0;    // the picker's chosen library id, or sound::kSoundOff
static om::ui::CivilTime g_setTime;  // the manual-time steppers' civil time
static uint8_t g_setBrightness = om::kScreenBrightness;
// EST-357: PSRAM, allocated once in allocUiBuffers(). (The capacity constants are what the old
// sizeof(array)/sizeof(array[0]) sites now use: a pointer has no element count.)
static constexpr int kSetRowsCap = 64;   // the picker lists the whole 41-sound library
static om::ui::SettingRow* g_setRows = nullptr;
static int g_setRowCount = 0;
static om::ui::RadioPrefsStore g_radio;
static om::ui::RadioPrefs g_custom;
// EST-350: the chat whose settings the Chat tab shows. It starts as the open chat and never writes
// back to g_chatSel: picking another one in Settings leaves the Chat screen where it was.
static int g_setChat = 0;
static bool g_setSelOpen = false;    // the chat selector is dropped down over the Chat page
static int g_setSelScroll = 0;       // the selector list's scroll, px
static int g_setSelScroll0 = 0;      // its value when the finger went down
static int g_setSelMaxScroll = 0;    // the last build's clamp
// EST-392: the General page's ONE position control (the `Position` row) is open, and which row of
// the last build it is. The choice itself lives in ui/settings_layout.h.
static bool g_posChoice = false;
static int g_posRowIndex = -1;
// EST-354: the SSID whose password the sheet is asking for (never the password itself).
static char g_wifiPassSsid[om::wifi::kSsidBytes + 1] = "";

static void drawSettings();
static void openSettings(int mainTab, om::ui::SettingsTab tab);
// EST-350: the page history's two ends (defined with the settings shell below).
static void setGo(SetPage p);
static void setBack();
// --- chat (new UI layer) -----------------------------------------------------------------------
// The chat screen keeps no geometry of its own: om::ui::screen_chat.cpp owns the rectangles and the
// hit test, and these are only the state it draws.
static int g_chatSel = 0;         // the open chat: an index into g_chats (channels first, then DMs)
static bool g_selector = false;   // the chat/DM selector is dropped down
// EST-382: the ADVERT key's Flood / Local dropdown. It is exclusive with g_selector (opening one
// closes the other) and its press-away rule is the keyboard's own overlay rule.
static bool g_advertMenu = false;
static int g_selScroll = 0;       // the selector list's scroll, px
static int g_selScroll0 = 0;      // its value when the finger went down
static int g_selMaxScroll = 0;    // the last draw's clamp
static int g_chatScroll = 0;      // px scrolled up from the newest message (0 = at the bottom)
static int g_chatScroll0 = 0;     // chat scroll when the finger went down (its own base, not the picker's)
static int g_chatMaxScroll = 0;   // the last draw's clamp
static int g_chatTotal = 0;       // message band content height of the last draw
// The keyboard sheet's state (EST-346): one struct, and every door into the sheet calls openSheet(),
// so it always starts on the letters page with shift off, whatever page it was last closed on. The
// draft text (g_kbText) is separate and is kept as it was.
static om::ui::KeyboardState g_kb;
// EST-346: the s / c / z long press on the keyboard, driven by the same tested LongPress rule as the
// Nodes menu (ui/long_press.h). Armed on the press, fired while the finger is still down (the bubble
// appears), and the release enters the accented letter. A short tap enters the plain letter.
static om::ui::LongPress g_keyHold;
static bool g_keyHoldArmed = false;
static int g_accentRow = -1;
static int g_accentCol = -1;
static uint32_t g_accentCp = 0;        // the letter the bubble shows and the release enters
static bool g_accentPreview = false;   // the hold passed the threshold: the bubble is up
// The emoji page replaces the four key rows while it is open. Its own scroll follows the finger.
static int g_emojiGroup = 0;      // faces / hands / hearts / objects / symbols
static int g_emojiScroll = 0;     // the selected group's grid scroll, px
static int g_emojiScroll0 = 0;    // its value when the finger went down
static int g_emojiMaxScroll = 0;  // the last draw's clamp
static om::ui::EmojiRecent g_emojiRecent;   // last 16 picks, NVS "erec"
static char g_kbText[om::kMeshTextCap];   // the draft, sized like MeshCore's longest channel text
static uint32_t g_bubMenuSeq = 0; // the message sheet's target: monotonic message id, 0 = closed
static uint32_t g_replySeq = 0;   // the message the next send answers (id), 0 = none
static char g_replyName[om::kMeshNameCap] = "";   // the sender, copied when REPLY was tapped
static om::ui::ChatEntry* g_chats = nullptr;   // PSRAM, allocUiBuffers()
static int g_chatCount = 0;
static int g_channelCount = 0;
static int g_dmCount = 0;
// EST-367: one chat's own view. The 32-message RAM ring is only the ARRIVAL buffer now (a busy
// channel evicts a quiet one); the view is a PSRAM copy of that chat's own newest page(s) from its
// log, plus the arrivals that are newer than the newest stored message in it.
//   - g_viewMsgs holds up to kChatViewCap messages, oldest first (the newest page when it opens,
//     older pages prepended while the finger scrolls up). EST-349: PSRAM, one boot-time allocation.
//   - g_viewLoading is the deferred open: the tap sets it, the loop's history step loads the page so
//     a slow card never stalls the gesture, and the first frame says "Loading messages".
//   - g_chatShown remembers, per chat, what its view held when it was opened and how long that took:
//     the `chats` USB check reads it (EST-367 rule 6).
static om::history::Msg* g_viewMsgs = nullptr;   // PSRAM, allocUiBuffers()
static int g_viewCount = 0;                      // messages in g_viewMsgs, oldest first
static int g_viewChat = -1;                      // the chat the buffer belongs to
static bool g_viewLoading = false;               // the open's newest-page load is still to run
static bool g_viewMore = true;                   // an older page may exist
static constexpr int kChatMsgsCap = om::ui::kChatViewCap + om::ui::kMaxChatMsgs;
static om::ui::ChatMsgView* g_chatMsgs = nullptr;   // PSRAM, allocUiBuffers()
static int g_chatMsgCount = 0;
struct ChatShown {
  char key[om::ui::kChatNameCap] = "";   // the chat this row is about (names are what the list shows)
  int shown = -1;                        // the per-view count after the open's load; -1 = not opened
  uint32_t newestLogId = 0;              // the newest stored message the view showed
  uint32_t newestWall = 0;               // its clocks, for the `chats` line
  uint32_t newestUp = 0;
  bool newestReal = false;
  uint32_t openUs = 0;                   // how long the open's load took
  uint32_t windows = 0;                  // its backwards reads
  uint32_t bytes = 0;
};
static ChatShown g_chatShown[om::ui::kMaxChats];
// One copy buffer for the DM ring, shared by refreshChats() and refreshChatMessages(): they run one
// after the other inside buildChatView(), never nested, so one copy of the ring is enough. Two
// copies cost ~9 KB of RAM each (EST-342).
static om::MeshDm* g_dmScratch = nullptr;   // PSRAM, allocUiBuffers()

static bool g_sdOk = false;
static uint16_t g_packMb = 0;
static uint16_t g_battMv = 0;
// EST-402: the charging bolt's debounced state. buildStatus() reads bolt(); the loop feeds it one
// STATUS0 read every kChargePollMs. Unknown (a chip that did not answer at boot) never shows a bolt.
static om::ChargeBolt g_chargeBolt;
static om::GpsState g_gps;
// This firmware's build time (UTC), used only as the floor's seed in timeKeeper().begin(). It is NOT
// a timestamp cut-off any more: that moves at every flash and turned every node into "--" (EST-333).
// The formatter and the last-hour count use the fixed kMinSaneEpoch (2025-01-01 UTC, ui/age.h).
static uint32_t g_buildEpoch = 0;
// The wake button woke the screen: touches are gated for 300 ms and a held finger never counts.
static om::TouchGate g_touchGate;
// EST-339: a press that lands outside an open overlay closes it and spends the whole gesture. g_spent
// is the loop's copy for the drag, the hold and the release paths.
static om::OverlayDismiss g_dismiss;
static bool g_spent = false;
// Backlight ramp (EST-338, gamma 2.2 since EST-339). boardSetBrightness() steps in one go; this is
// the non-blocking ramp loop() ticks, one I2C write per tick. The level is reset to kScreenBrightness
// after boardBegin().
static om::FadeRamp g_fade;

// EST-405: the screen's on/off state moved here from the loop's own statics when the idle timer
// became a second caller of the sleep transition. One state, one sleep path, one wake path: the wake
// button and the auto-off timer both end in screenSleep()/screenWake() below.
static bool g_screenOn = true;
static bool g_sleepPending = false;      // the backlight is fading out; the panel is still awake
static bool g_sleepByTimer = false;      // the current sleep was the auto-off timer's, not the button
static bool g_wakePrev = false;          // the wake button's last sampled level (the press edge)
// The gesture state screenSleep() must drop when the screen goes dark, so a finger that was on the
// glass cannot turn into a tap in the dark. They live here rather than inside loop() because the
// sleep transition is now a function with two callers.
static bool g_down = false;
static bool g_drag = false;
static bool g_acted = false;
// EST-422: the current gesture's own record (press point, last point, how many samples). ui/tap_rule.h
// owns the decision; the loop feeds it and asks it on the release edge. Cleared by screenSleep() with
// the rest of the gesture state.
static om::ui::TapTrace g_tap;
// EST-414: true only while a finger is dragging one of the scrolling lists past its end. The views'
// own clamps (drawChat, nodes_tab's refreshNodes) keep the give while it is set and clamp absolutely
// outside it, so a content that shrinks while nobody is dragging can never strand a gap at the end.
static bool g_listGive = false;
static om::ScreenIdle g_idle;            // the auto-off timer (screen_idle.h)
static om::ScreenIdlePrefs g_idlePrefs;  // its two saved values

// EST-390: the pressed look's worst case, printed once a minute like the other timings. One
// sample per armed press: from the press edge being seen to the end of that frame's push.
static om::ui::PressLatencyLog g_pressLatency;

// EST-390: the two frame overlays and their one order. The pressed tint goes on the finished frame
// (so it is on exactly the hit rectangle and no screen can draw over it), and the toast goes on top
// of that, exactly as it did before this ticket.
static void drawFrameOverlays(lgfx::LovyanGFX* d, uint32_t nowMs) {
  om::ui::drawPressOverlay(d, nowMs);
  om::ui::drawToastOverlay(d, nowMs);
}

// EST-355: a full screen change (a tab, or any path that replaces the whole screen) either pushes at
// once or takes the light down for the push, when the old and new frames differ strongly in
// brightness. The machine is screen_change.h; g_change is the one instance. The touches are the wake
// path's own TouchGate: no tap is read while a change runs, and when it ends the gate is armed with
// the change's short window, so a finger that is already down must lift first.
static om::ScreenChange g_change;
static uint8_t g_changeOldLuma = 0;     // the visible frame's mean brightness when the change began
// The mean brightness of each tab's last frame, measured from its own pixels when it was pushed. The
// dip decision compares the frame on the glass with the last frame of the tab being entered.
static uint8_t g_tabLuma[4] = {0, 0, 0, 0};
static bool g_tabLumaKnown[4] = {false, false, false, false};

// EST-411: the Nodes tab's own state (the list copy and its scroll, the sheet, the Info page, the
// trace sheet and the new-node dot) lives in screens/nodes_tab.cpp. The two PSRAM pointers stay
// here because allocUiBuffers() below is EST-357's one allocation point; they are handed to the
// module once, in setup().
static om::ui::NodeItem* g_nodes = nullptr;   // PSRAM, allocUiBuffers()
// refreshNodes()'s copy of the contact table (64 x 92 B): also PSRAM, never the loop stack.
static om::MeshContact* g_contactScratch = nullptr;

// EST-357: every UI scratch array above is one PSRAM allocation, made once here. The crash that
// started this ticket was an internal-RAM allocation inside Bluedroid while Wi-Fi held 37.6 KB; these
// ~27 KB of per-screen scratch no longer compete with the radio stacks. The one-time contact copy is
// here too. A board whose PSRAM did not come up gets internal RAM back from the allocator's own
// fallback (psram_alloc.h) and the log says which one answered.
static void allocUiBuffers() {
  const size_t nodesB = sizeof(om::ui::NodeItem) * (size_t)om::nodes_tab::kNodeCap;
  const size_t chatsB = sizeof(om::ui::ChatEntry) * (size_t)om::ui::kMaxChats;
  const size_t chatMsgsB = sizeof(om::ui::ChatMsgView) * (size_t)kChatMsgsCap;
  // EST-367: one chat's own view (its newest page plus the older pages the finger asks for).
  const size_t viewMsgsB = sizeof(om::history::Msg) * (size_t)om::ui::kChatViewCap;
  const size_t dmB = sizeof(om::MeshDm) * (size_t)om::ui::kMaxChatMsgs;
  const size_t setB = sizeof(om::ui::SettingRow) * (size_t)kSetRowsCap;
  const size_t contactsB = sizeof(om::MeshContact) * (size_t)om::nodes_tab::kNodeCap;
  g_nodes = om::psramArray<om::ui::NodeItem>(om::nodes_tab::kNodeCap);
  g_chats = om::psramArray<om::ui::ChatEntry>(om::ui::kMaxChats);
  g_chatMsgs = om::psramArray<om::ui::ChatMsgView>(kChatMsgsCap);
  g_viewMsgs = om::psramArray<om::history::Msg>(om::ui::kChatViewCap);
  g_dmScratch = om::psramArray<om::MeshDm>(om::ui::kMaxChatMsgs);
  g_setRows = om::psramArray<om::ui::SettingRow>(kSetRowsCap);
  g_contactScratch = om::psramArray<om::MeshContact>(om::nodes_tab::kNodeCap);
  const uint32_t total = (uint32_t)(nodesB + chatsB + chatMsgsB + viewMsgsB + dmB + setB + contactsB);
  const bool ok = g_nodes && g_chats && g_chatMsgs && g_viewMsgs && g_dmScratch && g_setRows &&
                  g_contactScratch;
  Serial.printf("[mem] ui buffers %u B in %s: nodes %u, chats %u, chat msgs %u, chat view %u, "
                "dm scratch %u, set rows %u, contacts %u\n",
                (unsigned)total, ok ? "PSRAM" : "INTERNAL (PSRAM refused)",
                (unsigned)nodesB, (unsigned)chatsB, (unsigned)chatMsgsB, (unsigned)viewMsgsB,
                (unsigned)dmB, (unsigned)setB, (unsigned)contactsB);
  // EST-363: the RPTR page model's sizes, printed once at boot next to the other UI memory. Both
  // structs live in statics (g_rptrViewStore); copies of them were what the EST-362 stack could not
  // hold. The numbers are checked against the EST-362 ELF's DWARF in docs/PROGRESS.md.
  Serial.printf("[rptr] sizes: ScreenIn %u, ScreenOut %u, UiRow %u, RptrView %u, loop stack %u\n",
                (unsigned)sizeof(om::rptr::ScreenIn), (unsigned)sizeof(om::rptr::ScreenOut),
                (unsigned)sizeof(om::rptr::UiRow), (unsigned)sizeof(om::ui::RptrView),
                kLoopStackSize);
}

// The one-line toast (a tap on the radio fault mark, the new-node notice, a ping result, a trace) is
// no longer text in the shell: ui/toast.h owns the text and its deadline, and every frame carries the
// active toast through omFrameSetOverlay() (EST-344), so a repaint cannot wipe it.

// Sound prefs (NVS "omlite"): master, volume %, one stored library sound id per event, DND. The id
// is a global sound library id (EST-361), not a per-event index; kSoundOff is that event's Off.
// `sndver` says the keys already hold ids (2). An older value holds the EST-359 per-event index and
// is migrated once through sound::legacyVariantSound.
static Preferences g_prefs;

// EST-370: the Map's two saved layer switches (ui/map_layers.h) read and write through these thin
// callbacks, so the host test proves the same load/save rule with RAM instead of NVS.
static bool mapLayerPrefRead(void*, const char* key, bool fallback, bool& out) {
  if (!g_prefs.isKey(key)) return false;   // a first boot: the caller's default, nothing written
  out = g_prefs.getBool(key, fallback);
  return true;
}
static bool mapLayerPrefWrite(void*, const char* key, bool value) {
  return g_prefs.putBool(key, value) != 0;   // Preferences returns the bytes written (0 = failed)
}
// EST-377: both callbacks are key-generic, so the battery log's switch (om::plog, key "plogen",
// default ON) uses them too: one NVS rule for every saved bool in this shell.

// EST-405: the screen auto-off timer's two one-byte keys ("saoff" the switch, "saoft" the time
// index). One key-generic pair, the same rule as the bool callbacks above: a missing key is the
// caller's default and nothing is written for it.
static bool u8PrefRead(void*, const char* key, uint8_t fallback, uint8_t& out) {
  if (!g_prefs.isKey(key)) return false;
  out = g_prefs.getUChar(key, fallback);
  return true;
}
static bool u8PrefWrite(void*, const char* key, uint8_t value) {
  return g_prefs.putUChar(key, value) == sizeof(uint8_t);
}

// The emoji Recent row: 16 little-endian u32 then the valid count, 65 bytes in NVS "omlite".
// Unknown trailing bytes are ignored by restore(), so an older/longer blob is safe.
// EST-399: the ONE write of this blob, and it ANSWERS whether it landed. The pick path does not call
// it any more (that was one flash commit per emoji, with the result dropped: EST-398 #4).
static bool saveEmojiRecent() {
  uint8_t buf[4 * om::ui::kEmojiRecentMax + 1];
  for (int i = 0; i < om::ui::kEmojiRecentMax; ++i) {
    const uint32_t cp = g_emojiRecent.cps[i];
    buf[i * 4 + 0] = (uint8_t)(cp & 0xFF);
    buf[i * 4 + 1] = (uint8_t)((cp >> 8) & 0xFF);
    buf[i * 4 + 2] = (uint8_t)((cp >> 16) & 0xFF);
    buf[i * 4 + 3] = (uint8_t)((cp >> 24) & 0xFF);
  }
  buf[4 * om::ui::kEmojiRecentMax] = g_emojiRecent.count;
  // Preferences returns the bytes written, so a refused or short write is visible here (0).
  return g_prefs.putBytes("erec", buf, sizeof(buf)) == sizeof(buf);
}

// EST-399: the batched write's one place of truth. `pageShowing` is the emoji page being on the glass
// right now; the gate decides (leave the page, or 30 s with no pick) and this reports the outcome and
// counts a failure. One log line per attempt, so a broken NVS is visible instead of silent.
static om::ui::EmojiSaveGate g_emojiSave;

static void emojiPersistStep(bool pageShowing, uint32_t now) {
  if (!g_emojiSave.due(pageShowing, now)) return;
  const bool ok = saveEmojiRecent();
  g_emojiSave.result(ok, now);
  if (ok) {
    Serial.printf("[emoji] recent saved: %u pick(s), write %u\n",
                  (unsigned)g_emojiRecent.count, (unsigned)g_emojiSave.writes);
  } else {
    Serial.printf("[emoji] recent NOT saved: the NVS write failed (%u of %u writes so far)\n",
                  (unsigned)g_emojiSave.fails, (unsigned)g_emojiSave.writes);
  }
}

static void loadEmojiRecent() {
  uint8_t buf[4 * om::ui::kEmojiRecentMax + 1];
  const size_t n = g_prefs.getBytesLength("erec");
  if (n != sizeof(buf)) return;
  if (g_prefs.getBytes("erec", buf, sizeof(buf)) != sizeof(buf)) return;
  uint32_t raw[om::ui::kEmojiRecentMax];
  for (int i = 0; i < om::ui::kEmojiRecentMax; ++i) {
    raw[i] = (uint32_t)buf[i * 4] | ((uint32_t)buf[i * 4 + 1] << 8) |
             ((uint32_t)buf[i * 4 + 2] << 16) | ((uint32_t)buf[i * 4 + 3] << 24);
  }
  g_emojiRecent.restore(raw, om::ui::kEmojiRecentMax, buf[4 * om::ui::kEmojiRecentMax]);
}

// The floor is persisted every 10 minutes and on every applied sync (the caller calls this then). It
// is a lower bound only: the next boot starts at max(floor, build time) and still reports "--:--"
// until a real source sets the clock.
static void saveTimeFloor() {
  const uint32_t floor = om::timeKeeper().floor();
  const bool ok = g_prefs.putUInt("tfloor", floor) == sizeof(uint32_t);
  // Rate-limit even a failed write: retrying every loop would hammer NVS. A failed save is retried
  // with the normal 10-minute cadence, and the floor is still raised in RAM.
  om::timeKeeper().onFloorSaved(millis() / 1000);
  if (!ok) Serial.printf("[time] floor %lu not saved to NVS\n", (unsigned long)floor);
}

// ----------------------------------------------------------------------------- drawing

// ----------------------------------------------------------------------------- Map (EST-351)
// EST-371: the Map's state, drawing glue and tap handling live in screens/map_tab.cpp. main.cpp only
// resolves the tab bar's badge here (the ONE source every screen uses) and passes the Map's shell
// services (status bar, tab bar, GPS fix, toast) into the module at boot.
static void buildStatus(om::ui::StatusModel& s);
static int unreadTotal();
// EST-365: the ONE source of the tab bar's badge. Every screen's view carries the returned model,
// so a screen can no longer pass its own count (the RPTR page passed 0 and lost the badge).
static om::ui::TabBarModel currentTabBar(om::ui::Tab active) {
  return om::ui::tabBarModel(active, unreadTotal(), om::nodes_tab::newNodeDot());
}
static om::ui::TabBarModel appTabBar(om::ui::Tab active) { return currentTabBar(active); }
// EST-384: the Map, locate/follow and the traces read the ONE own-position source, not the raw GPS
// parser. The parser still owns the clock and the satellite diagnostics.
static const om::PositionFix* appGps() { return &om::posOwn(); }
// EST-410: RPTR's Host services. Its picker reads the RAW parser state, not posOwn() (the two were
// different sources before the move and stay different). screenVisible() is the same g_tab/g_settings
// test the notification door and the pump used.
static const om::GpsState* appRawGps() { return &g_gps; }
static bool appRptrVisible() { return g_tab == 3 && !g_settings; }

// Defined far below; the toast paths need it now that showing a toast means "redraw the current
// screen with the toast in the frame" (EST-344). It answers whether it drew (EST-381), so a frame
// refused by a running screen change can be asked for again instead of being lost.
static bool redrawCurrentScreen();
static bool appRedraw() { return redrawCurrentScreen(); }   // EST-410: RPTR's Host

// ------------------------------------------------------------------------ EST-405: sleep and wake
// ONE sleep transition and ONE wake path, shared by the wake button and the screen auto-off timer.
// The bodies are the wake button's own code, moved verbatim out of loop(): the fade-out over
// kFadeOutMs, then the panel sleep once the light has reached 0 (the `g_sleepPending` tick further
// down), and the ordered wake (panel out of sleep, DISPOFF, sleep-out, frame push, DISPON, one frame
// period, then the backlight ramp) with the TouchGate armed. `why` labels the log lines; fromTimer
// separates the timer's sleep from the button's for the touch wake rule (see loop()).
static void screenSleep(const char* why, bool fromTimer) {
  if (!g_screenOn) return;
  // A gesture in flight is dropped, so the finger that was on the glass cannot turn into a tap in
  // the dark. The same three resets the button path always did, plus EST-422's gesture record.
  g_screenOn = false;
  g_down = false;
  g_drag = false;
  g_acted = false;
  g_tap.reset();
  g_sleepPending = true;
  // EST-355: a screen change that is still running is abandoned; the fade-out below owns the light
  // from here and starts at whatever level the change had really reached.
  const int fromLevel = g_change.active() ? g_change.level() : g_fade.level();
  g_change.cancel();
  g_fade.start(millis(), fromLevel, 0, om::kFadeOutMs);
  g_sleepByTimer = fromTimer;
  Serial.printf("[wake] screen off (%s, fade out %lums from %d)\n", why,
                (unsigned long)om::kFadeOutMs, fromLevel);
}

static void screenWake(const char* why) {
  if (g_screenOn) return;
  // Wake, in the order that leaves no diagonal on the glass (Filip, EST-336): the panel out of
  // sleep, DISPOFF at once (LovyanGFX's wakeup() ends with DISPON, see board.h), its sleep-out
  // time, the whole current frame pushed into the panel's RAM while the display is still off,
  // then DISPON, one full frame period, and only then the backlight ramps up. A finger already
  // down (or one that lands during the gate) is swallowed by g_touchGate.
  g_screenOn = true;
  g_sleepByTimer = false;
  g_idle.onActivity(millis());   // a wake is the by-definition end of an idle stretch
  uint16_t tx = 0, ty = 0;
  const bool downAtWake = om::omTouch(tx, ty);
  const uint32_t wakeMs = millis();
  if (g_sleepPending) {
    // Woken while the fade-out was still running: the panel never slept, so reverse the ramp from
    // the current level instead of waking (and flashing) the panel.
    g_sleepPending = false;
    g_fade.start(wakeMs, g_fade.level(), om::kScreenBrightness, om::kFadeInMs);
    g_touchGate.onWake(wakeMs, downAtWake);
    Serial.printf("[wake] screen on (%s, fade reversed at %d), %lums masked\n", why, g_fade.level(),
                  (unsigned long)om::TouchGate::kGateMs);
  } else {
    om::boardSetBrightness(0);   // stays dark through the panel's sleep-out and the frame push
    om::panelPower(true);
    om::panelDisplay(false);
    delay(om::kPanelWakeOutMs);
    redrawCurrentScreen();
    om::panelDisplay(true);
    delay(om::kPanelFramePeriodMs);
    // The gate starts when the light starts, so it covers the whole fade-in; the fade now runs on a
    // gamma 2.2 curve for 300 ms, so it is longer than the gate (EST-339).
    const uint32_t litMs = millis();
    g_fade.start(litMs, 0, om::kScreenBrightness, om::kFadeInMs);
    g_touchGate.onWake(litMs, downAtWake);
    Serial.printf("[wake] screen on (%s, %s at wake), %lums masked\n", why,
                  downAtWake ? "finger held" : "no finger",
                  (unsigned long)om::TouchGate::kGateMs);
  }
}

// Everything the ticket says must keep the auto-off timer paused. One place, read by the loop; the
// Settings page's note and this function therefore describe the same rule.
static om::IdleBlockers idleBlockersNow();

// ----------------------------------------------------------------------------- new UI: Nodes data
// The UI layer is fed from the real MeshCore contact table. meshContactList() returns 0 when the
// mesh is down or nothing has been heard yet; 0 is a real answer and draws the empty state.

static int batteryPercent(uint16_t mv) {
  if (mv == 0) return -1;
  // Single-cell Li-ion estimate. The board reports volts; there is no fuel gauge. 3.2 V empty,
  // 4.2 V full (4.139 V measured on the device maps to 93%).
  int pct = ((int)mv - 3200) / 10;
  if (pct < 0) pct = 0;
  if (pct > 100) pct = 100;
  return pct;
}

static int unreadTotal() {
  int n = 0;
  for (int i = 0; i < om::mcChannelCount(); ++i) n += om::meshUnread(i);
  // EST-342: a DM waiting in a thread is unread traffic on the Chat tab too.
  for (int i = 0; i < om::meshDmCount(); ++i) n += om::meshDmUnread(i);
  return n;
}

static void buildStatus(om::ui::StatusModel& s) {
  s = om::ui::StatusModel();
  s.gpsValid = g_gps.valid;
  s.gpsHeard = g_gps.heardTotal;  // the one GPS number on the glass
  s.gpsTalked = g_gps.sentences > 0;
  s.batteryPct = batteryPercent(g_battMv);
  // EST-402: the bolt is the DEBOUNCED external-power flag, false for "absent" AND for "unknown".
  s.externalPower = g_chargeBolt.bolt();
  // The status icons that appear only when they are on. Wi-Fi (EST-354): present when the switch is
  // on, ink once the station has an IP and dim while it does not. Bluetooth (EST-356): present when
  // the switch is on, ink with a phone connected, dim while advertising, absent when off.
  s.dnd = om::sounds::dnd();
  s.bt = om::bleIsEnabled();
  s.btConnected = om::bleConnected();
  s.wifi = om::wifiIsEnabled();
  const om::wifi::Status& wst = om::wifiStatus();
  s.wifiConnected = wst.phase == om::wifi::Phase::Connected ||
                    (wst.phase == om::wifi::Phase::Scanning && wst.ssid[0] != 0);
  s.fault = om::radioFaultState().reason();
  // Data honesty: show HH:MM only after a real source (GPS today) has set the clock since boot.
  // Before that the time is only the floor (max saved, build time), which is not a real time.
  static char clockText[8];
  if (om::timeKeeper().realSinceBoot()) {
    om::formatClock(om::timeKeeper().now(), clockText, sizeof(clockText));
    s.clock = clockText;
  } else {
    s.clock = "--:--";
  }
}

// The fault mark's toast. It no longer draws on top of the panel: omFrameEnd() draws the active
// toast last on every frame (EST-344), so showing one means one redraw of the current screen. That
// redraw is what makes the toast part of the frame instead of a layer the next repaint erases.
//
// A tap on the mark says which of the three it is. Nothing happens when the mark is not showing.
static void showRadioFaultToast() {
  const om::RadioFault reason = om::radioFaultState().reason();
  if (reason == om::RadioFault::None) return;
  if (om::ui::toastState().show(om::radioFaultText(reason), millis(), om::ui::kToastMs)) {
    Serial.printf("[radio] fault toast: %s\n", om::ui::toastState().text);
    redrawCurrentScreen();
  }
}

// ---------------------------------------------------------------------------------- chat shell
// The Chat tab is the new screen (src/ui/screen_chat.cpp). This file only feeds it and reacts to what
// was tapped; every rectangle and every pixel lives in the UI layer.

// The chats are the MeshCore channels (channels first), then the direct messages the facade knows.
// A DM row exists from the moment its thread exists: a received DM, or one opened from the Nodes
// menu (EST-342), so "Direct messages" is no longer tied to having received one first.
static void refreshChats() {
  g_chatCount = 0;
  for (int i = 0; i < om::mcChannelCount() && g_chatCount < om::ui::kMaxChats; ++i) {
    om::ui::ChatEntry& c = g_chats[g_chatCount++];
    c = om::ui::ChatEntry();
    snprintf(c.name, sizeof(c.name), "%s", om::mcChannelName(i));
    const int unread = om::meshUnread(i);
    c.unread = unread > 0 ? (uint16_t)unread : 0;
    c.dm = false;
    c.muted = om::mcChannelMuted(i);
  }
  g_channelCount = g_chatCount;

  // The last message of each chat, for the selector's preview line (sender, start of text, time).
  // EST-367: it comes from the CHAT'S OWN LOG (`meshChatSummary`), not the shared arrival ring: a
  // busy channel evicted a quiet one from that ring, which is how a chat with 26 unread messages
  // looked empty. A message that arrived but whose record is still queued has no id yet, so the ring
  // may still fill the preview for that one; anything older than the stored newest never overrides.
  uint32_t lastId[om::ui::kMaxChats];
  for (int i = 0; i < om::ui::kMaxChats; ++i) lastId[i] = 0;
  for (int i = 0; i < g_channelCount; ++i) {
    om::history::ChatSummary sum;
    if (!om::meshChatSummary(i, -1, &sum)) continue;
    om::ui::ChatEntry& c = g_chats[i];
    c.hasLast = true;
    c.lastTs = sum.uptime;
    c.lastWall = sum.wall;
    c.lastWallReal = sum.wallReal;
    snprintf(c.lastFrom, sizeof(c.lastFrom), "%s", sum.name);
    snprintf(c.lastText, sizeof(c.lastText), "%s", sum.text);
    lastId[i] = sum.logId;
  }
  for (int i = 0; i < om::meshMsgCount(); ++i) {
    const int chan = om::meshMsgChannel(i);
    if (chan < 0 || chan >= g_channelCount) continue;
    const uint32_t id = om::meshMsgLogId(i);
    if (id != 0 && id <= lastId[chan]) continue;
    om::ui::ChatEntry& c = g_chats[chan];
    c.hasLast = true;
    c.lastTs = om::meshMsgTs(i);
    c.lastWall = om::meshMsgWallTs(i);
    c.lastWallReal = om::meshMsgWallReal(i);
    snprintf(c.lastFrom, sizeof(c.lastFrom), "%s", om::meshMsgName(i));
    snprintf(c.lastText, sizeof(c.lastText), "%s", om::meshMsgText(i));
    lastId[chan] = id;
  }

  // Direct messages come from the facade, never from a placeholder list. The entry keeps the thread
  // index, so the open chat and the send path never have to guess from the position in the list.
  for (int i = 0; i < om::meshDmCount() && g_chatCount < om::ui::kMaxChats; ++i) {
    const int chat = g_chatCount;
    om::ui::ChatEntry& c = g_chats[g_chatCount++];
    c = om::ui::ChatEntry();
    snprintf(c.name, sizeof(c.name), "DM: %s", om::meshDmName(i));
    c.dm = true;
    c.thread = i;   // threads are allocated in order and only ever added: the used ones are packed
    c.unread = (uint16_t)om::meshDmUnread(i);
    om::history::ChatSummary sum;
    if (om::meshChatSummary(-1, i, &sum)) {
      c.hasLast = true;
      c.lastTs = sum.uptime;
      c.lastWall = sum.wall;
      c.lastWallReal = sum.wallReal;
      snprintf(c.lastFrom, sizeof(c.lastFrom), "%s", sum.name);
      snprintf(c.lastText, sizeof(c.lastText), "%s", sum.text);
      lastId[chat] = sum.logId;
    }
    // The same "newer or not stored yet" rule as a channel's preview.
    const int n = om::meshDmList(i, g_dmScratch, om::ui::kMaxChatMsgs);
    if (n > 0) {
      const om::MeshDm& last = g_dmScratch[n - 1];
      if (last.logId == 0 || last.logId > lastId[chat]) {
        c.hasLast = true;
        c.lastTs = last.ts;
        c.lastWall = last.wall;
        c.lastWallReal = last.wallReal;
        snprintf(c.lastFrom, sizeof(c.lastFrom), "%s", last.name);
        snprintf(c.lastText, sizeof(c.lastText), "%s", last.text);
      }
    }
  }
  g_dmCount = g_chatCount - g_channelCount;

  if (g_chatSel >= g_chatCount) g_chatSel = g_chatCount - 1;
  if (g_chatSel < 0) g_chatSel = 0;
}

// The MeshCore channel a chat entry sends to, or -1 for an entry that is not a channel (a DM).
static int chatChannel(int chat) {
  return (chat >= 0 && chat < g_channelCount) ? chat : -1;
}

// The DM thread of an open chat, or -1 for a channel / a chat with no thread.
static int chatThread(int chat) {
  if (chat < 0 || chat >= g_chatCount || !g_chats[chat].dm) return -1;
  return g_chats[chat].thread;
}

// EST-367: the deferred open. The tap only marks the chat; this runs from the loop's history step,
// so a card that takes milliseconds never sits inside a gesture, and the frame drawn right after the
// tap says "Loading messages". The newest page is one seek to the end of the chat's log plus one
// backwards 4 KB window, never a scan. The measured numbers (time, windows, bytes) are logged here
// and kept for the `chats` USB check.
static void chatViewStep() {
  if (!g_viewLoading) return;
  if (g_viewChat != g_chatSel) {   // the finger moved on before the step ran
    g_viewLoading = false;
    return;
  }
  g_viewLoading = false;
  if (g_viewMsgs == nullptr) return;
  const int chan = chatChannel(g_chatSel);
  const int thread = chatThread(g_chatSel);
  const uint32_t t0 = micros();
  const int n = om::meshHistoryNewest(chan, thread, g_viewMsgs, om::ui::kChatNewestPage);
  const uint32_t dt = micros() - t0;
  g_viewCount = n > 0 ? n : 0;
  g_viewMore = n == om::ui::kChatNewestPage;   // a full page may have more behind it
  const om::history::ReadStats& rs = om::history::store().readStats();
  ChatShown& cs = g_chatShown[g_chatSel];
  snprintf(cs.key, sizeof(cs.key), "%s", g_chats[g_chatSel].name);
  cs.shown = g_viewCount;
  cs.newestLogId = g_viewCount > 0 ? g_viewMsgs[g_viewCount - 1].logId : 0;
  cs.newestWall = 0;
  cs.newestUp = 0;
  cs.newestReal = false;
  if (g_viewCount > 0) {
    const om::history::Msg& nm = g_viewMsgs[g_viewCount - 1];
    cs.newestWall = nm.wall;
    cs.newestUp = nm.uptime;
    cs.newestReal = nm.wallReal();
  }
  cs.openUs = dt;
  cs.windows = rs.windows;
  cs.bytes = rs.bytes;
  // EST-399: the chat's index and what was read, never its name (a DM chat's name is a person).
  Serial.printf("[hist] open chat %d (%s): %d msg(s) in %lu.%03lu ms (%lu window(s), %lu B)\n",
                g_chatSel, thread >= 0 ? "the DM log" : "the card", g_viewCount,
                (unsigned long)(dt / 1000u), (unsigned long)(dt % 1000u),
                (unsigned long)rs.windows, (unsigned long)rs.bytes);
}

// EST-367: one page of older messages, prepended in front of the view. Called when the finger pulls
// past the oldest message; the caller redraws and clamps afterwards. The stored block moves to the
// back first and the older page is read into the front, so the two never overlap (EST-348's trick).
static void loadOlderChatPage() {
  if (g_viewMsgs == nullptr) {
    g_viewMore = false;
    return;
  }
  if (!g_viewMore || g_viewCount >= om::ui::kChatViewCap) {
    g_viewMore = false;
    return;
  }
  const int chan = chatChannel(g_chatSel);
  const int thread = chatThread(g_chatSel);
  if (chan < 0 && thread < 0) return;
  if (g_viewCount <= 0) return;   // nothing to page behind yet (the open's load has not run)
  const uint32_t before = g_viewMsgs[0].logId;
  if (before == 0) return;
  int want = om::ui::kChatOlderPage;
  if (g_viewCount + want > om::ui::kChatViewCap) want = om::ui::kChatViewCap - g_viewCount;
  if (want <= 0) {
    g_viewMore = false;
    return;
  }
  memmove(g_viewMsgs + want, g_viewMsgs, (size_t)g_viewCount * sizeof(g_viewMsgs[0]));
  const int n = om::meshHistoryOlder(chan, thread, before, g_viewMsgs, want);
  if (n <= 0) {
    memmove(g_viewMsgs, g_viewMsgs + want, (size_t)g_viewCount * sizeof(g_viewMsgs[0]));
    g_viewMore = false;
    // EST-399: no channel name (rule 9); the index and the log kind say which log ran out.
    Serial.printf("[hist] no older messages (chat %d, %s)\n", g_chatSel,
                  thread >= 0 ? "DM log" : "card");
    return;
  }
  if (n < want) {
    memmove(g_viewMsgs + n, g_viewMsgs + want, (size_t)g_viewCount * sizeof(g_viewMsgs[0]));
  }
  g_viewCount += n;
  g_viewMore = n == want && g_viewCount < om::ui::kChatViewCap;
  Serial.printf("[hist] page: %d older message(s), %d in the view\n", n, g_viewCount);
}

// One stored history message as the screen draws it. A stored message gets a synthetic seq with the
// top bit set: the log id is stable across reboots and cannot collide with this boot's per-ring
// sequence numbers, so REPLY / the message sheet still resolve to the tapped message.
static void addStoredMsg(const om::history::Msg& h, bool dm, const char* chanName) {
  if (g_chatMsgCount >= kChatMsgsCap) return;
  om::ui::ChatMsgView& m = g_chatMsgs[g_chatMsgCount++];
  m.seq = 0x80000000u | (h.logId & 0x7FFFFFFFu);
  m.logId = h.logId;
  m.name = h.name;
  m.text = h.text;
  m.chanName = chanName;
  m.ts = h.uptime;
  m.wall = h.wall;
  m.wallReal = h.wallReal();
  m.hops = h.hops;
  m.snrq = h.snr4;
  m.mine = h.mine();
  m.dm = dm;
  m.delivery = h.delivery;
  m.ackWall = h.ackWall;
  m.ackReal = h.ackReal();
  // Clear first: the view entry is reused, and a stale path would name the wrong repeaters.
  m.path = nullptr;
  m.pathHashSize = 1;
  m.pathHashCount = 0;
  if (h.pathLen > 0) {
    m.path = h.path;
    m.pathHashSize = h.pathHashSize;
    m.pathHashCount = h.pathCount;
  }
  m.repeats = h.repeats;
}

static void refreshChatMessages() {
  // The view belongs to one chat. A switch drops it and asks the loop for that chat's own newest
  // page: the tap must not wait for a card read (chatViewStep logs how long it took).
  if (g_viewChat != g_chatSel) {
    g_viewChat = g_chatSel;
    g_viewCount = 0;
    g_viewLoading = true;
    g_viewMore = true;
  }
  g_chatMsgCount = 0;
  const int chan = chatChannel(g_chatSel);
  const int thread = chatThread(g_chatSel);
  const uint32_t newestStored = g_viewCount > 0 ? g_viewMsgs[g_viewCount - 1].logId : 0;

  if (thread >= 0) {
    // One thread: the facade copies the ring into the shared buffer, and the view points into it
    // (stable for this draw: the mesh is not pumped between buildChatView and chatScreenDraw).
    const int n = om::meshDmList(thread, g_dmScratch, om::ui::kMaxChatMsgs);
    uint32_t ids[om::ui::kMaxChatMsgs];
    for (int i = 0; i < n; ++i) ids[i] = g_dmScratch[i].logId;
    const om::ui::LiveTail tail = om::ui::chatLiveTail(ids, n, newestStored);
    const int first = om::ui::chatViewFirstKept(g_viewCount, tail.count, kChatMsgsCap);
    for (int i = first; i < g_viewCount; ++i) addStoredMsg(g_viewMsgs[i], true, "DM");
    for (int i = tail.first; i < n; ++i) {
      const om::MeshDm& dm = g_dmScratch[i];
      if (g_chatMsgCount >= kChatMsgsCap) break;
      om::ui::ChatMsgView& m = g_chatMsgs[g_chatMsgCount++];
      m.seq = dm.seq;
      m.logId = dm.logId;
      m.name = dm.name;
      m.text = dm.text;
      m.chanName = "DM";
      m.ts = dm.ts;
      m.wall = dm.wall;
      m.wallReal = dm.wallReal;
      m.hops = dm.hops;
      m.snrq = dm.snr4;
      m.mine = dm.mine;
      m.dm = true;
      m.delivery = dm.state;
      m.ackWall = dm.ackWall;
      m.ackReal = dm.ackReal;
      m.path = nullptr;
      m.pathHashSize = 1;
      m.pathHashCount = 0;
      m.repeats = 0;
      if (dm.pathCount > 0) {
        m.path = dm.path;
        m.pathHashSize = dm.pathHashSize;
        m.pathHashCount = dm.pathCount;
      }
    }
    return;
  }
  if (chan < 0) return;

  // The channel's own stored page(s) first (oldest), then only the arrivals that are NEWER than the
  // newest stored message: the shared ring is an arrival buffer, never the chat's source of truth.
  const int ring = om::meshMsgCount();
  uint32_t ids[om::ui::kMaxChatMsgs];
  int ringIdx[om::ui::kMaxChatMsgs];
  int n = 0;
  for (int i = 0; i < ring && n < om::ui::kMaxChatMsgs; ++i) {
    if (om::meshMsgChannel(i) != chan) continue;
    ids[n] = om::meshMsgLogId(i);
    ringIdx[n] = i;
    ++n;
  }
  const om::ui::LiveTail tail = om::ui::chatLiveTail(ids, n, newestStored);
  const int first = om::ui::chatViewFirstKept(g_viewCount, tail.count, kChatMsgsCap);
  for (int i = first; i < g_viewCount; ++i) addStoredMsg(g_viewMsgs[i], false, om::mcChannelName(chan));
  for (int k = tail.first; k < n; ++k) {
    if (g_chatMsgCount >= kChatMsgsCap) break;
    const int i = ringIdx[k];
    om::ui::ChatMsgView& m = g_chatMsgs[g_chatMsgCount++];
    m.seq = om::meshMsgSeq(i);
    m.logId = om::meshMsgLogId(i);
    m.name = om::meshMsgName(i);
    m.text = om::meshMsgText(i);
    m.chanName = om::mcChannelName(chan);
    m.ts = om::meshMsgTs(i);
    m.wall = om::meshMsgWallTs(i);
    m.wallReal = om::meshMsgWallReal(i);
    m.hops = (int8_t)om::meshMsgHops(i);
    m.snrq = (int8_t)om::meshMsgSnrQ(i);
    m.mine = om::meshMsgMine(i);
    uint8_t hs = 1, hc = 0;
    m.path = om::meshMsgPath(i, &hs, &hc);
    m.pathHashSize = hs;
    m.pathHashCount = hc;
    m.repeats = om::meshMsgHeardRepeats(i);
  }
}

static void buildChatView(om::ui::ChatView& v) {
  refreshChats();
  refreshChatMessages();
  v = om::ui::ChatView();
  buildStatus(v.status);
  v.chats = g_chats;
  v.chatCount = g_chatCount;
  v.channelCount = g_channelCount;
  v.dmCount = g_dmCount;
  v.selChat = g_chatSel;
  v.selScroll = g_selScroll;
  v.selector = g_selector;
  v.advertMenu = g_advertMenu;
  v.msgs = g_chatMsgs;
  v.msgCount = g_chatMsgCount;
  v.loading = g_viewLoading;
  v.scroll = g_chatScroll;
  v.nowSec = millis() / 1000;
  v.nowWall = om::timeKeeper().now();
  v.nowReal = om::timeKeeper().realSinceBoot();
  v.osk = g_kb.open;
  v.shift = g_kb.shift;
  v.nums = g_kb.nums();
  v.emoji = g_kb.emoji();
  // The held key's preview (EST-346): only while the bubble is actually up.
  v.accentRow = g_accentPreview ? g_accentRow : -1;
  v.accentCol = g_accentPreview ? g_accentCol : -1;
  v.accentCp = g_accentPreview ? g_accentCp : 0;
  v.emojiRecent = g_emojiRecent.cps;
  v.emojiRecentCount = g_emojiRecent.count;
  v.emojiGroup = g_emojiGroup;
  v.emojiScroll = g_emojiScroll;
  v.draft = g_kbText;
  v.ownName = om::meshNodeName();
  v.dmThread = chatThread(g_chatSel) >= 0;
  // The UI holds message ids, never indexes: when the 32-message ring shifts, the reply target and
  // the open sheet resolve to the same message. A name copied at REPLY time survives even if the
  // message itself falls out of the ring.
  v.replySeq = g_replySeq;
  v.replyName = g_replyName;
  v.menuSeq = g_bubMenuSeq;
  v.menuMsg = om::ui::chatMsgIndexBySeq(g_chatMsgs, g_chatMsgCount, g_bubMenuSeq);
  // The target fell out of the ring: the sheet has nothing left to show, so close it.
  if (g_bubMenuSeq != 0 && v.menuMsg < 0) g_bubMenuSeq = 0;
  if (v.menuMsg >= 0) {
    // What the sheet may offer. Resolved here, once per build, from the same facade the screens use:
    // a row exists only when its action can work (shown/left out, never greyed).
    const om::ui::ChatMsgView& m = g_chatMsgs[v.menuMsg];
    v.menuPath = m.path;
    v.menuPathSize = m.pathHashSize;
    v.menuPathCount = m.pathHashCount;
    v.menuHeard = m.repeats;
    om::MeshContact contact{};
    v.menuSenderKnown = !m.mine && om::meshContactByName(m.name, &contact);
    v.menuSenderHasKey = v.menuSenderKnown && contact.has_key;
    v.menuSenderHasPos = v.menuSenderKnown && contact.has_pos;
    v.menuInDm = m.dm;
  }
  v.tabs = currentTabBar(om::ui::Tab::Chat);
}

// EST-367 rule 5: the open chat's seen point follows what its view actually loaded and shows. The
// normal open loads the newest page, which is the newest stored message, so unread goes to 0 exactly
// as before; a chat whose load fell short (no card, a torn window, nothing loaded) keeps its unread
// instead of being cleared for messages nobody saw. Unread itself stays defined as "messages newer
// than the seen point" (history::unreadAfterSeen): older messages still on the card were read in an
// earlier session, so they are not counted again.
static void markOpenChatRead() {
  if (g_viewLoading || g_selector || g_viewChat != g_chatSel) return;
  const int chan = chatChannel(g_chatSel);
  const int thread = chatThread(g_chatSel);
  if (chan < 0 && thread < 0) return;
  uint32_t newest = g_viewCount > 0 ? g_viewMsgs[g_viewCount - 1].logId : 0;
  if (thread < 0) {
    // The arrival ring may already hold a stored message newer than the page that was loaded.
    for (int i = om::meshMsgCount() - 1; i >= 0; --i) {
      if (om::meshMsgChannel(i) != chan) continue;
      const uint32_t id = om::meshMsgLogId(i);
      if (id > newest) newest = id;
      break;
    }
  }
  if (newest == 0) return;   // nothing loaded: nothing to mark read
  om::meshHistoryMarkSeen(chan, thread, newest);
}

// One draw path for every caller: build, clamp, draw, and remember the numbers a new message needs.
static void drawChat() {
  markOpenChatRead();
  om::ui::ChatView v;
  buildChatView(v);
  g_chatMaxScroll = om::ui::chatMaxScroll(v);
  g_selMaxScroll = om::ui::chatSelectorMaxScroll(v);
  // EST-414: while a finger is dragging the message band or the channel list, the kSelGive stretch
  // past either end IS the scroll (releaseSnap's listSnapScroll takes it back). Outside a drag the
  // clamp is absolute, so a content that shrinks (a new page, a removed chat) can never leave a gap.
  if (g_listGive) {
    g_chatScroll = om::ui::listGiveScroll(0, g_chatScroll, g_chatMaxScroll);
    g_selScroll = om::ui::listGiveScroll(0, g_selScroll, g_selMaxScroll);
  } else {
    g_chatScroll = om::ui::listSnapScroll(g_chatScroll, g_chatMaxScroll);
    g_selScroll = om::ui::listSnapScroll(g_selScroll, g_selMaxScroll);
  }
  v.scroll = g_chatScroll;
  v.selScroll = g_selScroll;
  g_emojiMaxScroll = om::ui::chatEmojiMaxScroll(v);
  if (g_emojiScroll > g_emojiMaxScroll) g_emojiScroll = g_emojiMaxScroll;
  if (g_emojiScroll < 0) g_emojiScroll = 0;
  v.emojiScroll = g_emojiScroll;
  g_chatTotal = om::ui::chatContentHeight(v);
  om::ui::chatScreenDraw(v);
}

// "Manage channels" in the chat selector is a door into the same Settings page: General > Channels.
static void openChannelList() {
  openSettings(1, om::ui::SettingsTab::General);
  setGo(SetPage::Channels);   // Back from the list returns to General, as it always did
  drawSettings();
}

static void chatSelectChat(int chat) {
  if (chat < 0 || chat >= g_chatCount) return;
  g_chatSel = chat;
  g_chatScroll = 0;
  g_selScroll = 0;
  // EST-367: a new chat starts with NO view and no mark-as-read. The view asks the loop for that
  // chat's own newest page (chatViewStep), and drawChat marks read only through what it loaded: an
  // unread count can no longer drop for a chat whose screen stayed empty.
  g_viewChat = chat;
  g_viewCount = 0;
  g_viewLoading = true;
  g_viewMore = true;
  g_selector = false;
  g_advertMenu = false;   // EST-382: the two dropdowns are exclusive and both belong to the old chat
  g_kb.showLetters();   // leaving a page does not follow the next open (which resets anyway)
  g_emojiScroll = 0;
  g_bubMenuSeq = 0;
  g_replySeq = 0;
  g_replyName[0] = 0;
}

// The draft budget of the open chat. A channel text spends our "<name>: " prefix (and an "@Name "
// reply mention); a direct text frame spends only its 4-byte timestamp and 1 attempt byte, so the DM
// budget is MAX_TEXT_LEN minus five (mesh_text.h, proven by the host test).
static int chatDraftAllowance() {
  if (chatThread(g_chatSel) >= 0) return om::kMeshDmTextMax;
  const bool replying = g_replySeq != 0 && g_replyName[0] != 0;
  return om::ui::composeAllowance(replying, g_replyName, om::meshNodeName());
}

// Send on the open chat. A channel reply travels as "@Name text": MeshCore's message format has no
// reply field (checked in Packet/BaseChatMesh), and the mention is what the bots already understand.
// A DM has exactly one reader, so its reply bar marks what the text answers without adding bytes to
// the frame. Nothing is cut here: an over-long draft is refused and logged instead of going on the
// air short (EST-334).
static bool chatSend() {
  // EST-406: the send button's dim state is this same rule. A draft that is empty or only whitespace
  // has nothing to send, so neither the look nor the action may pretend otherwise.
  if (!om::ui::sendEnabled(g_kbText)) return false;
  const int allow = chatDraftAllowance();
  if ((int)strlen(g_kbText) > allow) {
    Serial.printf("[chat] send refused: %u bytes, %d allowed\n", (unsigned)strlen(g_kbText), allow);
    return false;
  }
  const int thread = chatThread(g_chatSel);
  if (thread >= 0) {
    const bool sent = om::meshDmSend(thread, g_kbText);
    if (sent) om::sounds::playEvent(SoundEvent::Sent);
    else om::sounds::playEvent(SoundEvent::Error);
    // EST-399: the verdict and the length, never the draft (rule 9; EST-396 #2).
    Serial.printf("[mc] UI DM send: %s, %u B\n", sent ? "ok" : "failed",
                  (unsigned)strlen(g_kbText));
    return sent;
  }
  const int chan = chatChannel(g_chatSel);
  if (chan < 0) return false;
  const bool replying = g_replySeq != 0 && g_replyName[0] != 0;
  char wire[om::kMeshTextCap + om::kMeshNameMax + 4];
  if (replying) {
    snprintf(wire, sizeof(wire), "@%s %s", g_replyName, g_kbText);
  } else {
    snprintf(wire, sizeof(wire), "%s", g_kbText);
  }
  const bool sent = om::meshLinkSend(chan, wire);
  if (sent) om::sounds::playEvent(SoundEvent::Sent);
  else om::sounds::playEvent(SoundEvent::Error);
  // EST-399: same rule for the channel send (this one also carries the reply mention).
  Serial.printf("[mc] UI send: %s, %u B%s\n", sent ? "ok" : "failed", (unsigned)strlen(wire),
                replying ? ", reply" : "");
  return sent;
}

// Send the draft through the open chat (channel or DM, a reply or not, from the letters page or the
// emoji page). EST-406: the composer's send button on the draft line is the ONE door; every path
// ends here, so they all clear the same state. It does nothing on an empty or whitespace-only draft
// (chatSend() refuses it), which is the same state the button is drawn dim in.
static void chatSendDraft() {
  if (!chatSend()) return;
  g_kbText[0] = 0;
  g_replySeq = 0;
  g_replyName[0] = 0;
  g_kb.close();   // the next open goes through openSheet() and starts on letters, shift off
}

// One emoji from the keyboard: four UTF-8 bytes at most, refused as a unit when the draft budget
// has no room for it (never a broken sequence). The pick moves to the front of the Recent row.
static void chatEmojiPick(uint32_t cp) {
  char bytes[5] = {0};
  const int n = om::ui::utf8Encode(cp, bytes);
  if (n <= 0) return;
  bytes[n] = 0;
  if (!om::ui::composeAppend(g_kbText, (int)sizeof(g_kbText), bytes, chatDraftAllowance())) {
    Serial.printf("[chat] emoji U+%04lX refused: draft budget full\n", (unsigned long)cp);
    return;
  }
  g_emojiRecent.use(cp);
  // EST-399: RAM only. The one NVS write for the Recent row goes out when the emoji page is left, or
  // after 30 s without another pick (emojiPersistStep from the loop). Six emoji used to be six flash
  // commits, and the write's result was never looked at (EST-398 #4).
  g_emojiSave.changed(millis());
  Serial.printf("[chat] emoji U+%04lX -> recent %u (save pending)\n", (unsigned long)cp,
                (unsigned)g_emojiRecent.count);
}

// EST-346: the release of a hold on s, c or z enters the accented letter the bubble showed. One code
// point (two UTF-8 bytes), appended as a whole through the same budget as every other key: a full
// draft refuses it rather than splitting the sequence.
static void chatAccentCommit() {
  if (g_accentCp == 0) return;
  char bytes[5] = {0};
  const int n = om::ui::utf8Encode(g_accentCp, bytes);
  if (n <= 0) return;
  bytes[n] = 0;
  if (!om::ui::composeAppend(g_kbText, (int)sizeof(g_kbText), bytes, chatDraftAllowance())) {
    Serial.printf("[chat] accent U+%04lX refused: draft budget full\n", (unsigned long)g_accentCp);
    return;
  }
  Serial.printf("[chat] accent U+%04lX (%s), %u bytes in the draft\n", (unsigned long)g_accentCp,
                bytes, (unsigned)strlen(g_kbText));
}

// The sheet owns the keyboard state; this applies one key and says whether the draft was sent. The
// draft counts bytes against the same budget the counter shows, and a key that would pass it does
// nothing at all (Filip, 2026-11-10: no silent cut on send).
static void chatKey(const om::ui::ChatHitResult& hit) {
  const int allow = chatDraftAllowance();
  switch (hit.keyKind) {
    case om::ui::KeyKind::Shift:
      g_kb.toggleShift();
      break;
    case om::ui::KeyKind::Mode:
      g_kb.toggleNumbers();
      break;
    case om::ui::KeyKind::Emoji:
      g_kb.toggleEmoji();
      g_emojiScroll = 0;
      break;
    case om::ui::KeyKind::Space:
      om::ui::composeAppend(g_kbText, (int)sizeof(g_kbText), " ", allow);
      break;
    case om::ui::KeyKind::Del:
      om::ui::composeBackspace(g_kbText);   // one whole code point, never half an emoji
      break;
    case om::ui::KeyKind::Send:
      chatSendDraft();
      break;
    case om::ui::KeyKind::Reveal:
      break;   // a chat draft has no secret to reveal
    case om::ui::KeyKind::Char: {
      char one[2] = {hit.keyCh, 0};
      if (g_kb.shift && !g_kb.nums() && one[0] >= 'a' && one[0] <= 'z') one[0] = (char)(one[0] - 32);
      om::ui::composeAppend(g_kbText, (int)sizeof(g_kbText), one, allow);
      break;
    }
  }
}

static void showTab(int tab);
static void drawSettings();   // the Chat header's gear opens it (defined below)

// Open (or create) a DM thread for a contact and show it in the chat screen. This is what the
// message sheet's "Direct message" row and a tap on a sender's name both call (EST-342).
static bool chatOpenDmFor(const char* name) {
  int thread = -1;
  if (!om::meshDmOpenByName(name, &thread)) {
    // EST-399: no name (rule 9: it is the contact the user typed or tapped).
    Serial.printf("[chat] DM refused: unknown contact\n");
    return false;
  }
  refreshChats();
  for (int i = g_channelCount; i < g_chatCount; ++i) {
    if (g_chats[i].dm && g_chats[i].thread == thread) {
      chatSelectChat(i);
      // EST-355: Nodes -> Chat is a full screen change like any tab switch (both pages are dark, so
      // the dip rule keeps it instant, but it goes through the one path and logs its line).
      if (g_tab != 1) showTab(1);
      else drawChat();
      return true;
    }
  }
  return false;
}

// One row of the message sheet. The rows were built from what can work (message_sheet.h), so a row
// that is here does something; the informational ones (Path, Heard repeats) just close the sheet.
static void handleSheetAction(const om::ui::ChatHitResult& hit) {
  if (hit.index < 0 || hit.index >= g_chatMsgCount) {
    g_bubMenuSeq = 0;
    return;
  }
  const om::ui::ChatMsgView& m = g_chatMsgs[hit.index];
  switch (hit.sheet) {
    case om::ui::SheetAction::Reply:
      g_replySeq = hit.seq;
      // Copy the name now: the ring may shift before Send, and the reply must still address the
      // sender the user tapped, even if this message is the one that gets dropped.
      snprintf(g_replyName, sizeof(g_replyName), "%s", m.name);
      g_bubMenuSeq = 0;
      g_kbText[0] = 0;
      g_kb.openSheet();
      // EST-399: the sequence number being answered, not the sender's name (rule 9).
      Serial.printf("[chat] reply opened: seq %lu\n", (unsigned long)g_replySeq);
      break;
    case om::ui::SheetAction::CopyText:
      // COPY takes the whole text, cut only by the composer's own byte budget: on a code point
      // boundary and with an ellipsis when it has to shorten (composeCopy).
      om::ui::composeCopy(g_kbText, (int)sizeof(g_kbText), m.text, chatDraftAllowance());
      g_replySeq = 0;
      g_replyName[0] = 0;
      g_bubMenuSeq = 0;
      g_kb.openSheet();
      Serial.println("[chat] copied a message into the draft");
      break;
    case om::ui::SheetAction::Mention: {
      // "@Name " in the draft without the reply bar: a plain message that starts with a mention.
      char tag[om::kMeshNameCap + 3];
      snprintf(tag, sizeof(tag), "@%s ", m.name);
      om::ui::composeAppend(g_kbText, (int)sizeof(g_kbText), tag, chatDraftAllowance());
      g_replySeq = 0;
      g_replyName[0] = 0;
      g_bubMenuSeq = 0;
      g_kb.openSheet();
      // EST-399: that a mention went in, not the name it names (rule 9).
      Serial.printf("[chat] mention prepended: %u B\n", (unsigned)strlen(tag));
      break;
    }
    case om::ui::SheetAction::NodeDetails: {
      om::nodes_tab::selectByName(m.name);
      g_bubMenuSeq = 0;
      g_selector = false;
      showTab(0);
      return;
    }
    case om::ui::SheetAction::ShowOnMap: {
      om::MeshContact c{};
      if (om::meshContactByName(m.name, &c) && c.has_pos) {
        const double lat = (double)c.lat_e6 / 1e6;
        const double lon = (double)c.lon_e6 / 1e6;
        g_bubMenuSeq = 0;
        om::map_tab::showPoint(lat, lon, m.name);
        // EST-397: the name only. The contact's exact point is rule 9's first "no", and this line put
        // it in the log on every map open from a chat.
        Serial.printf("[chat] map: opening the node's position\n");
        showTab(2);
        return;
      }
      g_bubMenuSeq = 0;
      break;
    }
    case om::ui::SheetAction::Resend: {
      // The same text as a NEW packet: a channel send, or a fresh DM through the companion's path.
      const int thread = chatThread(g_chatSel);
      const int chan = chatChannel(g_chatSel);
      if (thread >= 0) {
        const bool sent = om::meshDmSend(thread, m.text);
        // EST-399: the verdict and the length, never the body (rule 9; EST-396 #2).
        Serial.printf("[chat] DM resend %s, %u B\n", sent ? "ok" : "failed",
                      (unsigned)strlen(m.text));
      } else if (chan >= 0) {
        const bool sent = om::meshLinkSend(chan, m.text);
        Serial.printf("[chat] resend %s, %u B\n", sent ? "ok" : "failed",
                      (unsigned)strlen(m.text));
      }
      g_bubMenuSeq = 0;
      break;
    }
    case om::ui::SheetAction::DirectMessage: {
      // EST-342: the row exists only for a known contact with a key, and the thread opens (or is
      // created empty) here.
      g_bubMenuSeq = 0;
      chatOpenDmFor(m.name);
      return;
    }
    case om::ui::SheetAction::Path:            // informational, shown in the row's value
    case om::ui::SheetAction::HeardRepeats:    // informational, shown in the row's value
    case om::ui::SheetAction::None:
    default:
      g_bubMenuSeq = 0;
      break;
  }
}

// EST-382: one advert, from the button or (via the USB command) the same facade call. The 30 s guard
// per kind lives in mesh_link, so the key and `advert local|flood` can never disagree. `r` is 0 when
// sent, a positive number of seconds still to wait, and negative when the radio refused.
static void showToast(const char* text);

static void chatAdvertSend(bool flood) {
  g_advertMenu = false;   // a tap on an option sends and closes
  const int r = om::meshSendAdvert(flood);
  char msg[48];
  if (r == 0) {
    snprintf(msg, sizeof(msg), "%s", flood ? "Advert sent (flood)" : "Advert sent (nearby)");
  } else if (r > 0) {
    snprintf(msg, sizeof(msg), "Advert already sent, wait %ds", r);
  } else {
    snprintf(msg, sizeof(msg), "Advert not sent");
  }
  showToast(msg);
}

// One tap on the Chat tab. The screen says what was hit with the same rectangles it drew.
static void handleChatTap(int x, int y) {
  const om::ui::Layout& L = om::ui::l2();
  om::ui::ChatView v;
  buildChatView(v);
  const om::ui::ChatHitResult hit = om::ui::chatScreenHit(v, x, y);
  switch (hit.hit) {
    case om::ui::ChatHit::Head:
      // The header is the selector's own door: it opens the dropdown and closes it again. EST-382:
      // the two dropdowns are exclusive, so opening the selector closes the ADVERT menu.
      g_selector = !g_selector;
      g_advertMenu = false;
      g_kb.close();
      g_bubMenuSeq = 0;
      if (g_selector) g_selScroll = 0;
      break;
    case om::ui::ChatHit::Advert:
      // The key toggles its own small dropdown; the chat selector is the other one and must close.
      g_advertMenu = !g_advertMenu;
      g_selector = false;
      g_kb.close();
      g_bubMenuSeq = 0;
      break;
    case om::ui::ChatHit::AdvertFlood:
      chatAdvertSend(true);
      break;
    case om::ui::ChatHit::AdvertLocal:
      chatAdvertSend(false);
      break;
    case om::ui::ChatHit::AdvertClose:
      g_advertMenu = false;   // a tap on the panel but not an option: close only, never act behind
      break;
    case om::ui::ChatHit::SelRow:
      chatSelectChat(hit.index);
      break;
    case om::ui::ChatHit::SelManage:
      g_selector = false;
      openChannelList();
      return;
    case om::ui::ChatHit::SelClose:
      g_selector = false;
      break;
    case om::ui::ChatHit::Msg:
      g_bubMenuSeq = hit.seq;   // hold the message id, not its position in the ring
      g_kb.close();             // the sheet needs the room and covers the keyboard anyway
      break;
    case om::ui::ChatHit::SenderName: {
      // EST-342: a tap on the sender's name is the sheet's "Direct message" row.
      if (hit.index >= 0 && hit.index < g_chatMsgCount && !g_chatMsgs[hit.index].mine) {
        chatOpenDmFor(g_chatMsgs[hit.index].name);
        return;
      }
      g_bubMenuSeq = hit.seq;
      g_kb.close();
      break;
    }
    case om::ui::ChatHit::SheetRow:
      handleSheetAction(hit);
      break;
    case om::ui::ChatHit::SheetClose:
      g_bubMenuSeq = 0;
      break;
    case om::ui::ChatHit::Field:
      g_kb.openSheet();   // always on the letters page, shift off (EST-346)
      break;
    case om::ui::ChatHit::Key:
      chatKey(hit);
      break;
    case om::ui::ChatHit::EmojiCell:
      chatEmojiPick(hit.emojiCp);
      break;
    case om::ui::ChatHit::EmojiCat:
      if (hit.emojiGroup >= 0 && hit.emojiGroup < om::ui::kEmojiGroupCount) {
        g_emojiGroup = hit.emojiGroup;
        g_emojiScroll = 0;
      }
      break;
    case om::ui::ChatHit::EmojiBack:
      g_kb.showLetters();   // back to the letters/numbers keyboard page
      g_emojiScroll = 0;
      break;
    // EST-406: the one Send door for channel, DM, reply and the emoji page. The button is on the
    // draft line and is drawn dim while the draft is empty or only whitespace; chatSendDraft() then
    // does nothing, exactly like the dim look says.
    case om::ui::ChatHit::SendDraft:
      chatSendDraft();
      break;
    case om::ui::ChatHit::Outside:
      // Belt and braces: the shell already closed the sheet on the PRESS that landed above it and
      // spent that gesture (EST-339), so this is only reached if a hit test runs on an open sheet.
      g_kb.close();
      break;
    case om::ui::ChatHit::None:
      // Not the chat surface: the tab bar (hidden while the sheet is open), the fault mark and the
      // status gear.
      if (!g_kb.open) {
        const int tab = L.tabAt(x, y);
        if (tab >= 0) { showTab(tab); return; }
      }
      // A tap on the radio fault mark says which fault it is; nothing when the mark is not showing.
      if (L.radioFault().contains(x, y)) {
        showRadioFaultToast();
        return;
      }
      // The gear is the only door to Settings (Filip, 2026-11-10); the channel list is reached from
      // the selector's "Manage channels" row.
      if (L.gear().contains(x, y)) {
        openSettings(1, om::ui::SettingsTab::Chat);
        return;
      }
      return;
  }
  drawChat();
}

// The overlay on top of the chat at a press, and whether the finger is inside it (EST-339). The same
// rectangles the drawing and the release-time hit test use, so the two can never disagree.
static om::ui::ChatOverlayPress chatOverlayPressAt(int x, int y) {
  om::ui::ChatView v;
  buildChatView(v);
  const om::ui::ChatLayout g =
      om::ui::chatLayoutFor(om::ui::l2(), v.osk, v.replySeq != 0, v.nums, v.selector);
  return om::ui::chatOverlayPress(g, v.menuMsg >= 0, om::ui::chatSheetPanel(v), x, y,
                                  v.advertMenu, g.advertMenu);
}

// Close one overlay because a press landed outside it. Returns true when something was open.
static bool closeChatOverlay(om::ui::ChatOverlay which) {
  switch (which) {
    case om::ui::ChatOverlay::MessageSheet:
      if (g_bubMenuSeq == 0) return false;
      g_bubMenuSeq = 0;
      return true;
    case om::ui::ChatOverlay::Selector:
      if (!g_selector) return false;
      g_selector = false;
      return true;
    case om::ui::ChatOverlay::AdvertMenu:
      if (!g_advertMenu) return false;
      g_advertMenu = false;
      return true;
    case om::ui::ChatOverlay::Keyboard:
      if (!g_kb.open) return false;
      g_kb.close();
      return true;
    case om::ui::ChatOverlay::None:
    default:
      return false;
  }
}

static const char* chatOverlayName(om::ui::ChatOverlay which) {
  switch (which) {
    case om::ui::ChatOverlay::MessageSheet: return "the message sheet";
    case om::ui::ChatOverlay::Selector: return "the selector";
    case om::ui::ChatOverlay::AdvertMenu: return "the advert menu";
    case om::ui::ChatOverlay::Keyboard: return "the keyboard";
    case om::ui::ChatOverlay::None:
    default: return "no overlay";
  }
}

// EST-410: the RPTR tab's state, drawing glue and tap handling live in screens/rptr_tab.cpp.
static void showToast(const char* text);

// ------------------------------------------------------------------------------ notifications (EST-366)
// One door for every event that plays a sound (rule 9): the DND rule, the open-chat rule and the
// burst queue live in ui/notify.h (host-tested), and this only decides WHERE the text goes: straight
// to the toast, or into the one pending slot while a toast is already showing. `chatOpen` is true
// only when the chat that received this message is the one on screen.


static bool chatOpenForChannel(int channel) {
  if (g_tab != 1 || g_settings || g_selector) return false;
  if (g_chatSel < 0 || g_chatSel >= g_chatCount) return false;
  if (g_chatSel >= g_channelCount) return false;   // a DM is open, not this channel
  return g_chatSel == channel;
}

static bool chatOpenForThread(int thread) {
  if (g_tab != 1 || g_settings || g_selector) return false;
  if (g_chatSel < 0 || g_chatSel >= g_chatCount) return false;
  const om::ui::ChatEntry& c = g_chats[g_chatSel];
  return c.dm && (int)c.thread == thread;
}



// --------------------------------------------------------------------------------- settings shell
// EST-347: Settings rebuilt on the new layer. Every page is a list of SettingRow built here and
// drawn by ui/screen_settings.cpp; the rectangles, the tab row, the scroll clamp and the manual-time
// arithmetic live in ui/settings_layout.h and are host-tested. The only geometry this file knows is
// the action id in a row.
// EST-422: the ids (SetAct) live in ui/settings_actions.h now, next to the ONE list of which of them
// ask before they change and the confirm sheet's state machine, so the shell and the host test read
// the same numbers.

// EST-350: where a page came from is the navigation history (ui/settings_layout.h SettingsNav), not a
// flag per page, so Back needs no table and every page returns to the one that opened it. What is left
// here is only who the name editor is renaming.
static bool s_setNameNode = false;   // the name editor is renaming the node, not a channel

static void drawSettings();   // the gear and every settings page reach this
static void showToast(const char* text);
static void drawOwnPick();    // EST-384: the Settings own-position map picker's frame

static void setResetRows() { g_setRowCount = 0; }

static void setAdd(om::ui::SetRowKind kind, uint16_t id, const char* label, const char* value = "",
                   bool on = false, bool danger = false) {
  if (g_setRowCount >= kSetRowsCap) return;
  om::ui::SettingRow& r = g_setRows[g_setRowCount++];
  r = om::ui::SettingRow();
  r.kind = kind;
  r.id = id;
  r.on = on;
  r.danger = danger;
  snprintf(r.label, sizeof(r.label), "%s", label != nullptr ? label : "");
  snprintf(r.value, sizeof(r.value), "%s", value != nullptr ? value : "");
}

static void setSection(const char* label) {
  setAdd(om::ui::SetRowKind::Section, A_None, label);
}

static bool setRootPage(SetPage p) { return om::ui::settingsRootPage(p); }

// EST-350: the ONE way to move to another page. Leaving a page records where it was scrolled to, so
// Back (settingsBack) returns there; Back itself is the other end of the same record.
static void setGo(SetPage p) {
  if (p != g_setPage) g_setNav.push(g_setPage, g_setScroll);
  g_setPage = p;
  g_setScroll = 0;
  g_setSelOpen = false;
  g_ask.close();   // EST-422: the confirm sheet never survives a page change
  g_posChoice = false;   // EST-392: leaving the page closes the Position choice
  // EST-352: every door into a text editor opens the shared sheet on the letters page with shift
  // off, exactly the chat sheet's rule; the accented-letter hold starts clean. EST-354: the Wi-Fi
  // password also starts hidden and empty.
  if (p == SetPage::NameEdit || p == SetPage::ChanKey || p == SetPage::WifiPass) {
    g_setEditNums = false;
    g_setEditShift = false;
    g_setEditReveal = false;
    if (p == SetPage::WifiPass) g_editBuf[0] = 0;
    g_setAccentRow = -1;
    g_setAccentCol = -1;
    g_setAccentCp = 0;
    g_setAccentPreview = false;
  }
}

// Back from an action (Join, Apply, Use, Delete) to the page it was opened from: the same step, run
// backwards, so that page comes back at the scroll it had.
static void setBack() {
  SetPage p = g_setPage;
  int scroll = 0;
  if (!g_setNav.pop(&p, &scroll)) {
    g_setPage = SetPage::GeneralRoot;
    g_setScroll = 0;
  } else {
    g_setPage = p;
    g_setScroll = scroll;
  }
  g_setSelOpen = false;
  g_ask.close();   // EST-422: the confirm sheet never survives a page change
  g_posChoice = false;   // EST-392: the choice never survives a Back
}

static SetPage setRootForTab(om::ui::SettingsTab t) {
  switch (t) {
    case om::ui::SettingsTab::Nodes: return SetPage::NodesRoot;
    case om::ui::SettingsTab::Chat:  return SetPage::ChatRoot;
    case om::ui::SettingsTab::Map:   return SetPage::MapRoot;
    case om::ui::SettingsTab::Rptr:  return SetPage::RptrRoot;
    default:                         return SetPage::GeneralRoot;
  }
}

// The channel the Chat tab's settings page edits: the chat picked IN SETTINGS (g_setChat), which is
// the open chat until the user picks another one there.
static int settingsChatChannel() {
  if (g_setChat < 0 || g_setChat >= g_chatCount) return -1;
  if (g_chats[g_setChat].dm) return -1;
  return g_setChat < g_channelCount ? g_setChat : -1;
}

static void clockLine(char* out, size_t cap) {
  const uint32_t now = om::timeKeeper().now();
  if (!om::timeKeeper().realSinceBoot() || !om::formatClock(now, out, cap)) {
    snprintf(out, cap, "--:--");
  }
}

// "GPS, 2 min ago" / "not set": the time's source and how long ago it set the clock.
static void timeSourceLine(char* out, size_t cap) {
  const om::TimeSource s = om::timeKeeper().source();
  if (s == om::TimeSource::None) {
    snprintf(out, cap, "not set");
    return;
  }
  const uint32_t age = om::timeKeeper().sourceAgeSec(millis() / 1000);
  char ag[24];
  if (age < 60) snprintf(ag, sizeof(ag), "just now");
  else if (age < 3600) snprintf(ag, sizeof(ag), "%lu min ago", (unsigned long)(age / 60));
  else if (age < 86400) snprintf(ag, sizeof(ag), "%lu h ago", (unsigned long)(age / 3600));
  else snprintf(ag, sizeof(ag), "%lu d ago", (unsigned long)(age / 86400));
  snprintf(out, cap, "%s, %s", om::timeSourceName(s), ag);
}

static void timeInitFromClock() {
  // EST-413: a real clock seeds the steppers; a not-real clock is the floor (max saved NVS, build
  // time) and must not be shown as the time to set. Start from the build time instead: it is not a
  // real time either, but it is not the stale saved floor, and the Time page above already says
  // "--:--" until a real source arrives.
  const uint32_t seed = om::manualTimeSeedEpoch(om::timeKeeper().realSinceBoot(),
                                                om::timeKeeper().now(), g_buildEpoch);
  int y = 2026, mo = 1, d = 1, h = 0, mi = 0;
  if (seed == 0 || !om::localCivil(seed, y, mo, d, h, mi)) {
    y = 2026; mo = 1; d = 1; h = 0; mi = 0;
  }
  g_setTime = om::ui::CivilTime{y, mo, d, h, mi};
}

static void presetDesc(int i, char* out, size_t cap) {
  if (i >= 0 && i < om::ui::kRadioPresetCount) {
    snprintf(out, cap, "%s", om::ui::radioPresetAt(i).desc);
  } else {
    const om::ui::RadioPrefs& p = g_custom;
    char f[16], b[16];
    om::ui::radioFreqText(p, f, sizeof(f));
    om::ui::radioBwText(p, b, sizeof(b));
    snprintf(out, cap, "%s MHz / SF%u / BW%s / CR%u", f, (unsigned)p.sf, b, (unsigned)p.cr);
  }
}

static void radioPresetValue(char* out, size_t cap) {
  const int i = om::ui::radioPresetIndex(g_radio.prefs());
  snprintf(out, cap, "%s", i < om::ui::kRadioPresetCount ? om::ui::radioPresetAt(i).name : "Custom");
}

// The manual-time page's values, as the steppers show them.
static void timeFieldText(om::ui::TimeField f, char* out, size_t cap) {
  switch (f) {
    case om::ui::TimeField::Year:   snprintf(out, cap, "%d", g_setTime.year); break;
    case om::ui::TimeField::Month:  snprintf(out, cap, "%02d", g_setTime.month); break;
    case om::ui::TimeField::Day:    snprintf(out, cap, "%02d", g_setTime.day); break;
    case om::ui::TimeField::Hour:   snprintf(out, cap, "%02d", g_setTime.hour); break;
    default:                        snprintf(out, cap, "%02d", g_setTime.minute); break;
  }
}

// EST-400: ONE manual-time apply. The title row's Set key and the editor's OK carried the same
// twenty lines (the civil build, the sanity gate, the source set, the floor save and the two toasts),
// and a third copy is how the EST-391 32-bit bug would come back. Shows the one toast and returns
// whether the clock was set; the caller then leaves the page.
static bool applyManualTime() {
  uint32_t epoch = 0;
  const bool made = om::localEpochFromCivil(g_setTime.year, g_setTime.month, g_setTime.day,
                                            g_setTime.hour, g_setTime.minute, 0, epoch);
  if (!made || !om::saneEpoch(epoch) ||
      !om::timeKeeper().setFromSource(epoch, om::TimeSource::Manual, millis() / 1000)) {
    showToast("Time not set");
    return false;
  }
  saveTimeFloor();
  showToast("Time set");
  return true;
}

static void buildSettingsRows() {
  setResetRows();
  // EST-392: the Position row is only on General; every other page leaves the index unset.
  g_posRowIndex = -1;
  g_setEditor = om::ui::SettingsEditor::None;
  g_setSubPage = !setRootPage(g_setPage);
  g_setOkLabel = "OK";
  g_setActionLabel = "";
  g_setActionId = A_None;
  g_setActionOn = false;
  snprintf(g_setTitle, sizeof(g_setTitle), "Settings");

  switch (g_setPage) {
    case SetPage::GeneralRoot: {
      char v[40], name[40], key[16];
      radioPresetValue(v, sizeof(v));
      setSection("RADIO & MESH");
      setAdd(om::ui::SetRowKind::Chevron, A_Preset, "Region / preset", v);
      snprintf(v, sizeof(v), "%d dBm", (int)g_radio.prefs().tx);
      setAdd(om::ui::SetRowKind::Stepper, A_TxPower, "TX power", v);
      setAdd(om::ui::SetRowKind::Chevron, A_Hash, "Path hash", om::meshPathHashLabel());
      snprintf(name, sizeof(name), "%s", om::meshNodeName());
      // EST-350: this row opens the NODE PAGE (Name, Public key, Share position); renaming is that
      // page's own Name row. It used to jump straight into the name editor.
      setAdd(om::ui::SetRowKind::Chevron, A_Node, "Node", name);
      snprintf(v, sizeof(v), "%d channels", om::mcChannelCount());
      setAdd(om::ui::SetRowKind::Chevron, A_Channels, "Channels", v);

      setSection("CONNECTIONS");
      // EST-354: the row says what the radio is doing, so the page is one tap away from an answer.
      if (!om::wifiIsEnabled()) snprintf(v, sizeof(v), "off");
      else if (om::wifiStatus().phase == om::wifi::Phase::Connected) snprintf(v, sizeof(v), "connected");
      else snprintf(v, sizeof(v), "on");
      setAdd(om::ui::SetRowKind::Chevron, A_Wifi, "Wi-Fi", v);
      setAdd(om::ui::SetRowKind::Chevron, A_Bt, "Bluetooth", om::ble::phaseLabel(om::blePhase()));
      // EST-412: the M5 CardKB on the back Grove port. DEFAULT OFF, saved as "grovekb"; the ON
      // action powers Grove, opens the second bus and probes 0x5F (the handler below).
      setAdd(om::ui::SetRowKind::Toggle, A_GroveKeyboard, "Keyboard (Grove)", "ON", g_kbEnabled);

      setSection("SOUND");
      setAdd(om::ui::SetRowKind::Chevron, A_Sound, "Sound", om::sounds::masterOn() ? "on" : "off");

      setSection("DISPLAY");
      snprintf(v, sizeof(v), "%u", (unsigned)g_setBrightness);
      setAdd(om::ui::SetRowKind::Stepper, A_Brightness, "Brightness", v);
      // EST-405: the screen auto-off switch, DEFAULT OFF, and (only while it is on) the row that
      // opens its five time choices. The time row is hidden when the switch is off, so the default
      // page looks exactly as it did before this ticket.
      setAdd(om::ui::SetRowKind::Toggle, A_IdleAutoOff, "Screen auto-off", "ON", g_idle.enabled());
      if (g_idle.enabled()) {
        setAdd(om::ui::SetRowKind::Chevron, A_IdleTime, "Auto-off after", g_idle.timeLabel());
      }

      setSection("TIME");
      clockLine(v, sizeof(v));
      setAdd(om::ui::SetRowKind::Chevron, A_Time, "Time", v);

      // EST-392: the "GPS" section is renamed "POSITION" and the `Position` row in it is THE one
      // source control (Filip, 2026-11-11: "There is only GPS in General ... rename GPS to Position,
      // with GPS and fixed position there"). Its value is the source in use, never a coordinate
      // (rule 9); a tap opens the small GPS / Fixed choice under the row. The row goes FIRST in its
      // section, so the two-row choice drops DOWN (with Satellites/Fix under it, the panel would have
      // been 10 px short of the page's floor at 320x240); the GPS details below it are unchanged.
      setSection(om::ui::kPosSectionLabel);
      g_posRowIndex = g_setRowCount;
      setAdd(om::ui::SetRowKind::Chevron, A_PosSource, om::ui::kPosRowLabel,
             om::posSourceLabel());
      snprintf(v, sizeof(v), "%u used, %u heard", (unsigned)g_gps.sats,
               (unsigned)g_gps.heardTotal);
      setAdd(om::ui::SetRowKind::Value, A_None, "Satellites", v);
      setAdd(om::ui::SetRowKind::Value, A_None, "Fix", g_gps.valid ? "3D" : "no fix");
      setAdd(om::ui::SetRowKind::Toggle, A_AdvertPos, "Share position", "ON",
             om::meshAdvertPosPolicyGet());

      setSection("ABOUT");
      setAdd(om::ui::SetRowKind::Value, A_None, "Firmware", __DATE__);
      // EST-379: the commit this image was built from, in the page's small dim text. The serial
      // boot line and the `status` answer carry the same id.
      snprintf(v, sizeof(v), "Build %s", OM_BUILD_ID);
      setAdd(om::ui::SetRowKind::Note, A_None, v);
      key[0] = 0;
      om::meshPubKeyShort(key, sizeof(key));
      setAdd(om::ui::SetRowKind::Value, A_None, "Node id", key);
      // EST-360: our own battery in volts, two decimals; "n/a" outside 2.5..30 V or at 0. The raw mV
      // stays on the serial `[batt] N mV` detail line, not on the glass.
      om::rptr::batteryVoltsText(v, sizeof(v), g_battMv);
      setAdd(om::ui::SetRowKind::Value, A_None, "Battery", v);
      snprintf(v, sizeof(v), "%u B", (unsigned)ESP.getFreeHeap());
      setAdd(om::ui::SetRowKind::Value, A_None, "Free heap", v);
      setAdd(om::ui::SetRowKind::Value, A_None, "SD card", g_sdOk ? "mounted" : "absent");
      // EST-365: what the radio hears, on the About page the ticket names. The noise floor is the
      // chip's own value (sampled every 5 s); packets heard counts every raw reception, including
      // the flood repeats this node does not process.
      {
        om::radio::UpstreamCounters c;
        const bool radioUp = om::meshRadioStats(&c);
        const om::radio::Snapshot sn = om::radio::snapshot();
        const int noise = sn.noise.samples > 0 ? sn.noise.last : (radioUp ? c.noiseFloor : 0);
        if (sn.noise.samples > 0) {
          snprintf(v, sizeof(v), "%d dBm (%d/%d)", noise, sn.noise.min, sn.noise.avg);
        } else {
          snprintf(v, sizeof(v), "%d dBm", noise);
        }
        setAdd(om::ui::SetRowKind::Value, A_None, "Noise floor", v);
        snprintf(v, sizeof(v), "%lu (dup %lu)", (unsigned long)sn.packetsHeard,
                 (unsigned long)(radioUp ? c.duplicates : 0));
        setAdd(om::ui::SetRowKind::Value, A_None, "Packets heard", v);
        setAdd(om::ui::SetRowKind::Value, A_None, "Radio gain",
               radioUp && c.boostedKnown ? (c.boosted ? "boosted" : "power save") : "--");
      }
      break;
    }

    case SetPage::NodesRoot: {
      char v[32];
      setSection("NODE LIST");
      snprintf(v, sizeof(v), "%d", om::nodes_tab::count());
      setAdd(om::ui::SetRowKind::Value, A_None, "Nodes heard", v);
      setAdd(om::ui::SetRowKind::Note, A_None, "No node list settings yet.");
      setAdd(om::ui::SetRowKind::Note, A_None,
             "Sorting, a hearing filter and type filters are not built yet.");
      break;
    }

    case SetPage::ChatRoot: {
      refreshChats();
      if (g_setChat >= g_chatCount) g_setChat = g_chatCount > 0 ? g_chatCount - 1 : 0;
      if (g_setChat < 0) g_setChat = 0;
      // EST-350: the section header IS the chat selector (the Chat tab's own dropdown), so the chat
      // whose settings are shown can be picked here without leaving Settings. Its label stays the
      // section name; its value is the chat on the page, never the Chat tab's open chat.
      const char* selName = (g_setChat >= 0 && g_setChat < g_chatCount) ? g_chats[g_setChat].name
                                                                       : "";
      setAdd(om::ui::SetRowKind::Selector, A_ChatPick, "THIS CHAT", selName, g_setSelOpen);
      const int ch = settingsChatChannel();
      if (ch >= 0) {
        char v[40], k[40];
        setAdd(om::ui::SetRowKind::Chevron, A_ChatOpen, "Open channel", om::mcChannelName(ch));
        setAdd(om::ui::SetRowKind::Toggle, A_ChatEnabled, "Enabled", "ON", om::mcChannelEnabled(ch));
        setAdd(om::ui::SetRowKind::Toggle, A_ChatSound, "Sound", "ON", !om::mcChannelMuted(ch));
        setAdd(om::ui::SetRowKind::Chevron, A_ChatRename, "Rename", om::mcChannelName(ch));
        om::mcChannelKeyB64(ch, k, sizeof(k));
        setAdd(om::ui::SetRowKind::Value, A_None, "Key", k);
        // EST-422: one pattern for every delete. The row is a plain Delete button; the shared confirm
        // sheet asks once and Cancel leaves the channel alone (the EST-399 "tap again" arm is gone).
        setAdd(om::ui::SetRowKind::Button, A_ChatDelete, "Delete channel", "", false, true);
      } else if (g_chatCount > 0 && g_chats[g_setChat].dm) {
        setAdd(om::ui::SetRowKind::Note, A_None, "Direct message settings are not built yet.");
      } else {
        setAdd(om::ui::SetRowKind::Note, A_None, "No chat is open.");
      }
      setSection("CHAT");
      setAdd(om::ui::SetRowKind::Chevron, A_ChatMsgSound, "Message sound",
             om::sounds::choiceName(SoundEvent::Message, om::sounds::choice(SoundEvent::Message)));
      setAdd(om::ui::SetRowKind::Chevron, A_ChatDmSound, "Direct message sound",
             om::sounds::choiceName(SoundEvent::Dm, om::sounds::choice(SoundEvent::Dm)));
      setAdd(om::ui::SetRowKind::Chevron, A_ChatMenSound, "Mention sound",
             om::sounds::choiceName(SoundEvent::Mention, om::sounds::choice(SoundEvent::Mention)));
      break;
    }

    case SetPage::MapRoot: {
      setSection("MAP");
      setAdd(om::ui::SetRowKind::Value, A_None, "Tile source", g_sdOk ? "SD card" : "no card");
      setAdd(om::ui::SetRowKind::Button, A_MapRecentre, "Recentre on Ljubljana");
      setAdd(om::ui::SetRowKind::Button, A_MapClear, "Clear marker");
      setAdd(om::ui::SetRowKind::Note, A_None,
             "Follow my position and node names are not built yet.");
      break;
    }

    case SetPage::RptrRoot: {
      setSection("REPEATER");
      // EST-410: the open session's repeater name, now owned by screens/rptr_tab.cpp.
      const char* openRptr = om::rptr_tab::openNodeName();
      // EST-414 (Filip's glass test): while a session is open the row is a Chevron that jumps to the
      // RPTR tab, which still holds that session's page (the same view as after login). With nothing
      // open it stays a plain read-only value: no action, no '>', so a tap does nothing.
      if (openRptr[0]) {
        setAdd(om::ui::SetRowKind::Chevron, A_RptrOpen, "Open repeater", openRptr);
      } else {
        setAdd(om::ui::SetRowKind::Value, A_None, "Open repeater", "none");
      }
      // EST-358: the switch the ticket asks for, on the Settings RPTR tab.
      setAdd(om::ui::SetRowKind::Toggle, A_RptrAuto, "Auto-login", "ON", om::rptrAutoLogin());
      const int remembered = om::rptrRememberedCount();
      if (remembered > 0) {
        for (int i = 0; i < remembered && i < 4; ++i) {
          setAdd(om::ui::SetRowKind::Value, A_None, "Remembered", om::rptrRememberedName(i));
        }
        setAdd(om::ui::SetRowKind::Note, A_None,
               "The password is stored for each repeater and never shown.");
      } else {
        setAdd(om::ui::SetRowKind::Note, A_None,
               "Log in once and the password is remembered for that repeater.");
      }
      if (openRptr[0] || remembered > 0) {
        setAdd(om::ui::SetRowKind::Button, A_RptrForget, "Forget repeater");
      }
      break;
    }

    case SetPage::Preset: {
      char v[40];
      snprintf(g_setTitle, sizeof(g_setTitle), "Region / preset");
      setSection("PRESETS");
      const int cur = om::ui::radioPresetIndex(g_radio.prefs());
      for (int i = 0; i < om::ui::kRadioPresetCount; ++i) {
        presetDesc(i, v, sizeof(v));
        setAdd(om::ui::SetRowKind::Check, (uint16_t)(A_PresetBase + i),
               om::ui::radioPresetAt(i).name, v, cur == i);
      }
      setAdd(om::ui::SetRowKind::Chevron, A_CustomOpen, "Custom",
             "enter frequency and modulation");
      setAdd(om::ui::SetRowKind::Warn, A_None,
             "A node with the wrong preset is deaf: it hears nothing and reports no error. "
             "Presets are suggestions from the mesh config, not firmware defaults.");
      break;
    }

    case SetPage::PresetCustom: {
      char v[24], f[16], b[16];
      snprintf(g_setTitle, sizeof(g_setTitle), "Custom preset");
      om::ui::radioFreqText(g_custom, f, sizeof(f));
      snprintf(v, sizeof(v), "%s MHz", f);
      setAdd(om::ui::SetRowKind::Stepper, A_CustomFreq, "Frequency", v);
      om::ui::radioBwText(g_custom, b, sizeof(b));
      snprintf(v, sizeof(v), "%s kHz", b);
      setAdd(om::ui::SetRowKind::Stepper, A_CustomBw, "Bandwidth", v);
      snprintf(v, sizeof(v), "SF%u", (unsigned)g_custom.sf);
      setAdd(om::ui::SetRowKind::Stepper, A_CustomSf, "Spreading", v);
      snprintf(v, sizeof(v), "CR%u", (unsigned)g_custom.cr);
      setAdd(om::ui::SetRowKind::Stepper, A_CustomCr, "Coding", v);
      setAdd(om::ui::SetRowKind::Warn, A_None,
             "A node with the wrong preset is deaf: it hears nothing and reports no error.");
      // EST-363: the page's Apply is in the title row, not a row at the bottom of a page that scrolls.
      g_setActionLabel = "Apply";
      g_setActionId = A_CustomApply;
      g_setActionOn = true;
      break;
    }

    // EST-405: the screen auto-off time. Five Check rows, the chosen one dotted, straight from
    // om::kIdleTimes so the labels, the milliseconds the timer uses and the row order cannot drift.
    // The page is reached only while the switch is on (General hides its row when it is off).
    case SetPage::AutoOff: {
      snprintf(g_setTitle, sizeof(g_setTitle), "Screen auto-off");
      setSection("TURN THE SCREEN OFF AFTER");
      for (int i = 0; i < om::kIdleTimeCount; ++i) {
        setAdd(om::ui::SetRowKind::Check, (uint16_t)(A_IdleTimeBase + i), om::kIdleTimes[i].label,
               "", g_idle.timeIndex() == i);
      }
      // Two notes, measured to fit the body's 306 px at 11 px (the ellipsis would otherwise cut the
      // second one at its most important word, the OTA upload).
      setAdd(om::ui::SetRowKind::Note, A_None, "Touch, wake or a USB command restarts it.");
      setAdd(om::ui::SetRowKind::Note, A_None,
             "Never during typing, a pop-up, OTA or a map drag.");
      break;
    }

    case SetPage::Hash: {
      snprintf(g_setTitle, sizeof(g_setTitle), "Path hash");
      setSection("PATH HASH");
      const uint8_t cur = om::meshPathHashBytes();
      setAdd(om::ui::SetRowKind::Check, (uint16_t)(A_HashBase + 0), "1B", "256 ids, 64 hops",
             cur == 1);
      setAdd(om::ui::SetRowKind::Check, (uint16_t)(A_HashBase + 1), "2B", "65,536 ids, 32 hops",
             cur == 2);
      setAdd(om::ui::SetRowKind::Check, (uint16_t)(A_HashBase + 2), "3B", "16,777,216 ids, 21 hops",
             cur == 3);
      setAdd(om::ui::SetRowKind::Warn, A_None,
             "SLO runs 2B and it is enforced. Keep 2B unless the mesh changes: 1B still works but "
             "diverges from everyone else, and 3B cuts the max path to 21 hops.");
      break;
    }

    case SetPage::Node: {
      char key[16];
      snprintf(g_setTitle, sizeof(g_setTitle), "Node");
      setSection("IDENTITY");
      setAdd(om::ui::SetRowKind::Chevron, A_NodeName, "Name", om::meshNodeName());
      key[0] = 0;
      om::meshPubKeyShort(key, sizeof(key));
      setAdd(om::ui::SetRowKind::Value, A_None, "Public key", key);
      // EST-392: EST-384's second POSITION section and its source row are GONE from this page. The
      // source is chosen in ONE place, Settings > General > Position. Share position is a different
      // switch (what the advert carries) and stays where it was before EST-384, under IDENTITY.
      setAdd(om::ui::SetRowKind::Toggle, A_AdvertPos, "Share position", "ON",
             om::meshAdvertPosPolicyGet());
      break;
    }

    case SetPage::NameEdit: {
      snprintf(g_setTitle, sizeof(g_setTitle), s_setNameNode ? "Node name" : "Channel name");
      g_setEditor = om::ui::SettingsEditor::Letters;
      snprintf(g_setEditText, sizeof(g_setEditText), "%s", g_editBuf);
      break;
    }

    case SetPage::Channels: {
      snprintf(g_setTitle, sizeof(g_setTitle), "Channels");
      setSection("CHANNELS");
      for (int i = 0; i < om::mcChannelCount(); ++i) {
        char v[32];
        if (!om::mcChannelEnabled(i)) snprintf(v, sizeof(v), "OFF");
        else if (om::mcChannelMuted(i)) snprintf(v, sizeof(v), "muted");
        else snprintf(v, sizeof(v), "ON");
        // EST-414: no unread count here any more ("+2"). Unread belongs to the Chat tab (its own
        // badge and its per-chat dot/count); a channel row here says only ON / muted / OFF.
        setAdd(om::ui::SetRowKind::Chevron, (uint16_t)(A_ChanBase + i), om::mcChannelName(i), v);
      }
      if (om::mcChannelCount() < om::kMaxChannels) {
        setAdd(om::ui::SetRowKind::Button, A_ChanAdd, "+ Add channel");
      }
      setAdd(om::ui::SetRowKind::Note, A_None, "Tap a channel to manage it.");
      break;
    }

    case SetPage::Channel: {
      if (g_chanPage < 0 || g_chanPage >= om::mcChannelCount()) {
        setBack();                  // the channel went away: back to the list that opened it
        buildSettingsRows();
        return;
      }
      char title[48];
      snprintf(title, sizeof(title), "Channel: %s", om::mcChannelName(g_chanPage));
      snprintf(g_setTitle, sizeof(g_setTitle), "%s", title);
      char key[40];
      om::mcChannelKeyB64(g_chanPage, key, sizeof(key));
      setSection("CHANNEL");
      setAdd(om::ui::SetRowKind::Chevron, A_ChanRename, "Name", om::mcChannelName(g_chanPage));
      setAdd(om::ui::SetRowKind::Toggle, A_ChanEnabled, "Enabled", "ON",
             om::mcChannelEnabled(g_chanPage));
      setAdd(om::ui::SetRowKind::Toggle, A_ChanSound, "Sound", "ON",
             !om::mcChannelMuted(g_chanPage));
      setAdd(om::ui::SetRowKind::Value, A_None, "Unread",
             om::meshUnread(g_chanPage) ? "new, clear below" : "none");
      setAdd(om::ui::SetRowKind::Button, A_ChanClear, "Clear messages");
      setAdd(om::ui::SetRowKind::Value, A_None, "Key", key);
      // EST-422: the same shared confirm sheet as every other delete.
      setAdd(om::ui::SetRowKind::Button, A_ChanDelete, "Delete channel", "", false, true);
      break;
    }

    case SetPage::ChanAdd: {
      snprintf(g_setTitle, sizeof(g_setTitle), "Add channel");
      setSection("ADD CHANNEL");
      setAdd(om::ui::SetRowKind::Button, A_AddCreate, "Create private");
      setAdd(om::ui::SetRowKind::Button, A_AddPrivate, "Join private");
      setAdd(om::ui::SetRowKind::Button, A_AddPublic, "Join Public");
      setAdd(om::ui::SetRowKind::Button, A_AddHashtag, "Join #tag");
      setAdd(om::ui::SetRowKind::Note, A_None, "A #tag or Public key is derived from the name.");
      break;
    }

    case SetPage::ChanKey: {
      snprintf(g_setTitle, sizeof(g_setTitle), "Channel key");
      g_setEditor = om::ui::SettingsEditor::Base64;
      g_setOkLabel = "Join";
      snprintf(g_setEditText, sizeof(g_setEditText), "%s", g_keyText);
      break;
    }

    case SetPage::Sound: {
      char v[24];
      snprintf(g_setTitle, sizeof(g_setTitle), "Sound");
      setSection("SOUND");
      setAdd(om::ui::SetRowKind::Toggle, A_SoundMaster, "Master sound", "ON", om::sounds::masterOn());
      snprintf(v, sizeof(v), "%u%%", (unsigned)om::sounds::volume());
      setAdd(om::ui::SetRowKind::Stepper, A_SoundVolume, "Volume", v);
      // EST-361: one row per event, each showing the shared-library sound it uses (or Off).
      setAdd(om::ui::SetRowKind::Chevron, A_SoundBoot, "Boot",
             om::sounds::choiceName(SoundEvent::Boot, om::sounds::choice(SoundEvent::Boot)));
      setAdd(om::ui::SetRowKind::Chevron, A_SoundMsg, "Message",
             om::sounds::choiceName(SoundEvent::Message, om::sounds::choice(SoundEvent::Message)));
      setAdd(om::ui::SetRowKind::Chevron, A_SoundDm, "Direct message",
             om::sounds::choiceName(SoundEvent::Dm, om::sounds::choice(SoundEvent::Dm)));
      setAdd(om::ui::SetRowKind::Chevron, A_SoundMen, "Mention",
             om::sounds::choiceName(SoundEvent::Mention, om::sounds::choice(SoundEvent::Mention)));
      setAdd(om::ui::SetRowKind::Chevron, A_SoundSent, "Sent",
             om::sounds::choiceName(SoundEvent::Sent, om::sounds::choice(SoundEvent::Sent)));
      setAdd(om::ui::SetRowKind::Chevron, A_SoundError, "Error",
             om::sounds::choiceName(SoundEvent::Error, om::sounds::choice(SoundEvent::Error)));
      setAdd(om::ui::SetRowKind::Chevron, A_SoundNew, "New node",
             om::sounds::choiceName(SoundEvent::NewNode, om::sounds::choice(SoundEvent::NewNode)));
      setAdd(om::ui::SetRowKind::Chevron, A_SoundBatt, "Low battery",
             om::sounds::choiceName(SoundEvent::LowBattery, om::sounds::choice(SoundEvent::LowBattery)));
      // EST-390: the ticket's name for it; the stored key and the OFF default are EST-359's.
      setAdd(om::ui::SetRowKind::Toggle, A_SoundTouch, "Touch sound", "ON",
             om::sounds::touchClicks());
      setAdd(om::ui::SetRowKind::Chevron, A_SoundClick, "Click tone",
             om::sounds::choiceName(SoundEvent::Touch, om::sounds::choice(SoundEvent::Touch)));
      setAdd(om::ui::SetRowKind::Toggle, A_SoundDnd, "Do not disturb", "ON", om::sounds::dnd());
      setAdd(om::ui::SetRowKind::Toggle, A_SoundWelcome, "Welcome sound", "ON", om::sounds::welcome());
      break;
    }

    case SetPage::SoundPicker: {
      const SoundEvent ev = (SoundEvent)g_setSoundEvent;
      const int count = om::sound::libraryCount();
      snprintf(g_setTitle, sizeof(g_setTitle), "%s sound", om::sound::eventLabel(ev));
      // EST-363 (Filip): "Use" lives in the title row, always on the glass, so a sound picked 40 rows
      // down can be saved without scrolling back up. It is dim until the candidate differs from the
      // event's stored sound (nothing new picked = nothing to save).
      g_setActionLabel = "Use";
      g_setActionId = A_SoundPickUse;
      g_setActionOn = om::ui::settingsActionEnabled(g_setSoundPending, (int)om::sounds::choice(ev));
      // EST-369: the whole shared library, grouped by SHAPE (Solo, Duo, Trio, Multi, Alert); the voice
      // starts each name. A sound another event already uses carries its short tag(s) in the dim
      // value; it stays selectable (double duty is allowed). The action id is the row's index in the
      // library, because the sound ids themselves start at 54 (0..53 are the retired EST-361 ids).
      char tags[om::ui::kSetValueCap];
      for (int s = 0; s < om::sound::kShapeCount; ++s) {
        const om::sound::Shape shape = (om::sound::Shape)s;
        bool any = false;
        for (int i = 0; i < count; ++i) {
          if (om::sound::soundShape(om::sound::libraryId(i)) == shape) {
            any = true;
            break;
          }
        }
        if (!any) continue;
        setSection(om::sound::shapeName(shape));
        for (int i = 0; i < count; ++i) {
          const uint8_t id = om::sound::libraryId(i);
          if (om::sound::soundShape(id) != shape) continue;
          om::sounds::useTags(ev, id, tags, sizeof(tags));
          setAdd(om::ui::SetRowKind::Check, (uint16_t)(A_PickBase + i), om::sound::soundName(id),
                 tags, g_setSoundPending == (int)id);
        }
      }
      setAdd(om::ui::SetRowKind::Check, (uint16_t)(A_PickBase + count), "Off", "",
             g_setSoundPending == (int)om::sound::kSoundOff);
      setAdd(om::ui::SetRowKind::Note, A_None, "Tap a sound to hear it, then Use.");
      break;
    }

    case SetPage::Wifi: {
      char v[48];
      snprintf(g_setTitle, sizeof(g_setTitle), "Wi-Fi");
      const om::wifi::Status& wst = om::wifiStatus();
      setSection("WI-FI");
      setAdd(om::ui::SetRowKind::Toggle, A_WifiToggle, "Wi-Fi", "ON", om::wifiIsEnabled());
      om::wifi::stateLine(wst, v, sizeof(v));
      setAdd(om::ui::SetRowKind::Value, A_None, "State", v);
      if (wst.phase == om::wifi::Phase::Connecting || wst.phase == om::wifi::Phase::Connected) {
        setAdd(om::ui::SetRowKind::Value, A_None, "Network", wst.ssid);
      }
      if (wst.phase == om::wifi::Phase::Connected) {
        setAdd(om::ui::SetRowKind::Value, A_None, "IP", wst.ip);
        snprintf(v, sizeof(v), "%d dBm", (int)wst.rssi);
        setAdd(om::ui::SetRowKind::Value, A_None, "Signal", v);
      }
      if (om::wifiIsEnabled()) {
        const bool scanning = om::wifiIsScanning();
        snprintf(v, sizeof(v), "%s", scanning ? "scanning" : "");
        setAdd(om::ui::SetRowKind::Chevron, A_WifiScan, "Scan networks", v);
        const int found = om::wifiScanCount();
        if (found > 0) {
          setSection("NETWORKS");
          const int shown = found < 8 ? found : 8;
          for (int i = 0; i < shown; ++i) {
            const om::wifi::ScanResult* n = om::wifiScanAt(i);
            if (n == nullptr) continue;
            snprintf(v, sizeof(v), "%d dBm", (int)n->rssi);
            setAdd(om::ui::SetRowKind::Chevron, (uint16_t)(A_WifiNetBase + i), n->ssid, v,
                   n->secured);
          }
          if (found > shown) {
            snprintf(v, sizeof(v), "%d more, strongest first", found - shown);
            setAdd(om::ui::SetRowKind::Note, A_None, v);
          }
        } else {
          setAdd(om::ui::SetRowKind::Note, A_None,
                 scanning ? "Scanning, this takes a few seconds."
                          : "Tap Scan networks to look around.");
        }
        setSection("SAVED");
        snprintf(v, sizeof(v), "%d of %d", om::wifiSavedCount(), om::wifi::kMaxSaved);
        setAdd(om::ui::SetRowKind::Chevron, A_WifiSaved, "Saved networks", v);
      } else {
        setAdd(om::ui::SetRowKind::Note, A_None, "Turn Wi-Fi on to scan for networks.");
      }
      break;
    }

    case SetPage::WifiSaved: {
      char v[24];
      snprintf(g_setTitle, sizeof(g_setTitle), "Saved networks");
      setSection("SAVED");
      if (om::wifiSavedCount() == 0) {
        setAdd(om::ui::SetRowKind::Note, A_None,
               "No saved networks yet. Connect once and it is saved here.");
      } else {
        for (int i = 0; i < om::wifiSavedCount(); ++i) {
          const om::wifi::SavedNetwork* n = om::wifiSavedAt(i);
          if (n == nullptr) continue;
          setAdd(om::ui::SetRowKind::Value, A_None, n->ssid, "saved");
          // EST-422: Forget asks in the shared sheet, like every other delete, instead of a second tap.
          setAdd(om::ui::SetRowKind::Button, (uint16_t)(A_WifiForgetBase + i), "Forget", "", false,
                 true);
        }
        snprintf(v, sizeof(v), "%d of %d", om::wifiSavedCount(), om::wifi::kMaxSaved);
        setAdd(om::ui::SetRowKind::Note, A_None, v);
      }
      break;
    }

    case SetPage::WifiPass: {
      snprintf(g_setTitle, sizeof(g_setTitle), "Wi-Fi: %s", g_wifiPassSsid);
      g_setEditor = om::ui::SettingsEditor::WifiPass;
      g_setOkLabel = "Connect";
      snprintf(g_setEditText, sizeof(g_setEditText), "%s", g_editBuf);
      break;
    }
    case SetPage::Bt: {
      char pin[8];
      snprintf(g_setTitle, sizeof(g_setTitle), "Bluetooth");
      setSection("BLUETOOTH");
      setAdd(om::ui::SetRowKind::Toggle, A_BtToggle, "Bluetooth", "ON", om::bleIsEnabled());
      setAdd(om::ui::SetRowKind::Value, A_None, "State", om::ble::phaseToken(om::blePhase()));
      if (om::blePin() != 0) {
        om::blePinText(pin, sizeof(pin));
        setAdd(om::ui::SetRowKind::Value, A_None, "PIN", pin);
      } else {
        setAdd(om::ui::SetRowKind::Value, A_None, "PIN", "made when switched on");
      }
      setAdd(om::ui::SetRowKind::Button, A_BtNewPin, "New PIN");
      if (om::bleConnected()) {
        setAdd(om::ui::SetRowKind::Note, A_None,
               "Phone connected. Changes made there are saved here.");
      } else if (om::bleIsEnabled()) {
        setAdd(om::ui::SetRowKind::Note, A_None,
               "Advertising. Pair from the MeshCore app with the PIN above.");
      } else {
        setAdd(om::ui::SetRowKind::Note, A_None,
               "Off. The phone app uses this node as a MeshCore companion.");
      }
      break;
    }

    case SetPage::Time: {
      char now[8], src[40];
      snprintf(g_setTitle, sizeof(g_setTitle), "Time");
      clockLine(now, sizeof(now));
      timeSourceLine(src, sizeof(src));
      setSection("CLOCK");
      setAdd(om::ui::SetRowKind::Value, A_None, "Now", now);
      setAdd(om::ui::SetRowKind::Value, A_None, "Source", src);
      setAdd(om::ui::SetRowKind::Chevron, A_TimeManual, "Set manually");
      setAdd(om::ui::SetRowKind::Note, A_None, "GPS first, then Wi-Fi, phone, then by hand.");
      break;
    }

    case SetPage::TimeEdit: {
      snprintf(g_setTitle, sizeof(g_setTitle), "Set time");
      setSection("DATE AND TIME");
      for (int i = 0; i < (int)om::ui::TimeField::Count; ++i) {
        const char* labels[5] = {"Year", "Month", "Day", "Hour", "Minute"};
        char v[12];
        timeFieldText((om::ui::TimeField)i, v, sizeof(v));
        setAdd(om::ui::SetRowKind::Stepper, (uint16_t)(A_TimeFieldBase + i), labels[i], v);
      }
      // EST-400: the stepper now walks exactly the clock's real years (kMinSaneYear..kMaxSaneYear,
      // derived from kMinSaneEpoch/kMaxSaneEpoch), so the Note says the same bound instead of a
      // second, unrelated sentence.
      setAdd(om::ui::SetRowKind::Note, A_None,
             "2025 to 2038. The next GPS fix takes over.");
      // EST-363: same rule as the sound picker: the commit action lives in the title row, because with
      // five steppers above it the old bottom row needed a scroll on the 188 px body.
      g_setActionLabel = "Set";
      g_setActionId = A_TimeApply;
      g_setActionOn = true;
      break;
    }

    // EST-422: ConfirmPreset and ConfirmHash are gone. A preset, a custom preset and a path hash are
    // confirmed in the shared sheet on the page they are chosen, so there is ONE confirmation pattern
    // for the whole app instead of a page, a sheet and a "tap again" arm.
  }
}

static om::ui::SettingsView settingsView() {
  om::ui::SettingsView v;
  buildStatus(v.status);
  v.tab = g_setTab;
  v.title = g_setTitle;
  v.subPage = g_setSubPage;
  v.rows = g_setRows;
  v.rowCount = g_setRowCount;
  v.scroll = g_setScroll;
  // EST-363: the page's commit action in the title row (dim when there is nothing to commit).
  v.titleAction = g_setActionLabel;
  v.titleActionOn = g_setActionOn;
  v.editor = g_setEditor;
  v.editText = g_setEditText;
  v.okLabel = g_setOkLabel;
  v.editNums = g_setEditNums;
  v.editShift = g_setEditShift;
  v.editReveal = g_setEditReveal;
  v.accentRow = g_setAccentPreview ? g_setAccentRow : -1;
  v.accentCol = g_setAccentPreview ? g_setAccentCol : -1;
  v.accentCp = g_setAccentPreview ? g_setAccentCp : 0;
  // EST-350: the chat selector. `selected` is g_setChat, not g_chatSel: what this page edits.
  v.selector = g_setSelOpen;
  v.sel.chats = g_chats;
  v.sel.chatCount = g_chatCount;
  v.sel.channelCount = g_channelCount;
  v.sel.dmCount = g_chatCount - g_channelCount;
  v.sel.selected = g_setChat;
  v.sel.scroll = g_setSelScroll;
  v.sel.nowSec = millis() / 1000;
  v.sel.nowWall = om::timeKeeper().now();
  v.sel.nowReal = om::timeKeeper().realSinceBoot();
  // EST-422: the ONE confirm sheet ("Clear messages", a preset, a delete, a switch) owns every tap
  // while it is open, over the rows, the tab row and Back.
  v.ask = g_ask.open;
  v.askText = g_ask.text;
  v.askApply = om::ui::confirmApplyLabel(g_ask.kind);
  v.askDanger = om::ui::confirmIsDangerous(g_ask.kind);
  // EST-392: the General page's Position choice, hung under the row the last build recorded.
  v.posChoice = g_posChoice && g_setPage == SetPage::GeneralRoot;
  v.posChoiceRow = g_posRowIndex;
  v.posFixed = om::posSource().sourceFixed();
  return v;
}

// --- the editor's shared sheet (EST-352) --------------------------------------------------------
// One place that knows which field is open and which buffer it edits. The character filter and the
// byte limit come from ui/chat_layout.h, the same rules the host test checks.
static om::ui::KeyboardField settingsEditField() {
  return om::ui::settingsEditorField(g_setEditor);
}

static char* settingsEditBuf() { return g_setPage == SetPage::ChanKey ? g_keyText : g_editBuf; }

static bool settingsEditAppendBytes(const char* bytes, int n) {
  if (bytes == nullptr || n <= 0) return false;
  char* buf = settingsEditBuf();
  const size_t cap = g_setPage == SetPage::ChanKey ? sizeof(g_keyText) : sizeof(g_editBuf);
  const int used = (int)strlen(buf);
  if (!om::ui::keyboardAcceptsBytes(settingsEditField(), used, n)) return false;
  if ((size_t)used + (size_t)n >= cap) return false;
  memcpy(buf + used, bytes, (size_t)n);
  buf[used + n] = 0;
  return true;
}

static bool settingsEditAppendChar(char ch) {
  if (!om::ui::keyboardAllowsChar(settingsEditField(), ch)) return false;
  return settingsEditAppendBytes(&ch, 1);
}

// The release of a held s/c/z: two UTF-8 bytes through the same byte budget as any other key.
static bool settingsEditAppendAccent() {
  if (g_setAccentCp == 0) return false;
  char bytes[4] = {0};
  const int n = om::ui::utf8Encode(g_setAccentCp, bytes);
  if (n <= 0) return false;
  return settingsEditAppendBytes(bytes, n);
}

static void redrawMainTab() {
  if (g_tab == 0) om::nodes_tab::draw();
  else if (g_tab == 1) drawChat();
  else if (g_tab == 2) om::map_tab::draw();
  else om::rptr_tab::draw();
}

static void drawSettings() {
  // EST-384: the own-position map picker is its own full frame (the RPTR picker is drawn the same
  // way), so no row build happens while it is up.
  if (g_ownPick) {
    drawOwnPick();
    return;
  }
  buildSettingsRows();
  const om::ui::SettingsLayout L =
      om::ui::settingsLayoutFor(om::ui::kScreenW, om::ui::kScreenH, g_setSubPage, g_setSelOpen);
  g_setMaxScroll = om::ui::settingsMaxScroll(L, g_setRows, g_setRowCount);
  // The dropdown's clamp is the Chat tab's own: same list, same content height (the shared clamp).
  om::ui::SelectorModel sel;
  sel.chatCount = g_chatCount;
  sel.channelCount = g_channelCount;
  sel.dmCount = g_chatCount - g_channelCount;
  g_setSelMaxScroll = g_setSelOpen ? om::ui::selectorMaxScroll(sel, L.selList) : 0;
  if (g_setSelScroll > g_setSelMaxScroll) g_setSelScroll = g_setSelMaxScroll;
  if (g_setSelScroll < 0) g_setSelScroll = 0;
  const om::ui::SettingsView v = settingsView();
  om::ui::settingsScreenDraw(v);
}

static void openSettings(int mainTab, om::ui::SettingsTab tab) {
  (void)mainTab;
  g_settings = true;
  g_setTab = tab;
  g_setPage = setRootForTab(tab);
  g_setScroll = 0;
  g_setNav.reset();                 // a fresh door into Settings has no history behind it
  g_setEditor = om::ui::SettingsEditor::None;
  g_ask.close();   // EST-422: the confirm sheet never survives a page change
  g_setSelOpen = false;
  g_setSelScroll = 0;
  g_ownPick = false;      // EST-384: a fresh door into Settings never opens on the picker
  g_posChoice = false;    // EST-392: and it never opens with the Position choice down
  g_advertMenu = false;   // EST-382: leaving the Chat page closes its advert dropdown
  // EST-350: the settings page starts on the chat that was open when the gear was pressed.
  g_setChat = g_chatSel;
  if (tab == om::ui::SettingsTab::Chat) refreshChats();
  buildSettingsRows();
  drawSettings();
}

// EST-414: the ONE place that clears Settings' transient state when Settings is left, whether by Back
// from a root page or by a row that jumps to another tab (Settings > RPTR > Open repeater). It does
// not draw: the caller decides between redrawing the tab already on the glass and a screen change.
static void settingsLeaveState() {
  g_settings = false;
  g_setEditor = om::ui::SettingsEditor::None;
  g_ask.close();   // EST-422: the confirm sheet never survives a page change
  g_setSelOpen = false;
  g_posChoice = false;   // EST-392
}

static void settingsBack() {
  // EST-354: Back out of the password sheet wipes the typed secret; it is not needed after leaving.
  if (g_setPage == SetPage::WifiPass) {
    memset(g_editBuf, 0, sizeof(g_editBuf));
    g_setEditText[0] = 0;
    g_setEditReveal = false;
  }
  // EST-350: Back is one step of the history setGo() builds, so it needs no table per page: the page
  // it returns to is the one the user came from, at the scroll it was left at. An empty history means
  // this is a root page: Back leaves Settings for the screen the gear was pressed on.
  if (g_setNav.empty()) {
    settingsLeaveState();
    redrawMainTab();
    return;
  }
  setBack();
  g_setEditor = om::ui::SettingsEditor::None;
  drawSettings();
}

static void openChannelPage(int idx) {
  if (idx < 0 || idx >= om::mcChannelCount()) return;
  g_chanPage = idx;
  setGo(SetPage::Channel);
  drawSettings();
}

static void settingsEditorOk();

// --- EST-384: Settings' own-position picker (the SAME picker as the RPTR Position page) ----------
// The candidate is a draft: Save commits it as the Fixed position, Cancel changes nothing, so a
// program that was on GPS stays on GPS.
static void ownPickCentreToDraft() {
  double lat = 0.0;
  double lon = 0.0;
  om::mapScreenToLatLon(om::ui::kMapCentreX, om::ui::kMapCentreY, lat, lon);
  g_ownPickLatE6 = (int32_t)lround(lat * 1e6);
  g_ownPickLonE6 = (int32_t)lround(lon * 1e6);
}

static void ownPickOpen(bool onSavedPoint) {
  double lat = 46.0569;   // the map pack's own centre: no saved point and no fix
  double lon = 14.5058;
  if (onSavedPoint && om::posSource().fixedSet()) {
    lat = om::posSource().fixedLat();
    lon = om::posSource().fixedLon();
  } else if (g_gps.valid) {
    lat = g_gps.lat;      // the ticket: start at the current GPS fix when there is one
    lon = g_gps.lon;
  }
  g_ownPickLatE6 = (int32_t)lround(lat * 1e6);
  g_ownPickLonE6 = (int32_t)lround(lon * 1e6);
  g_ownPickZoom = 15;
  om::mapSetView(lat, lon, g_ownPickZoom);
  g_ownPickDragging = false;
  g_ownPick = true;
  drawSettings();
}

static void ownPickCancel() {
  g_ownPick = false;
  drawSettings();
}

static void ownPickSave() {
  // EST-422: the Position mode is a setting that matters, so Save asks in the shared sheet. The point
  // stays in g_ownPickLatE6/g_ownPickLonE6 until Apply; Cancel changes the source to nothing (the map
  // picker closes, the Position page is back) and writes no position.
  g_ownPick = false;
  g_ask.begin(om::ui::ConfirmKind::Position, 1, "a fixed point");
  drawSettings();
}

static void ownPickTap(int x, int y) {
  const om::ui::RptrMapPickLayout m = om::ui::rptrMapPickLayoutFor(om::ui::l2(), true);
  switch (om::ui::rptrMapPickHitAt(m, x, y)) {
    case om::ui::RptrMapPickHit::Back:
      ownPickCancel();
      return;
    case om::ui::RptrMapPickHit::ZoomIn:
      om::mapZoomBy(1);
      g_ownPickZoom = om::mapZoom();
      drawSettings();
      return;
    case om::ui::RptrMapPickHit::ZoomOut:
      om::mapZoomBy(-1);
      g_ownPickZoom = om::mapZoom();
      drawSettings();
      return;
    case om::ui::RptrMapPickHit::UseGps:
      if (!g_gps.valid) {
        showToast("No GPS fix yet");
        return;
      }
      om::mapSetView(g_gps.lat, g_gps.lon, g_ownPickZoom);
      g_ownPickLatE6 = (int32_t)lround(g_gps.lat * 1e6);
      g_ownPickLonE6 = (int32_t)lround(g_gps.lon * 1e6);
      drawSettings();
      return;
    case om::ui::RptrMapPickHit::Apply:
      ownPickSave();
      return;
    case om::ui::RptrMapPickHit::Map:
      ownPickCentreToDraft();
      drawSettings();
      return;
    default:
      return;   // the panel/back are over the map; nothing else is a map tap
  }
}

static void drawOwnPick() {
  char lat[20];
  char lon[20];
  // EST-410: the coordinate text helper now lives with the RPTR tab that owns it.
  om::rptr_tab::coordText(lat, sizeof(lat), g_ownPickLatE6);
  om::rptr_tab::coordText(lon, sizeof(lon), g_ownPickLonE6);
  om::ui::MapPickView v;
  snprintf(v.coords, sizeof(v.coords), "%s, %s", lat, lon);
  snprintf(v.hint, sizeof(v.hint), "z%d", g_ownPickZoom);
  v.gps = g_gps.valid;
  v.action = true;
  v.actionLabel = "Save";
  v.backLabel = "Cancel";
  om::ui::StatusModel st;
  buildStatus(st);
  om::ui::drawMapPickScreen(v, st);
}

static void openSoundPicker(SoundEvent ev) {
  g_setSoundEvent = (int)ev;
  g_setSoundPending = (int)om::sounds::choice(ev);
  setGo(SetPage::SoundPicker);
  drawSettings();
}

// EST-422: the ONE door into the confirm sheet. It never changes a value: it puts the question on the
// glass with the change's kind, its payload and the value the question quotes, and closes whatever
// dropdown or choice was open under it (so a tap on the sheet cannot fall through to them). The
// caller's own drawSettings() paints the sheet; Apply runs settingsApplyConfirmed().
static void askChange(om::ui::ConfirmKind kind, int arg, const char* value) {
  if (!g_ask.begin(kind, arg, value)) return;
  g_setSelOpen = false;
  g_posChoice = false;
  Serial.printf("[set] confirm: kind %d\n", (int)kind);
}

// One row's action. The id is the only thing the shell needs to know about a row.
static void handleSettingsRow(uint16_t id) {
  if (g_setTab == om::ui::SettingsTab::Chat) refreshChats();
  const int ch = settingsChatChannel();
  switch (id) {
    case A_Preset:   setGo(SetPage::Preset); break;
    case A_Hash:     setGo(SetPage::Hash); break;
    // EST-350: the General row named "Node" opens the Node page (Name, Public key, Share position);
    // the rename is the Node page's own "Name" row (A_NodeName), which is what used to be here.
    case A_Node:     setGo(SetPage::Node); break;
    // EST-392: the ONE position source control. It is not a page: it opens the small GPS / Fixed
    // choice under the row, lifted just enough for the whole panel to be on the glass.
    case A_PosSource:
      g_posChoice = true;
      g_setSelOpen = false;
      g_setScroll = om::ui::settingsChoiceScrollFor(
          om::ui::settingsLayoutFor(om::ui::kScreenW, om::ui::kScreenH, g_setSubPage), g_setRows,
          g_setRowCount, g_posRowIndex, g_setScroll);
      break;
    case A_NodeName:
      snprintf(g_editBuf, sizeof(g_editBuf), "%s", om::meshNodeName());
      s_setNameNode = true;
      g_editNew = false;
      setGo(SetPage::NameEdit);
      break;
    // EST-350: the "THIS CHAT" header opens the chat selector (setGo would close it, so it is not
    // used here: the page does not change). Opening it puts the page back at the top, so the header
    // row is exactly where the dropdown hangs from.
    case A_ChatPick:
      g_setSelOpen = !g_setSelOpen;
      g_setSelScroll = 0;
      g_setScroll = 0;
      g_ask.close();
      break;
    case A_Channels: setGo(SetPage::Channels); break;
    case A_Wifi:     setGo(SetPage::Wifi); break;
    case A_WifiToggle: {
      // EST-422: a switch that matters, so the sheet asks first. The value does not move here.
      const bool on = !om::wifiIsEnabled();
      askChange(om::ui::ConfirmKind::WifiSwitch, on ? 1 : 0, on ? "on" : "off");
      break;
    }
    case A_WifiScan:
      if (!om::wifiIsEnabled()) {
        showToast("Wi-Fi is off");
      } else {
        om::wifiStartScan();
      }
      break;
    case A_WifiSaved: setGo(SetPage::WifiSaved); break;
    case A_Bt:       setGo(SetPage::Bt); break;
    case A_BtToggle: {
      // EST-422: asks first. The old toast rule stays in the apply below.
      const bool on = !om::bleIsEnabled();
      askChange(om::ui::ConfirmKind::BtSwitch, on ? 1 : 0, on ? "on" : "off");
      break;
    }
    case A_BtNewPin: {
      const uint32_t pin = om::bleNewPin();
      showToast(pin != 0 ? "New PIN saved" : "New PIN failed");
      break;
    }
    // EST-412: the Grove keyboard switch. EST-422: it asks first, because switching it on powers the
    // Grove rail. The apply below does the work: RAM first, NVS after (a failed write is said out
    // loud but does not undo the switch). ON opens cardkb::begin()'s start window; OFF cancels a
    // window still running, closes the bus and drops the 5 V rail.
    case A_GroveKeyboard: {
      const bool on = !g_kbEnabled;
      askChange(om::ui::ConfirmKind::KeyboardSwitch, on ? 1 : 0, on ? "on" : "off");
      break;
    }
    case A_Sound:    setGo(SetPage::Sound); break;
    case A_Time:     setGo(SetPage::Time); break;
    // EST-405: the switch. Both stores move together: the saved one writes ONLY when the value
    // changes (the store's own rule), the live one restarts the count from now. Switching on leaves
    // the time at its saved value, which is 1 min on a fresh install (the ticket's default).
    case A_IdleAutoOff: {
      const bool on = !g_idle.enabled();
      const bool saved = g_idlePrefs.setEnabled(on);
      g_idle.setEnabled(on, millis());
      if (!saved) showToast("Auto-off setting not saved");
      Serial.printf("[idle] screen auto-off %s, %s\n", on ? "on" : "off", g_idle.timeLabel());
      break;
    }
    case A_IdleTime: setGo(SetPage::AutoOff); break;
    case A_TimeManual:
      timeInitFromClock();
      setGo(SetPage::TimeEdit);
      break;
    case A_AdvertPos: {
      const bool on = !om::meshAdvertPosPolicyGet();
      om::meshAdvertPosPolicySet(on);
      showToast(on ? "Position shared in adverts" : "Position not shared");
      break;
    }

    case A_MapRecentre:
      om::mapSetView(46.0569, 14.5058, 13);
      showToast("Map recentred");
      break;
    case A_MapClear:
      om::mapClearMarker();
      showToast("Marker cleared");
      break;
    case A_RptrForget: {
      // Forget the open repeater, or the last remembered one when the tab has none open. EST-422: the
      // sheet asks first and carries the name; the apply does the logging out.
      const char* openName = om::rptr_tab::openNodeName();
      const char* name = openName[0] ? openName : om::rptrLastRemembered();
      if (name != nullptr && name[0]) {
        askChange(om::ui::ConfirmKind::RepeaterForget, 0, name);
      }
      break;
    }
    case A_RptrAuto:
      om::rptrSetAutoLogin(!om::rptrAutoLogin());
      showToast(om::rptrAutoLogin() ? "Auto-login on" : "Auto-login off");
      break;
    case A_RptrOpen:
      // EST-414: leave Settings and show the RPTR tab as it stands. The tab's own state is NOT reset,
      // so the open session's page (the view login left behind) is exactly what comes back. Settings
      // clears its transient state first, through the same helper Back uses.
      settingsLeaveState();
      if (g_tab == 3) redrawMainTab();   // already the RPTR tab: repaint it in place
      else showTab(3);                   // the screen change composes and pushes it
      return;

    // Chat tab: the same channel, reached from the open chat.
    case A_ChatOpen:
      if (ch >= 0) openChannelPage(ch);
      return;
    case A_ChatEnabled:
      if (ch >= 0) {
        om::mcChannelSetEnabled(ch, !om::mcChannelEnabled(ch));
      }
      break;
    case A_ChatSound:
      if (ch >= 0) {
        om::mcChannelSetMuted(ch, !om::mcChannelMuted(ch));
      }
      break;
    case A_ChatRename:
      if (ch >= 0) {
        s_setNameNode = false;
        g_editNew = false;
        g_editCh = ch;
        snprintf(g_editBuf, sizeof(g_editBuf), "%s", om::mcChannelName(ch));
        setGo(SetPage::NameEdit);
      }
      break;
    case A_ChatDelete:
      if (ch >= 0) {
        // EST-422: the shared sheet asks; the apply removes the channel (EST-399's second tap is gone,
        // so every delete in the app asks the same way).
        askChange(om::ui::ConfirmKind::ChannelDelete, ch, om::mcChannelName(ch));
      }
      break;
    case A_ChatMsgSound: openSoundPicker(SoundEvent::Message); return;
    case A_ChatDmSound:  openSoundPicker(SoundEvent::Dm); return;
    case A_ChatMenSound: openSoundPicker(SoundEvent::Mention); return;

    case A_SoundMaster:
      om::sounds::setMasterOn(!om::sounds::masterOn());
      om::sounds::save();
      if (om::sounds::masterOn()) om::sounds::play(SoundEvent::Message, om::sounds::choice(SoundEvent::Message), true);
      break;
    case A_SoundBoot: openSoundPicker(SoundEvent::Boot); return;
    case A_SoundMsg:  openSoundPicker(SoundEvent::Message); return;
    case A_SoundDm:   openSoundPicker(SoundEvent::Dm); return;
    case A_SoundMen:  openSoundPicker(SoundEvent::Mention); return;
    case A_SoundSent: openSoundPicker(SoundEvent::Sent); return;
    case A_SoundError: openSoundPicker(SoundEvent::Error); return;
    case A_SoundNew:  openSoundPicker(SoundEvent::NewNode); return;
    case A_SoundBatt: openSoundPicker(SoundEvent::LowBattery); return;
    case A_SoundClick: openSoundPicker(SoundEvent::Touch); return;
    case A_SoundTouch:
      om::sounds::setTouchClicks(!om::sounds::touchClicks());
      om::sounds::save();
      if (om::sounds::touchClicks()) om::sounds::play(SoundEvent::Touch, om::sounds::choice(SoundEvent::Touch), true);
      break;
    case A_SoundDnd:
      om::sounds::setDnd(!om::sounds::dnd());
      om::sounds::save();
      break;
    case A_SoundWelcome:
      om::sounds::setWelcome(!om::sounds::welcome());
      om::sounds::save();
      if (om::sounds::welcome()) om::sounds::play(SoundEvent::Boot, om::sounds::choice(SoundEvent::Boot), true);
      break;

    case A_SoundPickUse: {
      const SoundEvent ev = (SoundEvent)g_setSoundEvent;
      if (g_setSoundPending != (int)om::sound::kSoundOff &&
          !om::sound::soundIsCurrent((uint8_t)g_setSoundPending)) {
        g_setSoundPending = (int)om::sound::defaultSound(ev);
      }
      om::sounds::choice(ev) = (uint8_t)g_setSoundPending;
      om::sounds::save();
      setBack();                    // the picker's opener: Sound, or the Chat page it came from
      showToast("Sound saved");
      break;
    }

    case A_ChanAdd:
      setGo(SetPage::ChanAdd);
      break;
    case A_AddCreate:
    case A_AddPrivate:
    case A_AddHashtag:
      g_addKind = id == A_AddCreate ? 1 : (id == A_AddPrivate ? 2 : 3);
      g_editNew = true;
      s_setNameNode = false;
      g_editBuf[0] = 0;
      setGo(SetPage::NameEdit);
      break;
    case A_AddPublic: {
      const int slot = om::mcChannelAdd("Public", om::mcPublicPsk());
      if (slot >= 0) {
        om::meshLinkReloadChannels();
        openChannelPage(slot);
        return;
      }
      showToast("Channel table is full");
      break;
    }

    case A_ChanRename:
      s_setNameNode = false;
      g_editNew = false;
      g_editCh = g_chanPage;
      snprintf(g_editBuf, sizeof(g_editBuf), "%s", om::mcChannelName(g_chanPage));
      setGo(SetPage::NameEdit);
      break;
    case A_ChanEnabled:
      om::mcChannelSetEnabled(g_chanPage, !om::mcChannelEnabled(g_chanPage));
      break;
    case A_ChanSound:
      om::mcChannelSetMuted(g_chanPage, !om::mcChannelMuted(g_chanPage));
      break;
    case A_ChanClear:
      // EST-382's question, now the shared sheet (EST-422). Cancel is the default side; only the
      // sheet's Clear calls meshChatClear(). The name in the question is the channel's own.
      askChange(om::ui::ConfirmKind::ClearMessages, (int)g_chanPage, om::mcChannelName(g_chanPage));
      break;
    case A_ChanDelete:
      // EST-422: the same shared sheet every delete uses. The apply removes the channel and steps back.
      askChange(om::ui::ConfirmKind::ChannelDelete, (int)g_chanPage, om::mcChannelName(g_chanPage));
      break;

    case A_CustomOpen:
      g_custom = g_radio.prefs();   // the Custom page opens on the live values
      setGo(SetPage::PresetCustom);
      break;
    case A_CustomApply:
      askChange(om::ui::ConfirmKind::Preset, om::ui::kRadioCustomPreset, "the custom values");
      break;
    case A_TimeApply:
      // EST-400: the one apply (it shows the one toast too); on success leave the page.
      if (applyManualTime()) setBack();
      break;
    case A_Apply:
      // EST-422: the preset and path-hash pages are gone (they asked through the shared sheet), so
      // these two ids have no row left that reaches them. Kept so the enum and the switch stay in
      // step with ui/settings_actions.h.
      break;
    case A_Cancel:
      break;

    default:
      if (id >= A_WifiNetBase && id < A_WifiNetBase + 8) {
        const int at = (int)(id - A_WifiNetBase);
        const om::wifi::ScanResult* n = om::wifiScanAt(at);
        if (n != nullptr) {
          const int saved = om::wifiSavedIndexFor(n->ssid);
          if (saved >= 0) {
            if (om::wifiConnectSaved(saved)) showToast("Wi-Fi: connecting");
            else showToast("Wi-Fi: not started");
          } else if (!n->secured) {
            if (om::wifiConnect(n->ssid, "")) showToast("Wi-Fi: connecting");
            else showToast("Wi-Fi: not started");
          } else {
            snprintf(g_wifiPassSsid, sizeof(g_wifiPassSsid), "%s", n->ssid);
            setGo(SetPage::WifiPass);
          }
        }
      } else if (id >= A_WifiForgetBase && id < A_WifiForgetBase + om::wifi::kMaxSaved) {
        const int at = (int)(id - A_WifiForgetBase);
        // EST-422: one shared confirm sheet per Forget row, and it names the network, so the row that
        // was tapped and the row that is asked about can never differ (EST-398 #1's failure mode).
        const om::wifi::SavedNetwork* n = om::wifiSavedAt(at);
        if (n != nullptr) askChange(om::ui::ConfirmKind::WifiForget, at, n->ssid);
      } else if (id >= A_PresetBase && id < A_PresetBase + om::ui::kRadioPresetCount) {
        // EST-422: the sheet asks "Change region to X?" on the row itself.
        const int idx = (int)(id - A_PresetBase);
        askChange(om::ui::ConfirmKind::Preset, idx, om::ui::radioPresetAt(idx).name);
      } else if (id >= A_HashBase && id < A_HashBase + 3) {
        char v[8];
        snprintf(v, sizeof(v), "%uB", (unsigned)(id - A_HashBase) + 1);
        askChange(om::ui::ConfirmKind::PathHash, (int)(id - A_HashBase) + 1, v);
      } else if (id >= A_PickBase && id < A_ChanBase) {
        const SoundEvent ev = (SoundEvent)g_setSoundEvent;
        const int count = om::sound::libraryCount();
        const int idx = (int)(id - A_PickBase);
        if (idx >= 0 && idx < count) {
          const uint8_t soundId = om::sound::libraryId(idx);
          g_setSoundPending = (int)soundId;
          om::sounds::play(ev, soundId, true);   // preview ignores DND, not master
        } else if (idx == count) {
          g_setSoundPending = (int)om::sound::kSoundOff;   // the Off row
        }
      } else if (id >= A_ChanBase && id < A_ChanBase + om::kMaxChannels) {
        openChannelPage((int)(id - A_ChanBase));
        return;
      } else if (id >= A_IdleTimeBase && id < A_IdleTimeBase + om::kIdleTimeCount) {
        // EST-405: a time choice. The store writes ONLY when the index changes; the live timer
        // restarts its count from now. The page stays open with the dot moved, like every other
        // Check list, and Back returns to General.
        const int choice = (int)(id - A_IdleTimeBase);
        const bool saved = g_idlePrefs.setTimeIndex(choice);
        g_idle.setTimeoutIndex(choice, millis());
        if (!saved) showToast("Auto-off time not saved");
        Serial.printf("[idle] auto-off after %s\n", g_idle.timeLabel());
      }
      break;
  }
  drawSettings();
}

// The +/- keys of a stepper row.
static void handleSettingsStep(uint16_t id, int dir) {
  if (dir == 0) return;
  switch (id) {
    case A_TxPower: {
      // EST-422: the stepper's +/- asks first; the row keeps showing the stored value until Apply.
      const int tx = (int)g_radio.prefs().tx + dir;
      const int next = (int)om::ui::clampTxPower(tx);
      if (next == (int)g_radio.prefs().tx) break;   // already at the end: nothing to ask
      char v[16];
      snprintf(v, sizeof(v), "%d dBm", next);
      g_ask.begin(om::ui::ConfirmKind::TxPower, next, v);
      break;
    }
    case A_SoundVolume: {
      int v = (int)om::sounds::volume() + dir * 10;
      if (v < 0) v = 0;
      if (v > 100) v = 100;
      om::sounds::setVolume((uint8_t)v);
      om::sounds::save();
      om::audioVolume(om::sounds::volume());
      break;
    }
    case A_Brightness: {
      int b = (int)g_setBrightness + dir * 20;
      if (b < 20) b = 20;
      if (b > 255) b = 255;
      g_setBrightness = (uint8_t)b;
      om::boardSetBrightness(g_setBrightness);
      g_prefs.putUChar("bright", g_setBrightness);
      break;
    }
    case A_CustomFreq: {
      int64_t f = (int64_t)g_custom.freqKhz + (int64_t)dir * 100;
      if (f < (int64_t)om::ui::kRadioFreqMin) f = om::ui::kRadioFreqMin;
      if (f > (int64_t)om::ui::kRadioFreqMax) f = om::ui::kRadioFreqMax;
      g_custom.freqKhz = (uint32_t)f;
      break;
    }
    case A_CustomBw: {
      static const uint32_t kBandwidths[] = {7800,  10400, 15600, 20800, 31250,
                                             41700, 62500, 125000, 250000, 500000};
      int at = (int)(sizeof(kBandwidths) / sizeof(kBandwidths[0])) - 1;
      for (int i = 0; i < (int)(sizeof(kBandwidths) / sizeof(kBandwidths[0])) - 1; ++i) {
        if (g_custom.bwHz <= kBandwidths[i]) { at = i; break; }
      }
      at += dir;
      if (at < 0) at = 0;
      if (at > (int)(sizeof(kBandwidths) / sizeof(kBandwidths[0])) - 1) {
        at = (int)(sizeof(kBandwidths) / sizeof(kBandwidths[0])) - 1;
      }
      g_custom.bwHz = kBandwidths[at];
      break;
    }
    case A_CustomSf: {
      int s = (int)g_custom.sf + dir;
      if (s < (int)om::ui::kRadioSfMin) s = om::ui::kRadioSfMin;
      if (s > (int)om::ui::kRadioSfMax) s = om::ui::kRadioSfMax;
      g_custom.sf = (uint8_t)s;
      break;
    }
    case A_CustomCr: {
      int c = (int)g_custom.cr + dir;
      if (c < (int)om::ui::kRadioCrMin) c = om::ui::kRadioCrMin;
      if (c > (int)om::ui::kRadioCrMax) c = om::ui::kRadioCrMax;
      g_custom.cr = (uint8_t)c;
      break;
    }
    default:
      if (id >= A_TimeFieldBase && id < A_TimeFieldBase + (uint16_t)om::ui::TimeField::Count) {
        g_setTime = om::ui::stepCivilTime(g_setTime, (om::ui::TimeField)(id - A_TimeFieldBase), dir);
      }
      break;
  }
  drawSettings();
}

static void settingsEditorOk() {
  if (g_setPage == SetPage::WifiPass) {
    char ssid[om::wifi::kSsidBytes + 1];
    snprintf(ssid, sizeof(ssid), "%s", g_wifiPassSsid);
    const char* toast = "Wi-Fi: not started";
    if (!om::wifiIsEnabled()) {
      toast = "Wi-Fi is off";
    } else if (ssid[0] == 0) {
      toast = "No network chosen";
    } else if (om::wifiConnect(ssid, g_editBuf)) {
      toast = "Wi-Fi: connecting";
    }
    // The passphrase is never needed by the screen after this point; the saved copy is what
    // auto-connect uses. Wipe both the working buffer and the display copy, then leave the sheet
    // BEFORE the toast redraws, so the page behind it is the one that appears.
    memset(g_editBuf, 0, sizeof(g_editBuf));
    g_setEditText[0] = 0;
    setBack();
    showToast(toast);
    return;
  }

  if (g_setPage == SetPage::TimeEdit) {
    // EST-400: the same one apply as the title row's Set key.
    if (applyManualTime()) setBack();   // the page that opened the editor: Time
    drawSettings();
    return;
  }

  if (g_setPage == SetPage::NameEdit) {
    if (s_setNameNode) {
      // EST-422: the node name is a setting that matters, so OK asks in the shared sheet and only its
      // Apply writes the name. Cancel leaves the page as it is and the stored name untouched.
      g_ask.begin(om::ui::ConfirmKind::NodeName, 0, g_editBuf);
    } else if (g_editNew) {
      if (g_addKind == 2) {   // join private: ask for the key next
        g_keyText[0] = 0;
        setGo(SetPage::ChanKey);
      } else {
        const int slot = g_addKind == 1 ? om::mcChannelCreatePrivate(g_editBuf)
                                        : om::mcChannelAddHashtag(g_editBuf);
        if (slot >= 0) {
          om::meshLinkReloadChannels();
          refreshChats();
          g_chanPage = slot;
          setGo(SetPage::Channel);
          showToast("Channel added");
        } else {
          showToast("Channel not added");
          setBack();                // back to Add channel, where the kind was chosen
        }
      }
    } else {
      om::mcChannelSetName(g_editCh, g_editBuf);
      g_chanPage = g_editCh;
      setBack();                    // EST-350: back to the Channel page
      showToast("Channel renamed");
    }
    drawSettings();
    return;
  }

  if (g_setPage == SetPage::ChanKey) {
    const int slot = om::mcChannelAddFromB64(g_editBuf, g_keyText);
    if (slot >= 0) {
      om::meshLinkReloadChannels();
      refreshChats();
      g_chanPage = slot;
      setGo(SetPage::Channel);
      showToast("Channel joined");
    } else {
      showToast("That key is not a 16-byte base64 key");
    }
    drawSettings();
    return;
  }
}

// EST-382: what the pop-up's Clear does. The facade removes the chat's card copy, its queued records,
// its arrival-ring entries and its unread count; this only drops the open chat's own view so the next
// frame reloads an empty chat. On a card failure the facade has already left RAM as the card is, and
// the pop-up result says so (no unread/ring reset here either).
static void settingsClearChannelMessages() {
  const int ch = g_chanPage;
  if (ch < 0 || ch >= om::mcChannelCount()) return;
  const int r = om::meshChatClear(ch);
  if (r == 2) {
    showToast("Could not clear the card copy");
  } else if (r < 0) {
    showToast("No such channel");
  } else {
    showToast("Messages cleared");
    g_chatShown[ch] = ChatShown{};
    if (g_viewChat == ch) {
      g_viewCount = 0;
      g_viewLoading = true;
      g_viewMore = true;
    }
    if (g_chatSel == ch) {
      g_chatScroll = 0;
      g_replySeq = 0;
      g_replyName[0] = 0;
      g_bubMenuSeq = 0;
    }
  }
  refreshChats();
}

// EST-422: the Apply side of the one shared confirm sheet. Every change that asked runs here, and only
// here: Cancel and a tap outside never reach this function (ui/settings_actions.h confirmTap). Each
// case is the code the row used to run straight from its tap, moved behind the sheet.
static void settingsApplyConfirmed(om::ui::ConfirmKind kind, int arg, const char* value) {
  switch (kind) {
    case om::ui::ConfirmKind::Preset:
      if (arg == om::ui::kRadioCustomPreset) {
        if (g_radio.setRadio(g_custom.freqKhz, g_custom.bwHz, g_custom.sf, g_custom.cr)) {
          g_custom = g_radio.prefs();
          showToast("Radio preset saved");
        } else {
          showToast("Preset refused");
        }
      } else if (g_radio.setPreset(arg)) {
        g_custom = g_radio.prefs();
        showToast("Radio preset saved");
      } else {
        showToast("Preset refused");
      }
      break;
    case om::ui::ConfirmKind::TxPower:
      g_radio.setTx((int8_t)om::ui::clampTxPower(arg));
      break;
    case om::ui::ConfirmKind::PathHash:
      if (om::meshPathHashSet((uint8_t)arg)) showToast("Path hash saved");
      else showToast("Path hash refused");
      break;
    case om::ui::ConfirmKind::NodeName:
      om::meshNodeNameSet(value);
      showToast("Name saved");
      setBack();                    // EST-350: back to the Node page, not to General
      break;
    case om::ui::ConfirmKind::ChannelDelete:
      om::mcChannelRemove(arg);
      om::meshLinkReloadChannels();
      refreshChats();
      showToast("Channel removed");
      if (g_setPage == SetPage::Channel) {
        setBack();                  // whichever page the channel was opened from
      } else {
        g_setChat = g_chatCount > 0 ? (g_setChat < g_chatCount ? g_setChat : 0) : 0;
        g_setPage = SetPage::ChatRoot;
        g_setScroll = 0;
      }
      break;
    case om::ui::ConfirmKind::WifiForget:
      om::wifiForget(arg);
      showToast("Network forgotten");
      break;
    case om::ui::ConfirmKind::RepeaterForget: {
      om::rptrForget(value);
      const char* openName = om::rptr_tab::openNodeName();
      if (value != nullptr && openName[0] && strcmp(value, openName) == 0) {
        om::rptrLogout();
        om::rptr_tab::clearSession();
      }
      showToast("Repeater forgotten");
      break;
    }
    case om::ui::ConfirmKind::WifiSwitch:
      om::wifiSetEnabled(arg != 0);
      showToast(arg != 0 ? "Wi-Fi on" : "Wi-Fi off");
      break;
    case om::ui::ConfirmKind::BtSwitch: {
      const bool on = arg != 0;
      om::bleSetEnabled(on);
      // EST-357: the start guard may have refused (not enough internal RAM); its own notice already
      // carries the numbers, so "Bluetooth on" must not overwrite it with a claim that is not true.
      if (!on) {
        showToast("Bluetooth off");
      } else if (om::bleIsEnabled()) {
        showToast("Bluetooth on");
      }
      break;
    }
    case om::ui::ConfirmKind::KeyboardSwitch: {
      g_kbEnabled = arg != 0;
      const bool saved = mapLayerPrefWrite(nullptr, "grovekb", g_kbEnabled);
      if (!saved) showToast("Keyboard setting not saved");
      Serial.printf("[kb] switch %s (saved=%d)\n", g_kbEnabled ? "on" : "off", saved ? 1 : 0);
      if (g_kbEnabled) {
        if (!om::cardkb::begin()) showToast("Grove power failed");
      } else {
        om::cardkb::end();
      }
      break;
    }
    case om::ui::ConfirmKind::Position:
      // 0 is GPS, 1 the point picked on the map (still in g_ownPickLatE6/g_ownPickLonE6).
      if (arg == 0) {
        if (om::posSelectGps()) showToast("Position: GPS");
      } else if (om::posSelectFixed((double)g_ownPickLatE6 / 1e6, (double)g_ownPickLonE6 / 1e6)) {
        showToast("Fixed position saved");
      } else {
        showToast("Position not saved");
      }
      g_ownPick = false;
      break;
    case om::ui::ConfirmKind::ClearMessages:
      settingsClearChannelMessages();
      break;
    case om::ui::ConfirmKind::None:
    default:
      break;
  }
}

// A tap on a settings page. All rectangles come from the view the drawing used.
static void handleSettingsTap(int x, int y) {
  // EST-384: the own-position picker owns every tap while it is up (Cancel, zoom, GPS, Save, map).
  if (g_ownPick) {
    ownPickTap(x, y);
    return;
  }
  buildSettingsRows();
  const om::ui::SettingsView v = settingsView();

  // EST-422: the ONE confirm sheet is the highest layer and owns every tap, including Back and the
  // rows behind it. Cancel and a tap outside the box change NOTHING and are consumed.
  if (g_ask.open) {
    const om::ui::SettingsModalHit h = om::ui::settingsAskHit(v, x, y);
    om::ui::ConfirmAsk answered = g_ask;   // answer() closes g_ask; arg/value stay readable here
    const om::ui::ConfirmKind k = g_ask.answer(h);
    if (k != om::ui::ConfirmKind::None) {
      Serial.printf("[set] confirm: apply kind %d\n", (int)k);
      settingsApplyConfirmed(k, answered.arg, answered.value);
    } else {
      Serial.println("[set] confirm: cancelled");
    }
    drawSettings();
    return;
  }

  // EST-392: the Position choice owns every tap while it is down, Back and the row above it
  // included. GPS asks in the shared sheet; Fixed opens EST-384's map picker exactly as before; a tap
  // anywhere else is Cancel and changes neither the source nor the saved point.
  if (g_posChoice) {
    const int option = om::ui::settingsPositionChoiceHit(v, x, y);
    g_posChoice = false;
    switch (om::ui::posChoiceAction(option)) {
      case om::ui::PosChoiceAct::Gps:
        askChange(om::ui::ConfirmKind::Position, 0, "GPS");
        break;
      case om::ui::PosChoiceAct::OpenPicker:
        // Already Fixed? Then the picker opens on the saved point, exactly like EST-384's Change row.
        ownPickOpen(om::posSource().sourceFixed());
        return;   // ownPickOpen drew the picker
      case om::ui::PosChoiceAct::Keep:
      default:
        break;    // Cancel: nothing is written
    }
    drawSettings();
    return;
  }

  // EST-350: while the chat selector is open it owns the page, exactly like the Chat tab's dropdown:
  // a row picks that chat (the page below shows its settings without leaving Settings), the pinned
  // row opens the channel list, and a tap anywhere else — including Back — closes it and is CONSUMED,
  // so the press never reaches the row behind it.
  if (g_setSelOpen) {
    const om::ui::SelectorPress press = om::ui::settingsSelectorPress(v, x, y);
    if (press.picks) {
      const int wasOpen = g_chatSel;
      om::ui::selectorPickShown(press, &g_setChat);   // g_chatSel is deliberately untouched
      g_setSelOpen = false;
      g_setScroll = 0;
      g_ask.close();
      // EST-399: which chat was picked (its index), never its name (rule 9).
      Serial.printf("[set] chat picked: %d of %d (chat screen still on %d)\n", g_setChat, g_chatCount,
                    wasOpen);
      drawSettings();
      return;
    }
    if (press.kind == om::ui::SelectorHitKind::Manage) {
      g_setSelOpen = false;
      openChannelList();
      return;
    }
    g_setSelOpen = false;
    drawSettings();
    return;                   // consumed: no tap behind a closed dropdown
  }

  if (om::ui::settingsBackHit(v, x, y)) {
    settingsBack();
    return;
  }

  // EST-363: the title row's commit action (the picker's Use, the time page's Set, the custom preset's
  // Apply). It is drawn dim when there is nothing new to commit, and then a tap does nothing at all
  // but is still spent here, so it can never fall through to a row behind it.
  if (om::ui::settingsTitleActionHit(v, x, y)) {
    if (g_setActionOn) handleSettingsRow(g_setActionId);
    return;
  }

  if (g_setEditor != om::ui::SettingsEditor::None) {
    // EST-352: the sheet owns the page. One key, one action, through the same key tables and byte
    // filters the chat uses. A tap above the sheet (the hint line) does nothing, and Back above it
    // was handled before this branch.
    const om::ui::SettingsKeyHit key = om::ui::settingsEditorKeyAt(v, x, y);
    if (!key.pressed) return;
    switch (key.kind) {
      case om::ui::KeyKind::Shift:
        g_setEditShift = !g_setEditShift;
        break;
      case om::ui::KeyKind::Mode:
        g_setEditNums = !g_setEditNums;
        g_setEditShift = false;
        break;
      case om::ui::KeyKind::Del:
        om::ui::composeBackspace(settingsEditBuf());   // one whole code point, never half an accent
        break;
      case om::ui::KeyKind::Reveal:
        g_setEditReveal = !g_setEditReveal;   // EST-354: show/hide the passphrase
        break;
      case om::ui::KeyKind::Send:
        settingsEditorOk();   // draws its own frame
        return;
      case om::ui::KeyKind::Space:
        settingsEditAppendChar(' ');
        break;
      case om::ui::KeyKind::Char:
        settingsEditAppendChar(key.ch);
        break;
      case om::ui::KeyKind::Emoji:
      default:
        break;   // an editor's sheet offers no emoji page
    }
    drawSettings();
    return;
  }

  const int tab = om::ui::settingsTabHit(v, x, y);
  if (tab >= 0) {
    g_setTab = (om::ui::SettingsTab)tab;
    g_setPage = setRootForTab(g_setTab);
    g_setScroll = 0;
    g_setNav.reset();         // a tab is a new root: Back leaves Settings from it
    g_ask.close();
    g_posChoice = false;      // EST-392: a tab is a new page, so no choice is left down
    drawSettings();
    return;
  }

  const int row = om::ui::settingsRowHit(v, x, y);
  if (row < 0) return;
  const int part = om::ui::settingsStepperHit(v, x, y);
  if (part != 0) {
    handleSettingsStep(g_setRows[row].id, part);
    return;
  }
  handleSettingsRow(g_setRows[row].id);
}

// The two MeshCore-backed callbacks the radio store calls. Nothing here is a second store: the read
// comes from NodePrefs and the write is the same savePrefs + radio apply the phone commands use.
static bool radioPrefsRead(void*, om::ui::RadioPrefs& out) {
  om::MeshRadioPrefs p;
  if (!om::meshRadioPrefsGet(&p)) return false;
  out.freqKhz = p.freq_khz;
  out.bwHz = p.bw_hz;
  out.sf = p.sf;
  out.cr = p.cr;
  out.tx = p.tx;
  return true;
}

static bool radioPrefsWrite(void*, const om::ui::RadioPrefs& p) {
  om::MeshRadioPrefs m{p.freqKhz, p.bwHz, p.sf, p.cr, p.tx};
  return om::meshRadioPrefsSet(m);
}

static void settingsBegin() {
  g_radio.begin(radioPrefsRead, radioPrefsWrite, nullptr);
  const bool seeded = g_radio.load();
  g_custom = g_radio.prefs();
  if (seeded) Serial.println("[set] radio prefs seeded from the build values");
}

// EST-411: the Nodes tab module's shell services. Its long-press arm and press-away rule only run
// on the Nodes screen; a sheet row can open a DM or switch page through the shell's own functions.
static bool appNodesVisible() { return g_tab == 0 && !g_settings; }
static bool appOpenDm(const char* name) { return chatOpenDmFor(name); }
static void appShowTab(int tab) { showTab(tab); }

void setup() {
  Serial.begin(115200);
  Serial.setDebugOutput(true);
  const uint32_t t0 = millis();
  while (!Serial && millis() - t0 < 4000) delay(10);
  Serial.println();
  Serial.println("======================================");
  Serial.println(" OM Lite - L2 Pro P2");
  Serial.println("======================================");
  Serial.printf("build: %s %s\n", __DATE__, __TIME__);
  // EST-379: the commit this image was built from, so the serial log names the build by itself.
  Serial.printf("[om] build %s\n", OM_BUILD_ID);

  // Before anything that can crash: print the previous boot's ending, its RTC_NOINIT checkpoint and
  // one core-dump summary line (then erase a dump that printed). EST-341.
  om::crashReportBegin();
  om::crashCheckpoint("[om] board.begin");

  g_boardOk = om::boardBegin();
  g_fade.reset(om::kScreenBrightness);   // boardBegin lit the panel already
  Serial.printf("[om] board: %s\n", g_boardOk ? "ok" : "FAILED");
  // EST-402: the bolt's state machine starts from what the boot achieved. A chip that did not answer
  // or a POWER write that was not verified latches "unknown", so no bolt is ever drawn; board.cpp
  // prints that one line. The first two equal reads are what may raise it.
  g_chargeBolt.begin(om::usbPdReady());
  om::useAppFont(om::om_display());   // the app font is the default everywhere
  om::omFrameInit();
  om::radio::begin(millis());   // EST-365: the noise window and the loop histogram start clean
  // The toast is a frame overlay, not a second push: omFrameEnd() draws it last on every redraw
  // (EST-344). Register it once, before any screen can be drawn.
  om::omFrameSetOverlay(&drawFrameOverlays);   // EST-390: press, then toast on top
  om::toasts::begin(redrawCurrentScreen);
  // EST-371: the Map tab module gets the four shell services it needs, once, before any draw.
  {
    om::map_tab::Host mapHost;
    mapHost.buildStatus = buildStatus;
    mapHost.tabBar = appTabBar;
    mapHost.gps = appGps;
    mapHost.toast = showToast;
    om::map_tab::begin(mapHost);
  }
  // EST-410: the RPTR tab module gets its shell services, once, before any draw. gps is the raw
  // parser state (the picker's own source); screenVisible and redraw are the shell's own tests.
  {
    om::rptr_tab::Host rptrHost;
    rptrHost.buildStatus = buildStatus;
    rptrHost.tabBar = appTabBar;
    rptrHost.gps = appRawGps;
    rptrHost.toast = showToast;
    rptrHost.screenVisible = appRptrVisible;
    rptrHost.redraw = appRedraw;
    om::rptr_tab::begin(rptrHost);
  }
  om::ui::loadFonts();                // anti-aliased VLW tables, needed before the first Nodes draw
  // EST-357: the one-time PSRAM move, and the boot number the Bluetooth guard is built from.
  allocUiBuffers();
  // EST-411: the Nodes tab module gets its shell services and the two PSRAM buffers it fills, once,
  // before the first draw.
  {
    om::nodes_tab::Host nodesHost;
    nodesHost.buildStatus = buildStatus;
    nodesHost.tabBar = appTabBar;
    nodesHost.toast = showToast;
    nodesHost.screenVisible = appNodesVisible;
    nodesHost.openDm = appOpenDm;
    nodesHost.showTab = appShowTab;
    om::nodes_tab::begin(nodesHost, g_nodes, g_contactScratch);
  }
  om::printMemLine("boot (before Wi-Fi, before BLE)");

  om::crashCheckpoint("[om] prefs + clock");
  g_prefs.begin("omlite", false);
  // EST-384: the node's own position source (GPS or a point fixed on the map). Loaded before
  // MeshCore exists so its own saved lat/lon can never win the boot race; the effective point is
  // re-applied right after meshLinkBegin() below.
  om::posBegin(&g_prefs);
  // One clock, seeded before MeshCore exists: max(saved floor, build time). It is not real time yet;
  // buildStatus() keeps showing "--:--" until GPS (or a later Wi-Fi/phone/manual source) sets it.
  {
    uint32_t buildEpoch = 0;
    om::parseBuildTimestamp(__DATE__, __TIME__, buildEpoch);
    g_buildEpoch = buildEpoch;
    const uint32_t savedFloor = g_prefs.getUInt("tfloor", 0);
    // EST-403: every accepted real source refreshes the RTC_NOINIT record (clock_keep.cpp).
    om::timeKeeper().begin(savedFloor, buildEpoch, millis() / 1000, &om::TimeKeeper::systemSet,
                           &om::TimeKeeper::systemGet, &om::clockKeepStore);
    Serial.printf("[time] floor %lu s (saved %lu, build %lu), waiting for a real source\n",
                  (unsigned long)om::timeKeeper().floor(), (unsigned long)savedFloor,
                  (unsigned long)buildEpoch);
    // EST-403: after a software/OTA/panic/watchdog restart the RTC counter survived, and so did
    // the record. Restore the epoch from it at once (a fresh source still replaces it immediately).
    // The reset-reason table is the GPS warm boot's own (gps_boot.h), so the two cannot drift.
    const om::ClockKeepBoot kept = om::clockKeepBegin(om::timeKeeper().floor());
    if (kept.kept && om::timeKeeper().setKept(kept.epoch, kept.source, millis() / 1000)) {
      Serial.printf("[time] kept across restart (was %s)\n", om::timeSourceName(kept.source));
    }
  }
  // EST-371: the sound events own their keys, defaults and the EST-359 -> EST-361 migration.
  om::sounds::begin(&g_prefs);
  if (om::sounds::load()) Serial.println("[snd] choices migrated to shared-library ids");
  // EST-368 / EST-370 / EST-373: the Map's three layer switches are remembered (Traces and Names
  // default ON, the hidden tab column default OFF). The store owns the keys ("traces", "names",
  // "tabsHidden") and reads each once, here, after Preferences is open.
  om::map_tab::beginLayers(mapLayerPrefRead, mapLayerPrefWrite, nullptr);
  om::map_tab::loadLayers();
  Serial.printf("[map] layers traces=%d names=%d hidden=%d\n", om::map_tab::tracesOn() ? 1 : 0,
                om::map_tab::namesOn() ? 1 : 0, om::map_tab::tabsHidden() ? 1 : 0);
  loadEmojiRecent();
  // EST-412: the Grove keyboard switch. DEFAULT OFF and a missing key means OFF (cardkb_logic.h's
  // enabledFromNvs), so an upgrade from an image without this key powers nothing and opens no bus.
  // EST-421: a saved ON powers the rail and opens the start window (cardkb::begin() returns at once);
  // the loop's cardKbStep() probes until the keyboard answers, so boot never waits. The OFF path here
  // is one NVS read and nothing else.
  {
    bool saved = false;
    const bool present = mapLayerPrefRead(nullptr, "grovekb", false, saved);
    g_kbEnabled = om::cardkb::enabledFromNvs(present, saved);
    Serial.printf("[kb] switch %s (%s)\n", g_kbEnabled ? "on" : "off",
                  present ? "saved" : "default");
    if (g_kbEnabled && !om::cardkb::begin()) showToast("Grove power failed");
  }
  // EST-405: the screen auto-off switch and time. DEFAULT OFF and 1 min; a missing key writes
  // nothing, so an upgrade from an image without them changes no NVS byte. The timer starts its
  // count here, so an image that boots with the switch on still shows the screen for a full time.
  g_idlePrefs.begin(u8PrefRead, u8PrefWrite, nullptr);
  g_idlePrefs.load();
  g_idle.begin(g_idlePrefs.enabled(), g_idlePrefs.timeIndex(), millis());
  Serial.printf("[idle] screen auto-off %s, %s\n", g_idle.enabled() ? "enabled" : "off",
                g_idle.timeLabel());
  // EST-347: the one brightness setting, in NVS as "bright". The fade starts from it.
  g_setBrightness = g_prefs.getUChar("bright", om::kScreenBrightness);
  if (g_setBrightness < 20) g_setBrightness = 20;
  om::boardSetBrightness(g_setBrightness);
  g_fade.reset(g_setBrightness);
  // EST-354: the Wi-Fi switch and its five saved networks. Default off; the radio is not touched
  // until the switch is on (or a saved "on" is applied by the first loop pass).
  om::wifiBegin();
  om::printMemLine("boot (Wi-Fi stack off)");
  Serial.printf("[prefs] sound=%d vol=%u sndver=%u boot=%u msg=%u dm=%u men=%u sent=%u err=%u "
                "new=%u batt=%u dnd=%d tsnd=%d tone=%u emoji_rec=%u\n",
                om::sounds::masterOn(), om::sounds::volume(), om::sounds::prefsVersion(), om::sounds::choice(SoundEvent::Boot), om::sounds::choice(SoundEvent::Message), om::sounds::choice(SoundEvent::Dm), om::sounds::choice(SoundEvent::Mention),
                om::sounds::choice(SoundEvent::Sent), om::sounds::choice(SoundEvent::Error), om::sounds::choice(SoundEvent::NewNode), om::sounds::choice(SoundEvent::LowBattery), om::sounds::dnd(), om::sounds::touchClicks(), om::sounds::choice(SoundEvent::Touch),
                (unsigned)g_emojiRecent.count);
  Serial.printf("[emoji] table %s, %d cells\n",
                om::ui::emojiReady() ? "ok" : "MISSING", om::ui::emojiTableCount());

  om::crashCheckpoint("[om] audio");
  const bool audioOk = om::audioBegin();
  Serial.printf("[audio] %s\n", audioOk ? "ok" : "FAILED");
  if (audioOk) {
    om::audioVolume(om::sounds::volume());
    if (om::sounds::welcome()) om::sounds::playWelcome();
  }

  om::crashCheckpoint("[om] radio");
  om::RadioInfo ri;
  const bool radioOk = om::radioBegin(ri);
  Serial.printf("[radio] %s status=%d\n", radioOk ? "ok" : "FAILED", ri.status);

#if defined(OM_ENABLE_MESH)
  om::crashCheckpoint("[om] mesh begin");
  const bool meshOk = om::meshLinkBegin();
  Serial.printf("[mc] mesh: %s\n", meshOk ? "up" : "FAILED");
  // EST-384: MeshCore's begin() loads its own NodePrefs lat/lon into sensors. That is GPS-era saved
  // state; the ONE position source is the truth, so put the effective point back right after it.
  // Done even when begin() failed part-way: otherwise posPollNode() could mistake those half-loaded
  // prefs for a phone set-location on the first pass.
  om::posApplyToNode();
  // The status bar's red mark, second of its three reasons: MeshCore did not start (its radio,
  // identity, settings or contact store). A radio fault already showing outranks this one.
  if (!meshOk && om::radioFaultState().set(om::RadioFault::Mesh)) {
    Serial.printf("[radio] fault: %s\n", om::radioFaultToken(om::RadioFault::Mesh));
  }
  // EST-347: Settings edits the radio through NodePrefs. The store is loaded (and seeded from the
  // build values when /prefs.json has none) before the first page can be opened.
  settingsBegin();
  // EST-356: the Bluetooth switch, OFF by default. Reading it here means the PIN in NodePrefs is
  // available and the first loop pass can bring the transport up if it was saved on.
  // EST-357: the guard's refusals and its crash notice arrive as toasts on the screen. Registered
  // before bleBegin so a parked guard left by the crashed EST-356 image can say so on the first loop
  // pass (bleBegin only queues the text; the draw happens after setup finished).
  om::bleSetNotice(showToast);
  om::bleBegin();
#endif

  om::gpsBegin();
  g_battMv = om::batteryMilliVolts();
  Serial.printf("[batt] %u mV\n", g_battMv);

  const bool present = om::sdPresent();
  Serial.printf("[sd] present: %s\n", present ? "yes" : "no");
  if (present) {
    // EST-380: measure the mount's own cost. The FATFS file table (maxOpenFiles x FIL, about 4,136 B
    // per slot with a 4 KB per-file sector buffer) is allocated during SD_MMC.begin(). These two
    // [mem] lines say where it came from: internal RAM (which Bluetooth needs 80 KB of, EST-356) or
    // PSRAM (where IDF's ff_memalloc puts it on this build).
    om::printMemLine("boot (before the SD mount)");
    g_sdOk = om::sdMount();
    Serial.printf("[sd] mount: %s\n", g_sdOk ? "ok" : "FAILED");
    om::printMemLine("boot (after the SD mount)");
    if (g_sdOk) {
      File p = SD_MMC.open("/maps/slo/tiles.pack");
      if (p) {
        g_packMb = (uint16_t)(p.size() / (1024UL * 1024UL));
        Serial.printf("[sd] tiles.pack %u MB\n", g_packMb);
        p.close();
      }
      om::mapBegin();
    }
  }
#if defined(OM_ENABLE_MESH)
  // EST-348: the chat history begins after the card is mounted (meshLinkBegin ran earlier, before
  // the SD pins were powered) and restores the newest messages into the RAM rings. No packets are
  // pumped between meshLinkBegin and here, so nothing is missed. EST-349: the page window is
  // allocated in PSRAM before the first chat can be drawn.
  om::crashCheckpoint("[om] history");
  if (!om::meshHistoryBegin(g_sdOk)) Serial.println("[hist] store not ready (no SD, no SPIFFS)");
#endif
  // EST-377: the battery log's switch, loaded after Preferences is open (a missing key is ON and is
  // not written). The card itself is only touched from the loop, below.
  om::plog::begin(mapLayerPrefRead, mapLayerPrefWrite, nullptr);
  om::nodes_tab::draw();
  // EST-355: the first screen is on the glass now, so its brightness is known before the first
  // change is asked for.
  g_tabLuma[0] = om::omFrameMeanLuma(om::ui::kChangeLumaStep);
  g_tabLumaKnown[0] = true;
}

// EST-355: one line per screen change, the numbers the ticket asks for. `out` is the fade-out the
// change really spent, `push` the measured frame push, `settle` the one panel frame waited after it,
// `in` the fade-in.
static void logScreenChange() {
  Serial.printf("[ui] change: out %lu ms, push %lu us, settle %lu ms, in %lu ms\n",
                (unsigned long)g_change.outMs(), (unsigned long)g_change.pushUs(),
                (unsigned long)g_change.settleMs(), (unsigned long)g_change.inMs());
}

// Ask for a screen change from fromTab to toTab. The dip decision is made here, from the frame that is
// on the glass (its pixels, sampled now) and the last frame measured for the tab being entered, plus
// the map rule: the map's tiles are the one bright background this firmware has, so a switch to or
// from it always dips (frame_metrics.h).
static void beginScreenChange(int fromTab, int toTab) {
  const uint32_t now = millis();
  g_changeOldLuma = om::omFrameMeanLuma(om::ui::kChangeLumaStep);
  const bool mapInvolved = (fromTab == 2 || toTab == 2);
  const bool measured = g_tabLumaKnown[toTab];
  const uint8_t newLuma = measured ? g_tabLuma[toTab] : 0;
  const bool dip = om::screenChangeNeedsDip(g_changeOldLuma, newLuma, mapInvolved,
                                            om::ui::kChangeLumaDelta);
  const int from = g_fade.level();
  g_fade.reset(from);   // a wake ramp must not fight the change for the light
  if (!g_change.request(now, dip, from, (int)g_setBrightness)) {
    Serial.printf("[ui] change coalesced (luma %u -> %u): one transition, one push\n",
                  (unsigned)g_changeOldLuma, (unsigned)newLuma);
    return;
  }
  Serial.printf("[ui] change %s -> %s: luma %u -> %u (%s), %s\n",
                om::ui::tabLabel((om::ui::Tab)fromTab), om::ui::tabLabel((om::ui::Tab)toTab),
                (unsigned)g_changeOldLuma, (unsigned)newLuma, measured ? "measured" : "unknown",
                dip ? "dip" : "instant");
}

// The transition, advanced once per loop pass. push = compose the target and push it once; done = the
// light is back up. Between the passes the mesh, the radio and the GPS run as usual.
static void screenChangeLoop() {
  if (!g_change.active()) return;
  const om::ScreenChange::Action action = g_change.tick(millis());
  const int level = g_change.takeLevel();
  if (level >= 0) om::boardSetBrightness((uint8_t)level);

  if (action == om::ScreenChange::Action::Push) {
    const uint16_t pushesBefore = om::omFramePushCount();
    // Compose without pushing, so the composed frame can be measured before anything is shown.
    // The compose happens with the light already out, so a slow screen (the map decodes tiles) is
    // dark for its own duration too: say how long, so the pause can be judged on the glass.
    const uint32_t composeStart = millis();
    om::omFrameHoldPush(true);
    redrawMainTab();
    om::omFrameHoldPush(false);
    const uint32_t composeMs = millis() - composeStart;
    if (composeMs >= 5) {
      Serial.printf("[ui] change: composed in %lu ms (inside the dark)\n",
                    (unsigned long)composeMs);
    }
    uint8_t newLuma = 0;
    bool dark = g_change.dipped();
    if (om::omFramePending()) {
      newLuma = om::omFrameMeanLuma(om::ui::kChangeLumaStep);
      // The late check. The plan said "instant" from the target tab's LAST frame; if the frame just
      // composed is much brighter than the one on the glass (a page seen for the first time), the
      // light is still up and would show the tear. Cut it now: a hard cut instead of a 40 ms fade is
      // the honest repair, and the log says out 0 ms because that is what was spent.
      if (!dark && om::screenChangeNeedsDip(g_changeOldLuma, newLuma, false,
                                            om::ui::kChangeLumaDelta)) {
        om::boardSetBrightness(0);
        dark = true;
        Serial.printf("[ui] change: late dip (composed luma %u, glass %u)\n", (unsigned)newLuma,
                      (unsigned)g_changeOldLuma);
      }
      om::omFrameFlush();
    }
    const int pushes = (int)(uint16_t)(om::omFramePushCount() - pushesBefore);
    if (pushes != 1) {
      Serial.printf("[ui] tab %s: %d frame pushes, not 1\n",
                    om::ui::tabLabel((om::ui::Tab)g_tab), pushes);
    }
    // What this screen really looks like, for the next change's comparison.
    g_tabLuma[g_tab] = newLuma;
    g_tabLumaKnown[g_tab] = true;
    if (g_change.pushed(millis(), om::omFrameLastPushUs(), dark)) logScreenChange();
  } else if (action == om::ScreenChange::Action::Done) {
    logScreenChange();
  }

  if (!g_change.active()) {
    // The change is over: the light is back where the wake ramp keeps it, and a finger that is down
    // right now must lift before it can tap anything on the new screen (the wake path's own rule,
    // with the change's window). Reading the panel here is what tells that gate whether to latch.
    g_fade.reset((int)g_setBrightness);
    uint16_t tx = 0, ty = 0;
    const bool downNow = om::omTouch(tx, ty);
    g_touchGate.onWake(millis(), downNow, om::ui::kChangeGateMs);
  }
}

// One tab switch for the new shell. The old screens keep their own tap paths for now; both end here
// or in om::nodes_tab::draw(), so returning to Nodes always redraws the new chrome.
//
// EST-355: the switch itself is NOT drawn here any more. It is handed to the screen-change machine
// (screen_change.h) and performed by screenChangeLoop() from loop(): with the light taken down first
// when the two frames differ strongly in brightness, so the panel never shows the diagonal of a
// half-written frame (board.h). The caller keeps its state resets because g_tab is what the next
// drawings use, and no tap can arrive while the change runs.
static void showTab(int tab) {
  if (tab < 0 || tab >= 4) return;
  if (tab == g_tab) {
    // A plain redraw of the screen that is already up. Not while a change owns the light and the
    // frame (EST-355): it would push into a light that is on its way down or up.
    if (tab == 0 && !g_change.active()) om::nodes_tab::draw();
    return;
  }
  const int fromTab = g_tab;
  g_tab = tab;
  // EST-374: leaving the Map. The tucked bottom bar belongs to the MAP screen: every other screen
  // draws its own full bar, so the bar is on the next screen whatever the saved key says. Stating it
  // here covers every route off the tab at once (a pop-up action, a notification, a USB tap and a
  // page switch from code all end up in this function; the test scans the file to prove it).
  if (fromTab == 2 && tab != 2) om::map_tab::leave();
  g_bubMenuSeq = 0;
  g_replySeq = 0;
  g_replyName[0] = 0;
  g_selector = false;   // the dropdown belongs to the chat we are leaving
  g_advertMenu = false; // EST-382: so does the advert dropdown
  om::map_tab::clearSelection();
  // EST-371: decide the Map's open mode before the screen change composes. A canvas from an earlier
  // visit is shown at once; a view that changed since then refreshes after the frame is visible.
  if (tab == 2) {
    om::map_tab::enter();
    // EST-368: entering the Map starts a clean replay: the routes of the newest message per sender,
    // run one at a time. Nothing is replayed when the Traces toggle is off.
    om::map_tab::tracesResetAndSeed();
  }
  // EST-414 (Filip's glass test): the RPTR tab no longer scans when it opens. EST-362's auto scan is
  // gone; the header's Scan chip is the one door (screens/rptr_tab.cpp, RptrHit::Scan), and the list
  // of the last scan, the remembered passwords and the one-tap login are untouched. Nothing else in
  // this switch starts a scan.
  Serial.printf("[tab] %s\n", om::ui::tabLabel((om::ui::Tab)g_tab));
  beginScreenChange(fromTab, tab);
}

// A short message on top of the current frame, with its own deadline. The toast never answers a
// touch itself: it is drawn only, and the loop's press edge dismisses it and spends that gesture
// (EST-346). It is drawn by the frame overlay on the redraw this call triggers, so the next repaint
// carries it too (EST-344); only expiry asks for another redraw.
// One duration for every toast: theme.h kToastMs (5 s, EST-346).
static void showToast(const char* text) { om::toasts::text(text); }

// EST-390: what the pressed look goes on, screen by screen. Every branch asks the SAME hit test the
// tap path asks (through ui/press_targets.h) and then returns the rectangle that hit test used, so
// the tint can never sit off the element the tap lands on. A consumed press (a tap that only closed a
// pop-up or a keyboard) answers no target at all, and then nothing is drawn pressed.
static bool pressTargetAt(int x, int y, om::ui::PressTarget* out) {
  if (out == nullptr) return false;
  *out = om::ui::PressTarget{};
  const om::ui::Layout& L = om::ui::l2();

  if (g_settings) {
    // The own-position picker owns every tap while it is up.
    if (g_ownPick) {
      *out = om::ui::pressTargetForRptrMapPick(om::ui::rptrMapPickLayoutFor(L, true), x, y);
      return out->valid();
    }
    // The confirm sheet is the highest layer: only its two keys are targets, and a press outside the
    // box is the consumed Cancel.
    if (g_ask.open) {
      const om::ui::SettingsView v = settingsView();
      const om::ui::SettingsModalLayout m = om::ui::settingsModalLayoutFor(L.width, L.height);
      const bool confirm =
          om::ui::settingsAskHit(v, x, y) == om::ui::SettingsModalHit::Confirm;
      *out = om::ui::pressTargetForModalKey(confirm, m.cancel, m.confirm, x, y);
      return out->valid();
    }
    buildSettingsRows();
    const om::ui::SettingsView v = settingsView();
    // EST-392: the Position choice: only its two option rows are targets, and a press outside it
    // only closes it (consumed), so nothing behind shows a pressed look.
    if (g_posChoice) {
      *out = om::ui::pressTargetForPositionChoice(om::ui::settingsPositionChoice(v), x, y);
      return out->valid();
    }
    // The chat dropdown: a row or the pinned Manage row. Outside it the press only closes it
    // (consumed), so there is no target behind it.
    if (g_setSelOpen) {
      const om::ui::SettingsLayout sl = om::ui::settingsLayoutFor(
          L.width, L.height, v.subPage, true, v.titleAction[0] != 0);
      *out = om::ui::pressTargetForSelectorRow(sl.selList, v.sel.channelCount, v.sel.dmCount,
                                               v.sel.scroll, sl.selManage, x, y);
      return out->valid();
    }
    // A text editor's sheet owns the page.
    if (g_setEditor != om::ui::SettingsEditor::None) {
      const om::ui::KeyboardField field = settingsEditField();
      const om::ui::ChatLayout g =
          om::ui::chatLayoutFor(L, true, false, g_setEditNums, false, field);
      *out = om::ui::pressTargetForKeypad(g, g_setEditNums, x, y, field, g_setEditShift);
      return out->valid();
    }
    const om::ui::SettingsLayout sl =
        om::ui::settingsLayoutFor(L.width, L.height, v.subPage, false, v.titleAction[0] != 0);
    *out = om::ui::pressTargetForSettings(sl, v.rows, v.rowCount, v.scroll, x, y);
    return out->valid();
  }

  if (g_tab == 0) {
    // The info page and the sheets own every press while they are up (EST-411: the screen's own
    // hit test lives in screens/nodes_tab.cpp).
    if (om::nodes_tab::overlayOpen()) {
      *out = om::nodes_tab::pressTarget(x, y);
      return out->valid();
    }
    // The tab bar, the gear and the radio-fault mark are the shell's, exactly as on every tab.
    *out = om::ui::pressTargetForChrome(L, x, y);
    if (out->valid()) return true;
    *out = om::nodes_tab::pressTarget(x, y);
    return out->valid();
  }

  if (g_tab == 1) {
    om::ui::ChatView v;
    buildChatView(v);
    *out = om::ui::chatPressTarget(v, x, y);
    if (out->valid()) return true;
    // ChatHit::None with an action behind it: the tab bar (hidden while the keyboard sheet is up),
    // the radio fault mark and the gear, exactly where handleChatTap would act.
    if (!g_kb.open) {
      const int tab = L.tabAt(x, y);
      if (tab >= 0) {
        out->kind = om::ui::PressKind::Tab;
        out->rect = L.tab((om::ui::Tab)tab);
        return true;
      }
    }
    if (L.radioFault().contains(x, y)) {
      out->kind = om::ui::PressKind::Button;
      out->rect = L.radioFault();
      return true;
    }
    if (L.gear().contains(x, y)) {
      out->kind = om::ui::PressKind::Button;
      out->rect = L.gear();
      return true;
    }
    return false;
  }

  if (g_tab == 2) {
    // EST-374: while the bars are tucked the bottom strip is not a tab bar, so it is no target.
    const bool tucked = om::ui::mapBarsTucked(om::map_tab::tabsHidden(), true);
    if (!tucked) {
      out->kind = om::ui::PressKind::Tab;
      const int tab = L.tabAt(x, y);
      if (tab >= 0) {
        out->rect = L.tab((om::ui::Tab)tab);
        return true;
      }
      out->kind = om::ui::PressKind::None;
    }
    if (L.radioFault().contains(x, y)) {
      out->kind = om::ui::PressKind::Button;
      out->rect = L.radioFault();
      return true;
    }
    if (L.gear().contains(x, y)) {
      out->kind = om::ui::PressKind::Button;
      out->rect = L.gear();
      return true;
    }
    *out = om::map_tab::pressTarget(x, y);
    return out->valid();
  }

  // RPTR: same order as handleRptrTap (picker, confirmation, sheet, list, page).
  if (g_tab == 3) {
    if (!om::rptr_tab::keyboardOpen()) {
      const int tab = L.tabAt(x, y);
      if (tab >= 0) {
        out->kind = om::ui::PressKind::Tab;
        out->rect = L.tab((om::ui::Tab)tab);
        return true;
      }
      if (L.radioFault().contains(x, y)) {
        out->kind = om::ui::PressKind::Button;
        out->rect = L.radioFault();
        return true;
      }
      if (L.gear().contains(x, y)) {
        out->kind = om::ui::PressKind::Button;
        out->rect = L.gear();
        return true;
      }
    }
    *out = om::rptr_tab::pressTarget(x, y);
    return out->valid();
  }

  return false;
}

// EST-390: the press edge. Composing the frame here (instead of waiting for the next loop pass) is
// what keeps the look inside the ticket's ~30 ms target; the sample is taken to the END of that
// frame's push, so the printed number is the press-to-pixels time, not just the draw.
static void pressArmAt(int x, int y) {
  om::ui::PressTarget t;
  if (!pressTargetAt(x, y, &t) || !t.valid()) {
    om::ui::pressClear();   // nothing actionable under the finger: no look, and no stale one
    return;
  }
  om::ui::pressArm(t, millis());
  const uint32_t t0 = micros();
  const uint16_t push0 = om::omFramePushCount();
  redrawCurrentScreen();
  if (om::omFramePushCount() != push0) g_pressLatency.sample(micros() - t0);
}

static void handleTap(int x, int y, bool longPress) {
  Serial.printf("[tap] %d,%d\n", x, y);
  om::sounds::playClick();

  // New Nodes tab: the tab bar, the gear and the row bands all come from the same Layout rects
  // that drew them. Nothing here repeats a coordinate.
  if (!g_settings && g_tab == 1) {
    handleChatTap(x, y);
    return;
  }

  if (!g_settings && g_tab == 0) {
    const om::ui::Layout& L = om::ui::l2();
    // The Info page and the sheets own every tap: no tab bar is drawn there, so nothing else is
    // tappable until they close (EST-342, EST-411: the screen's own tap handling is in
    // screens/nodes_tab.cpp).
    if (om::nodes_tab::overlayOpen()) {
      (void)om::nodes_tab::tap(x, y, longPress);
      return;
    }
    const int tab = L.tabAt(x, y);
    if (tab >= 0) {
      showTab(tab);
      return;
    }
    if (L.gear().contains(x, y)) {
      // EST-347: the gear opens Settings on the tab of THIS screen, and Back returns here.
      openSettings(0, om::ui::SettingsTab::Nodes);
      return;
    }
    // The radio fault mark: a tap explains it, an empty slot does nothing.
    if (L.radioFault().contains(x, y)) {
      showRadioFaultToast();
      return;
    }
    (void)om::nodes_tab::tap(x, y, longPress);
    return;
  }

  if (!g_settings && g_tab == 2) {
    const om::ui::Layout& L = om::ui::l2();
    // EST-374: while the bars are tucked the bottom strip is not a tab bar any more: those rows are
    // map gestures (the strip "takes no taps"). Shown, the bar's own zones are exactly as before.
    const bool tucked = om::ui::mapBarsTucked(om::map_tab::tabsHidden(), true);
    const int tab = tucked ? -1 : L.tabAt(x, y);
    if (tab >= 0) { showTab(tab); return; }
    if (L.gear().contains(x, y)) { openSettings(2, om::ui::SettingsTab::Map); return; }
    if (L.radioFault().contains(x, y)) { showRadioFaultToast(); return; }
    // EST-371: the Map's chrome hit test (zoom, follow, Traces, Names, a marker, closing the callout)
    // and its redraw live in screens/map_tab.cpp. The tab bar, gear and fault mark above are the
    // shell's, exactly as on every other tab.
    (void)om::map_tab::tap(x, y);
    return;
  }

  if (!g_settings && g_tab == 3) {
    const om::ui::Layout& L = om::ui::l2();
    // While the keyboard sheet is up it covers the tab bar and the gear: a tap there must not hit
    // something the finger cannot see (the chat sheet's rule).
    if (!om::rptr_tab::keyboardOpen()) {
      const int tab = L.tabAt(x, y);
      if (tab >= 0) { showTab(tab); return; }
      if (L.gear().contains(x, y)) { openSettings(3, om::ui::SettingsTab::Rptr); return; }
      if (L.radioFault().contains(x, y)) { showRadioFaultToast(); return; }
    }

    if (om::rptr_tab::tap(x, y)) return;
    return;
  }

  // Every settings page: tabs, back, rows, steppers and the two text editors, from the view the
  // drawing used. No coordinate appears here.
  handleSettingsTap(x, y);
}

// Draw whatever the user is looking at, right now. The wake path needs it: the panel comes back
// black and stays black until something draws, and the old code only drew when a touch happened to
// arrive, which also made that touch a tap. Every screen the app can be showing must be in here.
// The once-a-minute clock repaint uses it too, so a tab, a settings page, the picker, the keyboard
// sheet and the chat selector all survive a wake with their own content.
//
// EST-381: it now ANSWERS whether it drew. The toast module needs that: a frame refused during a
// screen change must be asked for again, not lost (that refusal is one of the ways a Map pop-up
// could vanish while every drawing path looked correct).
static bool redrawCurrentScreen() {
  // EST-355: a screen change owns the light and the frame until it finishes (screenChangeLoop draws
  // the target itself). An in-page redraw in the middle of it would push a frame into a light that is
  // on its way down or up, so it is dropped here and the caller asks again after it.
  if (g_change.active()) return false;
  if (g_settings) {
    drawSettings();
    return true;
  }
  if (g_tab == 0) om::nodes_tab::draw();
  else if (g_tab == 1) drawChat();
  else if (g_tab == 2) om::map_tab::draw();
  else om::rptr_tab::draw();
  return true;
}

// EST-422: the delete arms' timeout is gone with the arms themselves; EST-399's DeleteArm has no
// caller in the shell any more (see docs/PROGRESS.md).

// EST-412: is a text field open right now? The same list the auto-off timer already had, now with
// one owner and with the screen it belongs to: Settings owns its editors, the Chat tab owns the
// composer sheet (channel, DM and reply all share g_kb) and the RPTR tab owns its sheet.
// EST-417: this no longer gates the CardKB (the arrows work on every screen, so the keys are read on
// every screen); it now says whether a key is typing and, on the Chat tab, whether the arrows scroll
// the chat behind the composer.
static bool textFieldOpen() {
  if (g_settings) return g_setEditor != om::ui::SettingsEditor::None;
  if (g_tab == 1) return g_kb.open;
  if (g_tab == 3) return om::rptr_tab::keyboardOpen();
  return false;
}

// EST-417: every pop-up, sheet, confirmation and dropdown on top of the current screen. It is the
// auto-off timer's own list (EST-405), moved into one name so the arrow keys and the timer cannot
// disagree about what counts as a sheet.
static bool popupOpen() {
  // The own-position picker and the RPTR map picker are full frames, but the user is in the middle of
  // choosing a point, so they are sheets here too, exactly as they are for the timer.
  return g_ask.open || g_setSelOpen || g_posChoice || g_ownPick || g_selector || g_advertMenu ||
         g_bubMenuSeq != 0 || om::nodes_tab::modalOpen() ||
         om::rptr_tab::modalOpen() || om::rptr_tab::mapPickerOpen();
}

// EST-405: everything the ticket says must keep the auto-off timer paused. Defined here, after every
// screen's own state it reads and just before its one caller.
static om::IdleBlockers idleBlockersNow() {
  om::IdleBlockers b;
  // The keyboard sheet covers every composer and editor: the chat composer, the message sheet's
  // REPLY/COPY/MENTION, the DM composer, every Settings text editor and the RPTR sheet.
  b.keyboard = textFieldOpen();
  // Pop-ups, confirmations, sheets and dropdowns: things that never finish themselves and that a tap
  // must not reach behind, so the timer waits (EST-417: one owner, popupOpen()).
  b.popup = popupOpen();
  b.ota = om::otaActive();
  // A drag is the finger down and moving; a stale canvas is a pan, zoom or recentre whose tiles are
  // still being decoded, which is the "zoom in progress" the ticket means.
  const bool mapVisible = g_tab == 2 && !g_settings;
  b.mapGesture = (mapVisible && (g_drag || om::mapViewStale())) ||
                 (g_ownPick && g_ownPickDragging) ||
                 (om::rptr_tab::mapPickerOpen() && om::rptr_tab::mapPickerDragging());
  // Rule 3's other half: the pop-up on the glass keeps the screen on for its 5 s. `visible()` is the
  // same test the drawing and the touch dismissal use.
  b.toast = om::ui::toastState().visible(millis());
  return b;
}

// EST-417: what a CardKB arrow means on the screen that is up now. One context wins, in the ticket's
// order: a text field (its composer may scroll the chat behind it), then a sheet or pop-up (the
// arrows do nothing), then the Map (plain arrows pan), then a list screen (plain arrows switch tabs
// and scroll). The table itself is keynav_logic.h's, so the host test proves every cell.
static om::keynav::Context keynavContext() {
  if (textFieldOpen()) return om::keynav::Context::TextField;
  // The chat selector is the channel list the ticket says the arrows scroll, so it is a LIST here
  // even though it is a dropdown for the auto-off timer (popupOpen). Every other pop-up stays a
  // sheet, where the arrows do nothing at all.
  if (popupOpen() && !(g_selector && !g_settings)) return om::keynav::Context::Sheet;
  if (g_tab == 2 && !g_settings) return om::keynav::Context::Map;
  return om::keynav::Context::List;
}

// EST-417 rules 2 and 3: previous / next tab, and NO wrap at either end (Nodes and RPTR are stops).
// The row that is on the glass is the one stepped: inside Settings that is Settings' own five tabs
// (the same page change a tab tap makes, its history reset included); everywhere else it is the four
// main tabs through showTab(), so leaving Settings' gear pages cannot be forgotten here.
static void keynavTabStep(int delta) {
  if (g_settings) {
    const int t = om::keynav::tabStep((int)g_setTab, delta, om::ui::kSettingsTabCount);
    if (t < 0) return;
    g_setTab = (om::ui::SettingsTab)t;
    g_setPage = setRootForTab(g_setTab);
    g_setScroll = 0;
    g_setNav.reset();
    g_ask.close();
    g_posChoice = false;
    drawSettings();
    return;
  }
  const int t = om::keynav::tabStep(g_tab, delta, om::ui::kTabCount);
  if (t < 0) return;
  showTab(t);
}

// EST-417 rules 2 and 5: one row of scroll in whatever list owns the screen, through the SAME clamp
// a finger's release applies. `dir` is +1 for the row below (towards the end), -1 for the row above.
// A key has no fingertip, so there is no give: the ends stop dead, where a drag would stretch 10 px.
static void keynavScroll(om::keynav::Context ctx, int dir) {
  if (ctx == om::keynav::Context::TextField) {
    // Only the Chat composer has a chat behind it; a Settings editor and the RPTR sheet do not
    // scroll anything from the arrows (item 5).
    if (g_settings || g_tab != 1) return;
    const int next = om::keynav::keyScroll(g_chatScroll, -dir, om::ui::kRowH, g_chatMaxScroll);
    if (next == g_chatScroll) return;
    g_chatScroll = next;
    drawChat();
    return;
  }
  if (g_settings) {
    const int next = om::keynav::keyScroll(g_setScroll, dir, om::ui::kRowH, g_setMaxScroll);
    if (next == g_setScroll) return;
    g_setScroll = next;
    drawSettings();
    return;
  }
  if (g_tab == 0) {
    om::nodes_tab::scrollByRow(dir);   // the list and the Info page, each with its own rows
    return;
  }
  if (g_tab == 1) {
    if (g_selector) {
      // The channel list is top-down, like the Nodes list: down shows later chats.
      const int next = om::keynav::keyScroll(g_selScroll, dir, om::ui::kSelRowH, g_selMaxScroll);
      if (next == g_selScroll) return;
      g_selScroll = next;
      drawChat();
      return;
    }
    // The message band is bottom-anchored (its scroll grows into history), so "down" (towards the
    // newest message) is the opposite sign, exactly as the drag path passes -dy there.
    const int next = om::keynav::keyScroll(g_chatScroll, -dir, om::ui::kRowH, g_chatMaxScroll);
    if (next == g_chatScroll) return;
    g_chatScroll = next;
    drawChat();
    return;
  }
  if (g_tab == 3) {
    om::rptr_tab::scrollByRow(dir);    // the list's 36 px rows or a page's 30 px ones
    return;
  }
}

// EST-417: one arrow press. The action comes from keynav_logic.h's table (arrow + context); this is
// only the wiring to the functions a tap, a drag or a tab tap already uses.
static void cardKbArrow(om::cardkb::Arrow a) {
  const om::keynav::Context ctx = keynavContext();
  switch (om::keynav::actFor(a, ctx)) {
    case om::keynav::Act::TabPrev:    keynavTabStep(-1); break;
    case om::keynav::Act::TabNext:    keynavTabStep(1); break;
    case om::keynav::Act::ScrollUp:   keynavScroll(ctx, -1); break;
    case om::keynav::Act::ScrollDown: keynavScroll(ctx, 1); break;
    // The Map: one fixed step through the drag's own path, so traces and markers follow.
    case om::keynav::Act::PanLeft:   om::map_tab::panStep(-om::ui::kMapKeyPanX, 0); break;
    case om::keynav::Act::PanRight:  om::map_tab::panStep(om::ui::kMapKeyPanX, 0); break;
    case om::keynav::Act::PanUp:     om::map_tab::panStep(0, -om::ui::kMapKeyPanY); break;
    case om::keynav::Act::PanDown:   om::map_tab::panStep(0, om::ui::kMapKeyPanY); break;
    // Fn+Up / Fn+Down zoom: keynav_logic.h's kFnZoomOnMap is the whole mapping, so dropping it is one
    // constant and these two lines never run.
    case om::keynav::Act::ZoomIn:    om::map_tab::zoomStep(1); break;
    case om::keynav::Act::ZoomOut:   om::map_tab::zoomStep(-1); break;
    case om::keynav::Act::None:
    default:                         break;   // nothing on this screen: no redraw, no log line
  }
}

// EST-412: one CardKB key, applied through the SAME functions the on-screen keys use. The mapping is
// cardkb_logic.h's; this is only the routing. `hasCursor` is false: today's editors insert at the
// end of the draft and draw the caret there, so left/right (for a future editor cursor) stay unused.
// EST-417: an arrow is decided FIRST, by arrowFor() and keynav_logic.h, so no arrow byte ever reaches
// mapCode. A key on a sleeping screen wakes it like a touch and is not applied (the touch rule),
// arrows included; an unrecognised code is counted and logged, never inserted.
static void cardKbKey(uint8_t code) {
  const om::cardkb::Arrow arrow = om::cardkb::arrowFor(code);
  const om::cardkb::Key k =
      arrow == om::cardkb::Arrow::None ? om::cardkb::mapCode(code, false) : om::cardkb::Key{};
  if (arrow == om::cardkb::Arrow::None && k.action == om::cardkb::Action::None) return;
  if (!g_screenOn) {
    screenWake("keyboard");
    return;
  }
  g_idle.onActivity(millis());   // a real key press is the user being there
  if (arrow != om::cardkb::Arrow::None) {
    cardKbArrow(arrow);
    return;
  }
  // The ticket allows the touch-feedback click here but does not require it. It is left to the
  // TAP path only (EST-390's one-call-site rule), so the keyboard is silent like a USB-injected
  // gesture while the on-screen keys keep their tick.
  if (k.action == om::cardkb::Action::Ignored) {
    ++g_kbIgnored;
    Serial.printf("[kb] ignored code 0x%02X (%lu)\n", (unsigned)code, (unsigned long)g_kbIgnored);
    return;
  }
  if (g_tab == 1 && !g_settings && g_kb.open) {
    switch (k.action) {
      case om::cardkb::Action::Char: {
        char one[2] = {k.ch, 0};
        om::ui::composeAppend(g_kbText, (int)sizeof(g_kbText), one, chatDraftAllowance());
        break;
      }
      case om::cardkb::Action::Backspace:
        om::ui::composeBackspace(g_kbText);   // one whole code point, as the sheet's Del key does
        break;
      case om::cardkb::Action::Enter:
        chatSendDraft();                      // the one Send door, channel/DM/reply alike
        break;
      case om::cardkb::Action::Esc:
        g_kb.close();                         // the on-screen Back above the sheet
        break;
      default:
        break;
    }
    drawChat();
    return;
  }
  if (g_settings && g_setEditor != om::ui::SettingsEditor::None) {
    switch (k.action) {
      case om::cardkb::Action::Char:
        settingsEditAppendChar(k.ch);         // the field's own filter and byte budget
        break;
      case om::cardkb::Action::Backspace:
        om::ui::composeBackspace(settingsEditBuf());
        break;
      case om::cardkb::Action::Enter:
        settingsEditorOk();                   // the sheet's OK / Join / Connect
        return;                               // it drew its own frame
      case om::cardkb::Action::Esc:
        settingsBack();                       // the page's own Back
        return;
      default:
        break;
    }
    drawSettings();
    return;
  }
  if (g_tab == 3 && !g_settings && om::rptr_tab::keyboardOpen()) {
    switch (k.action) {
      case om::cardkb::Action::Char:      om::rptr_tab::keyboardText(k.ch); break;
      case om::cardkb::Action::Backspace: om::rptr_tab::keyboardBackspace(); break;
      case om::cardkb::Action::Enter:     om::rptr_tab::keyboardConfirm(); break;
      case om::cardkb::Action::Esc:       om::rptr_tab::keyboardClose(); break;
      default:                            break;
    }
  }
}

// The one poll, from the loop task only, and only through the gate: switch on and keyboard found, on
// ANY screen (EST-417: the arrows work everywhere, so the keys are read everywhere; the text field
// now only decides what a key does). cardkb::poll() meters itself to ~30 ms and returns one new
// press at a time.
static void cardKbStep(uint32_t nowMs) {
  // EST-421: the start window. This is the ONLY place it advances: one call per loop pass, metered
  // inside to one probe per ~100 ms and closed at 3000 ms. No delay(), so the UI runs between
  // probes; found() is false until the keyboard answers, so nothing polls it early. Off = no window.
  om::cardkb::step(nowMs);
  // EST-417 rule 8: the keyboard was pulled out. The driver has already logged once, closed the bus
  // and dropped Grove power; all that is left is the short toast. Checked before the gate, because
  // found() is false by now. The switch stays ON: off and on again probes.
  if (om::cardkb::takeLostNotice()) showToast("Keyboard disconnected");
  // EST-421: the window ran out with no answer. The driver has already dropped the rail; this is the
  // ticket's toast. Switching the keyboard off and on again opens a fresh window.
  if (om::cardkb::takeNotFoundNotice()) showToast("CardKB not found (switch off/on to retry)");
  if (!om::cardkb::shouldPoll(g_kbEnabled, om::cardkb::found())) return;
  const int code = om::cardkb::poll(nowMs);
  if (code > 0) cardKbKey((uint8_t)code);
}

void loop() {
  // EST-365: one pass timer, and one bucket per block the ticket names. The parts are measured
  // around the calls below; endPass() charges the remainder to Other, so a long pass always names
  // the block that took it (radio prints loop_worst=... by=...).
  const uint32_t passStartUs = micros();
  om::radio::beginPass(passStartUs);
  const uint16_t passPush0 = om::omFramePushCount();
  // EST-384: catch a phone set-location that slipped past the BLE frame hook BEFORE this pass's GPS
  // write, so a GPS fix can never overwrite the point the phone just sent. The source itself decides;
  // this only reports an outside write.
  om::posPollNode();
  // EST-349: the ONE history flush point, on the loop task and outside every other path. A send, a
  // MeshCore callback or a USB command only enqueues a record; the card is touched here and nowhere
  // else. One (two under pressure) record per pass: a card write never sits in the packet path.
  {
    const uint32_t t = micros();
    om::history::loop();
    om::radio::addPart(om::radio::Part::History, micros() - t);
  }
  // EST-380: the history store kept a record it could not write. Say so ONCE per failure episode
  // (the store clears its notice when it is taken here, so a repaint or the next pass cannot repeat
  // it); the queue overflow is the one case where messages are really gone, and then the text says
  // how many. Same toast door as every other one-line notice.
  {
    uint32_t dropped = 0;
    const om::history::WriteNotice hn = om::history::takeWriteNotice(&dropped);
    if (hn != om::history::WriteNotice::None) {
      char text[64];
      if (hn == om::history::WriteNotice::CardErrorDropped) {
        snprintf(text, sizeof(text), "History not saved: card error, %lu dropped",
                 (unsigned long)dropped);
      } else if (hn == om::history::WriteNotice::QueueFull) {
        snprintf(text, sizeof(text), "History not saved: queue full, %lu dropped",
                 (unsigned long)dropped);
      } else {
        snprintf(text, sizeof(text), "History not saved: card error");
      }
      Serial.printf("[hist] notice: %s\n", text);
      showToast(text);
    }
  }
  // EST-354: Wi-Fi is polled, never waited on: the driver's scan and the supplicant's connect are
  // serviced here, and the model's timeouts are checked on the same pass. The status bar, a packet
  // and the history flush keep their own cadence.
  {
    const uint32_t t = micros();
    om::wifiLoop();
    om::radio::addPart(om::radio::Part::Wifi, micros() - t);
  }
  // EST-356: the Bluetooth switch and its transport. The transport's receive pump runs inside
  // MyMesh::loop() (it is MyMesh's serial interface); this only applies the switch, the PIN and the
  // connected/disconnected state, and prints the heap when both radios are up.
  {
    const uint32_t t = micros();
    om::bleLoop();
    om::radio::addPart(om::radio::Part::Ble, micros() - t);
  }
  static uint32_t lastBeat = 0;
  om::toasts::setScreenOn(g_screenOn);   // EST-366/371: the notification door checks the panel once
  static uint32_t lastTap = 0;
  // Gesture state (g_down / g_drag / g_acted, file scope since EST-405) lives outside the touch
  // section because switching the screen off must be able to drop a gesture in flight.
  static int g_sx = 0, g_sy = 0, g_scroll0 = 0, g_setScroll0 = 0, g_lastX = 0, g_lastY = 0;
  static int g_upX = 0, g_upY = 0;
  static uint32_t g_lastRender = 0, g_upMs = 0, g_downMs = 0;
  (void)g_setScroll0;

  bool pressed = false;
  // A physical press or, when the `key wake` test command is running, the same two edges injected
  // into this one handler. Everything below is the code the glass button drives.
  bool havePress = om::wakePressed(pressed);
  bool injectedEdge = false;
  if (om::usbWakeSample(millis(), &injectedEdge)) {
    pressed = injectedEdge;
    havePress = true;
  }
  if (havePress) {
    if (pressed && !g_wakePrev) {
      // The same two transitions the auto-off timer calls (EST-405), so there is one way to sleep
      // and one way to wake. The button's own labels are "button".
      if (g_screenOn) {
        screenSleep("button", false);
      } else {
        screenWake("button");
      }
    }
    g_wakePrev = pressed;
  }

  // EST-405: a screen the AUTO-OFF TIMER put to sleep wakes on a touch too, and that touch only
  // wakes: screenWake() arms the same TouchGate with "finger down at wake", so the press is
  // swallowed until it lifts and nothing under it is pressed. The glass is polled at
  // kIdleTouchPollMs rather than every pass to keep the I2C read off the hot path. A screen the
  // wake button slept is deliberately NOT woken by a touch (rule 4: with the feature off, nothing
  // changes from today); g_sleepByTimer is the one difference.
  if (!g_screenOn && g_sleepByTimer) {
    static uint32_t lastIdleTouchPoll = 0;
    uint16_t wx = 0, wy = 0;
    if (millis() - lastIdleTouchPoll >= om::kIdleTouchPollMs) {
      lastIdleTouchPoll = millis();
      if (om::omTouch(wx, wy)) screenWake("touch");
    }
  }

  // The non-blocking backlight ramp: at most one level (one I2C write) per loop pass. When the fade
  // out has reached 0, the panel is put to sleep; the reverse case above already cleared the flag.
  const int fadeLevel = g_fade.tick(millis());
  if (fadeLevel >= 0) {
    om::boardSetBrightness((uint8_t)fadeLevel);
    if (!g_fade.active()) {
      Serial.printf("[wake] fade done at %d (%d steps)\n", g_fade.level(), g_fade.steps());
    }
  }
  if (g_sleepPending && !g_fade.active()) {
    g_sleepPending = false;
    om::panelDisplay(false);
    om::panelPower(false);
    Serial.println("[wake] panel asleep");
  }

  // EST-355: the screen change, advanced here so the mesh, the radio and the GPS keep running between
  // its steps. It writes the light itself (out, settle, in) and does the one push.
  screenChangeLoop();
  // Everything below draws an ordinary, in-page frame; while a change is running the light and the
  // frame belong to it (redrawCurrentScreen has the same rule for the toast and the clock paths).
  const bool uiDrawOk = g_screenOn && !g_change.active();

  // EST-402: the charging bolt's one source. Every kChargePollMs (2 s) ONE read of STATUS0 (0x40),
  // no write, decoded to VBUSOK and fed to the two-read debounce. A failed read is Unavailable
  // (unknown), never "no cable". The flag only changes the bar, so a state change asks for one
  // repaint; with the controller not ready at boot nothing is read and nothing can raise a bolt.
  {
    static uint32_t lastVbusPoll = 0;
    if (g_chargeBolt.controllerReady() && millis() - lastVbusPoll >= om::kChargePollMs) {
      lastVbusPoll = millis();
      bool present = false;
      const bool answered = om::usbPdVbusPresent(&present);
      const om::VbusRead read =
          !answered ? om::VbusRead::Unavailable
                    : (present ? om::VbusRead::Present : om::VbusRead::Absent);
      if (g_chargeBolt.sample(read) && uiDrawOk) redrawCurrentScreen();
    }
  }

  // EST-367: the chat open's own step. The tap only marked the chat; the newest page of that chat's
  // log is read HERE, on the loop task, so a slow card never sits inside the gesture. The numbers are
  // logged (and kept for the `chats` check) and the screen is redrawn with them.
  if (g_viewLoading) {
    const uint32_t t = micros();
    chatViewStep();
    om::radio::addPart(om::radio::Part::History, micros() - t);
    if (uiDrawOk && g_tab == 1 && !g_settings && !g_kb.open) drawChat();
  }

  static uint32_t lastBatt = 0;
  static bool lowBattWarned = false;   // EST-359: one low-battery sound per crossing, re-armed above 20%
  if (millis() - lastBatt > 10000) {
    lastBatt = millis();
    const uint16_t mv = om::batteryMilliVolts();
    if (mv != g_battMv) {
      g_battMv = mv;
      if (g_tab == 0 && !g_settings && uiDrawOk) om::nodes_tab::draw();
      Serial.printf("[batt] %u mV\n", g_battMv);
    }
    const int pct = batteryPercent(g_battMv);
    if (!lowBattWarned && pct >= 0 && pct <= 15) {
      lowBattWarned = true;
      om::sounds::playEvent(SoundEvent::LowBattery);   // DND lets this one through (with error)
      char battText[om::ui::kNoticeCap];
      om::ui::noticeBatteryText(battText, sizeof(battText), pct);
      om::toasts::notify(om::ui::NoticeKind::LowBattery, battText, false, om::sounds::dnd());
      Serial.printf("[batt] low (%d%%), low-battery sound\n", pct);
    } else if (lowBattWarned && pct > 20) {
      lowBattWarned = false;
    }
  }

  // EST-359: the error sound follows a NEW radio fault (radio, mesh or a failed TX). A tap on the
  // mark only repeats the toast; it must not repeat the sound, so this watches the reason itself.
  {
    static om::RadioFault seenFault = om::RadioFault::None;
    const om::RadioFault fault = om::radioFaultState().reason();
    if (fault != seenFault) {
      seenFault = fault;
      if (fault != om::RadioFault::None) {
        om::sounds::playEvent(SoundEvent::Error);
        om::toasts::notify(om::ui::NoticeKind::Error, om::radioFaultText(fault), false, om::sounds::dnd());
        Serial.printf("[radio] fault sound: %s\n", om::radioFaultToken(fault));
      }
    }
  }

  const uint32_t gpsStartUs = micros();
  om::gpsPoll(g_gps);
  om::targetSetGpsFix(g_gps.lat, g_gps.lon, g_gps.valid);   // MeshCore adverts/telemetry
  // Feed the GPS time to the one clock. RMC repeats every second; timekeeper refreshes the source's
  // 6-hour hold each time but only writes/NVS-saves when the clock is off by more than a second.
  // EST-383: a time accepted without a fix is the LOWER source `gps-nofix`, so a fix, Wi-Fi, phone or
  // manual time replaces it at once. The source is compared too, so a fix arriving on the same
  // second as the no-fix time still upgrades it.
  {
    static uint32_t lastGpsTime = 0;
    static bool lastGpsTimeFix = false;
    if (g_gps.timeEpoch != 0 &&
        (g_gps.timeEpoch != lastGpsTime || g_gps.timeEpochFix != lastGpsTimeFix)) {
      lastGpsTime = g_gps.timeEpoch;
      lastGpsTimeFix = g_gps.timeEpochFix;
      const om::TimeSource gpsSource =
          g_gps.timeEpochFix ? om::TimeSource::Gps : om::TimeSource::GpsNoFix;
      const bool applied =
          om::timeKeeper().setFromSource(g_gps.timeEpoch, gpsSource, millis() / 1000);
      if (applied) {
        saveTimeFloor();
        Serial.printf("[time] %s -> %lu s, floor %lu s (%s)\n", om::timeSourceName(gpsSource),
                      (unsigned long)g_gps.timeEpoch, (unsigned long)om::timeKeeper().floor(),
                      om::timeSourceName(om::timeKeeper().source()));
      }
    }
  }
  om::radio::addPart(om::radio::Part::Gps, micros() - gpsStartUs);
  // EST-371: the toast module's once-per-pass work: expiry, and the one queued notice taking the
  // screen when the current toast is gone.
  om::toasts::pump(g_screenOn);
  // The floor is a one-way lower bound; persistence every 10 minutes is enough once a sync has set it.
  if (om::timeKeeper().saveDue(millis() / 1000)) saveTimeFloor();
  static bool gpsRetried = false;
  if (!gpsRetried && millis() > 10000 && g_gps.bytes == 0) {
    gpsRetried = true;
    om::gpsBegin(true);
  }
  static uint32_t lastGps = 0;
  static uint8_t lastSats = 255;
  static uint8_t lastHeard = 255;
  static bool lastValid = false;
  if (millis() - lastGps > 1000) {
    lastGps = millis();
    if (g_gps.sats != lastSats || g_gps.valid != lastValid || g_gps.heardTotal != lastHeard) {
      lastSats = g_gps.sats;
      lastValid = g_gps.valid;
      lastHeard = g_gps.heardTotal;
      if (g_tab == 0 && !g_settings && uiDrawOk) om::nodes_tab::draw();
      Serial.printf("[gps] %s used=%u expected=%u heard=%u best=%u maxheard=%u\n",
                    g_gps.valid ? "fix" : "no-fix", g_gps.sats, g_gps.expectedTotal,
                    g_gps.heardTotal, g_gps.bestSnr, g_gps.maxHeard);
    }
  }

  // Nodes refreshes on its own: a new advert, a changed name, or unread traffic. One second is
  // cheap (a frame push) and means the list is never stale, without redrawing on every loop.
  static uint32_t lastNodeCheck = 0;
  static int lastUnreadSeen = -1;
  if (g_tab == 0 && !g_settings && uiDrawOk && millis() - lastNodeCheck > 1000) {
    lastNodeCheck = millis();
    const uint32_t sig = om::meshContactSignature();
    const int unread = unreadTotal();
    if (sig != om::nodes_tab::seenSignature() || unread != lastUnreadSeen) {
      lastUnreadSeen = unread;
      om::nodes_tab::draw();
    }
  }

  if (millis() - lastBeat > 2000) {
    lastBeat = millis();
    // EST-350: `stack` is the loop task's least free stack in bytes since boot (FreeRTOS high-water
    // mark). The USB command path was the deepest one; this number is how the fix is checked.
    Serial.printf("[hb] uptime=%lus heap=%u stack=%u board=%s mesh=%s tab=%d settings=%d vol=%u snd=%d dnd=%d wifi=%s\n",
                  (unsigned long)(millis() / 1000), (unsigned)ESP.getFreeHeap(),
                  (unsigned)uxTaskGetStackHighWaterMark(nullptr),
                  g_boardOk ? "ok" : "FAIL",
#if defined(OM_ENABLE_MESH)
                  om::meshLinkReady() ? "up" : "off",
#else
                  "n/a",
#endif
                  g_tab, g_settings, om::sounds::volume(), om::sounds::masterOn(), om::sounds::dnd(),
                  om::wifi::phaseToken(om::wifiStatus().phase));
    // GPS diagnostics on the same beat: a module that talks and a module that hears nothing look
    // identical in GGA's "0 used", so bytes, sentences, the checksum failures and the GSV counts are
    // the evidence. expected=g/l/b/a is what the almanac lists per constellation, heard=g/l/b/a is
    // what the module actually received (a C/N0 above zero; GN's own count when it only speaks
    // GNGSV). best is the best C/N0 of the last 60 s in dB-Hz, maxheard the most heard at once since
    // boot, both kept even when nothing is plugged in during the test.
    // EST-397: over= is the NMEA buffer overflow count (#13), so a truncated line can be told from a
    // bad checksum.
    Serial.printf("[hb] gps bytes=%lu nmea=%lu bad=%lu over=%lu expected=%u(g%u l%u b%u a%u) "
                  "heard=%u(g%u l%u b%u a%u) used=%u best=%u maxheard=%u fix=%d\n",
                  (unsigned long)g_gps.bytes, (unsigned long)g_gps.sentences,
                  (unsigned long)g_gps.checksumBad, (unsigned long)g_gps.lineOverflow,
                  g_gps.expectedTotal,
                  g_gps.expected[om::kGpsUs], g_gps.expected[om::kGpsGlonass],
                  g_gps.expected[om::kGpsBeiDou], g_gps.expected[om::kGpsGalileo],
                  g_gps.heardTotal, g_gps.heard[om::kGpsUs], g_gps.heard[om::kGpsGlonass],
                  g_gps.heard[om::kGpsBeiDou], g_gps.heard[om::kGpsGalileo],
                  g_gps.sats, g_gps.bestSnr, g_gps.maxHeard, g_gps.valid ? 1 : 0);
  }

  // Repaint once a minute so the status bar's HH:MM is live. Before a real source the text stays
  // "--:--", so a floor that merely advances never causes a redraw.
  {
    static char shownClock[8] = "";
    char clockText[8];
    if (om::timeKeeper().realSinceBoot()) {
      om::formatClock(om::timeKeeper().now(), clockText, sizeof(clockText));
    } else {
      snprintf(clockText, sizeof(clockText), "--:--");
    }
    if (strcmp(shownClock, clockText) != 0) {
      snprintf(shownClock, sizeof(shownClock), "%s", clockText);
      if (g_screenOn) redrawCurrentScreen();
    }
  }

  // Touch is a gesture: press, drag, release. A drag scrolls (picker rows, settings pixels) or
  // pans the map, and NEVER selects; only a release without a drag is a tap.
  {
    const uint32_t t = micros();
    om::otaPoll();   // first: the mesh loop can block for seconds and overrun the CDC FIFO
    // EST-350: a USB command that arrived in otaPoll() is EXECUTED here, on the loop task and outside
    // the reader's frame, just like the screen's own paths and history::loop() above. The frame
    // handler only copies it into one slot (ota.cpp), because the SD stack does not fit inside the
    // reader's call chain (see docs/PROGRESS.md: 1,136 B otaPoll + 304 B frame handler + the command's
    // own 1,632 B, on an 8,192 B loop-task stack).
    om::otaCommandPoll();
    // EST-405: one executed USB command restarts the auto-off count and opens the 30 s quiet window
    // (the ticket's "a USB command arrived in the last 30 s"). The OMSHOT screenshot is not one: it
    // reads the off-screen frame and never runs through the command slot.
    {
      static uint32_t seenCmdSerial = 0;
      const uint32_t cs = om::otaCommandSerial();
      if (cs != seenCmdSerial) {
        seenCmdSerial = cs;
        g_idle.onUsbCommand(millis());
      }
    }
    om::radio::addPart(om::radio::Part::Usb, micros() - t);
  }
  // EST-354: one redraw when the Wi-Fi state a screen draws has changed (the status icon, the
  // Settings page, a finished scan). Never while the password sheet is open: a background frame
  // must not move the keys under the finger.
  {
    static uint32_t seenWifi = 0;
    const uint32_t ws = om::wifiSerial();
    if (ws != seenWifi) {
      seenWifi = ws;
      if (g_screenOn && g_setEditor == om::ui::SettingsEditor::None) redrawCurrentScreen();
    }
  }
  // EST-356: the Bluetooth page and the status icon follow the switch and the phase (off /
  // advertising / connected, and a new PIN). One redraw per visible change.
  {
    static uint32_t seenBle = 0;
    const uint32_t bs = om::bleSerial();
    if (bs != seenBle) {
      seenBle = bs;
      if (g_screenOn && g_setEditor == om::ui::SettingsEditor::None) redrawCurrentScreen();
    }
  }
#if defined(OM_ENABLE_MESH)
  {
    const uint32_t t = micros();
    om::meshLinkLoop();
    om::radio::addPart(om::radio::Part::Mesh, micros() - t);
  }
  // EST-358: follow the repeater session's answers (a login result, a CLI reply, the status card)
  // and the discovery window. It only redraws the screens it owns, and only when they are up.
  {
    const uint32_t t = micros();
    om::rptr_tab::pump();
    om::radio::addPart(om::radio::Part::Rptr, micros() - t);
  }
  // EST-365: sample the chip's noise floor every few seconds. It is upstream's own value; the
  // radio_stats window keeps the min/avg over the last three minutes.
  {
    static uint32_t lastNoisePoll = 0;
    if (millis() - lastNoisePoll >= om::radio::kNoisePeriodMs) {
      lastNoisePoll = millis();
      om::radio::UpstreamCounters c;
      if (om::meshRadioStats(&c)) om::radio::noteNoise(c.noiseFloor, millis());
    }
  }
  // EST-376: the diagnostics' loop half. A queued `radio tcxo` / `radio boost` is applied HERE (the
  // warm sleep, calibrate and RX re-entry are radio work, so they never run on the USB command
  // stack: EST-350), and `radio sample` prints its one line every 5 s and the summary. With nothing
  // queued and no sample running this is two bool tests and one SPI register read per 5 s.
  om::rdiag::loop(millis());

  // EST-377: the battery log's ONLY writer, once a minute (EST-349: the loop owns the card). The
  // state is what the status bar and the screens already use; plog::loop() reads the radio counters
  // only when the minute is due, so this is a handful of atomics on every other pass.
  {
    const uint32_t t = micros();
    om::plog::State ps;
    ps.battMv = g_battMv;
    ps.screenOn = g_screenOn;
    const int backlight = g_change.active() ? g_change.level() : g_fade.level();
    ps.brightness = g_screenOn ? (uint8_t)backlight : 0;
    ps.gpsRailOn = om::gpsRailOn();
    ps.fix = g_gps.valid;
    ps.sats = g_gps.sats;
    ps.heard = g_gps.heardTotal;   // EST-418: the heartbeat's own `heard=` number
    ps.wifiOn = om::wifiIsEnabled();
    ps.bleOn = om::bleIsEnabled();
    ps.uptimeSec = millis() / 1000;
    om::plog::loop(millis(), ps);
    om::radio::addPart(om::radio::Part::History, micros() - t);
  }

  // EST-356: the phone changed a store through MyMesh (channels, radio, name). One toast says so and
  // the redraw rebuilds the screen from the same stores, so the change is visible at once.
  {
    static uint32_t seenPhone = 0;
    const uint32_t ps = om::meshPhoneChangeSerial();
    if (ps != seenPhone) {
      seenPhone = ps;
      uint8_t kind = 0;
      bool radioChanged = false;
      char text[48] = "";
      char last[48] = "";
      while (om::meshPhoneChangeTake(&kind)) {
        if (kind & om::ble::kChangeRadio) radioChanged = true;
        om::ble::phoneChangeText(kind, text, sizeof(text));
        if (text[0] != 0) snprintf(last, sizeof(last), "%s", text);
      }
      // The Settings page keeps a small cached copy of the radio values; re-read it so the phone's
      // new frequency/SF/CR/TX shows there. The cache is filled from NodePrefs, not a second store.
      if (radioChanged) {
        g_radio.load();
        g_custom = g_radio.prefs();
      }
      if (last[0] != 0) {
        Serial.printf("[ble] %s\n", last);
        if (g_screenOn) showToast(last);
      } else if (g_screenOn && g_setEditor == om::ui::SettingsEditor::None) {
        redrawCurrentScreen();
      }
    }
  }

  // --- EST-342: the asynchronous mesh events -----------------------------------------------------
  // 1) A contact was ADDED by an advert: one toast for om::ui::kToastMs, a dot on the Nodes tab, the "New node"
  //    per-event sound (DND and Off silence it). Known contacts never get here (mesh_link queues
  //    only is_new adverts).
  {
    static uint32_t seenNew = 0;
    const uint32_t serial = om::meshNewNodeSerial();
    if (serial != seenNew) {
      seenNew = serial;
      char name[32];
      uint8_t type = 0;
      char lastText[64] = "";
      while (om::meshNewNodeTake(name, sizeof(name), &type)) {
        om::ui::newNodeToastText(lastText, sizeof(lastText), name, type);
      }
      if (lastText[0] != 0) {
        const om::ui::NodeNotice notice =
            om::ui::newNodeNotice(true, om::sounds::masterOn(), om::sounds::dnd(), !om::sound::validSound(om::sounds::choice(SoundEvent::NewNode)));
        om::nodes_tab::noteNewNode();   // the dot, until the Nodes screen is next drawn
        if (notice.sound) om::sounds::playEvent(SoundEvent::NewNode);
        // EST-366 (rule 9): the same toast door as a message, so DND and a burst are handled once.
        // The dot still appears: it is information on the bar, not a pop-up.
        om::toasts::notify(om::ui::NoticeKind::NewNode, lastText, false, om::sounds::dnd());
        Serial.printf("[nodes] notice: %s\n", lastText);
      }
    }
  }
  // 2) A DM ARRIVED: the per-event DM sound and its toast ("DM <sender>: ..."). Our own sends do not
  //    bump this serial. The open-chat rule is the DM thread's, not the channel's.
  {
    static uint32_t seenDm = 0;
    const uint32_t serial = om::meshDmRecvSerial();
    if (serial != seenDm) {
      seenDm = serial;
      om::sounds::playEvent(SoundEvent::Dm);
      int thread = -1;
      char from[32] = "";
      char body[om::kMeshTextCap] = "";
      if (om::meshDmLatest(&thread, from, sizeof(from), body, sizeof(body))) {
        // EST-368: the whole message travels with the notice, so the pop-up can show it wrapped.
        om::ui::Notice n;
        om::ui::noticeDmNotice(&n, from, body);
        om::toasts::notifyNotice(om::ui::NoticeKind::Dm, n, chatOpenForThread(thread), om::sounds::dnd());
      }
    }
  }
  // 3) A CHANNEL message ARRIVED (EST-359). mesh_link bumps the sound serial only for a message that
  //    should be heard (not muted, not our own send); a mention has its own serial and wins when both
  //    changed in one pass, so one message never plays two sounds. EST-366 adds the toast from the
  //    same arrival: "<sender> in <chat>: <start>" (a mention is marked), suppressed only when that
  //    chat is the one already on screen.
  {
    static uint32_t seenMsg = 0;
    static uint32_t seenMention = 0;
    const uint32_t mention = om::meshMentionSerial();
    const uint32_t msg = om::meshMsgSoundSerial();
    bool isMention = false;
    bool gotOne = false;
    if (mention != seenMention) {
      seenMention = mention;
      seenMsg = msg;
      om::sounds::playEvent(SoundEvent::Mention);
      isMention = true;
      gotOne = true;
    } else if (msg != seenMsg) {
      seenMsg = msg;
      om::sounds::playEvent(SoundEvent::Message);
      gotOne = true;
    }
    if (gotOne) {
      const int last = om::meshMsgCount() - 1;
      if (last >= 0) {
        const int ch = om::meshMsgChannel(last);
        // EST-368: title (sender · chat) plus the whole text, so the pop-up shows the message.
        om::ui::Notice n;
        om::ui::noticeChannelNotice(&n, om::meshMsgName(last),
                                    (ch >= 0 && ch < om::mcChannelCount()) ? om::mcChannelName(ch) : "?",
                                    om::meshMsgText(last), isMention);
        om::toasts::notifyNotice(isMention ? om::ui::NoticeKind::Mention
                                          : om::ui::NoticeKind::Channel,
                                   n, chatOpenForChannel(ch), om::sounds::dnd());
      }
    }
  }
  // 3) A ping's status reply (or its timeout) arrives later: the toast carries the round trip.
  {
    static om::MeshPingState lastPing = om::MeshPingState::Idle;
    uint32_t rtt = 0;
    char name[32] = "";
    const om::MeshPingState st = om::meshPingState(&rtt, name, sizeof(name));
    if (st != lastPing) {
      lastPing = st;
      char text[64] = "";
      if (st == om::MeshPingState::Replied) {
        snprintf(text, sizeof(text), "Ping %s: %lu ms", name, (unsigned long)rtt);
      } else if (st == om::MeshPingState::Timeout) {
        snprintf(text, sizeof(text), "Ping %s: no reply", name);
      } else if (st == om::MeshPingState::Failed) {
        snprintf(text, sizeof(text), "Ping: send failed");
      }
      if (text[0] && g_screenOn) showToast(text);
      if (text[0]) Serial.printf("[nodes] %s\n", text);
    }
  }
  // 4) A trace's hops come back: the small SNR list over the Nodes screen.
  {
    static uint32_t seenTrace = 0;
    const uint32_t serial = om::meshTraceSerial();
    if (serial != seenTrace) {
      seenTrace = serial;
      om::MeshTrace trace{};
      if (om::meshTraceResult(&trace)) {
        // Copy into the UI's trace view (same fields, one place for the screen).
        om::ui::TraceView tv;
        tv.count = trace.count > om::ui::kMaxTraceHops ? om::ui::kMaxTraceHops : trace.count;
        for (int i = 0; i < tv.count; ++i) {
          snprintf(tv.hops[i].name, sizeof(tv.hops[i].name), "%s", trace.hops[i].name);
          tv.hops[i].snr4 = trace.hops[i].snr4;
          tv.hops[i].known = trace.hops[i].known;
        }
        tv.finalSnr4 = trace.finalSnr4;
        tv.rttMs = trace.rttMs;
        tv.haveRtt = trace.haveRtt;
        if (tv.haveRtt) {
          om::nodes_tab::setTrace(tv, trace.node);
          if (g_tab == 0 && !g_settings && uiDrawOk) om::nodes_tab::draw();
          else if (g_screenOn) showToast("Trace came back");
          Serial.printf("[nodes] trace: %d hop(s), %lu ms\n", tv.count, (unsigned long)tv.rttMs);
        } else if (g_screenOn) {
          showToast("Trace: no data back");
        }
      }
    }
  }
#endif

  // Live-update the Chat tab when new traffic arrives. Compared on the serial, not the count: the
  // count stops changing once the 32-message ring is full, so new traffic went unseen. A new message
  // only moves the view when the reader is already at the bottom (scroll 0); otherwise the content
  // grew by its own height, so the scroll grows by the same amount and the text being read holds
  // still. While the keyboard sheet is open the screen is left alone, so the draft cannot jump.
  // Both serials are watched: a channel message and a DM (which also changes its delivery state on
  // an ACK, EST-342).
  if (g_tab == 1 && !g_kb.open && !g_settings) {
    static uint32_t lastSeenMsg = 0xFFFFFFFFu;
    static uint32_t lastSeenDm = 0xFFFFFFFFu;
    const uint32_t msgSerial = om::meshMsgSerial();
    const uint32_t dmSerial = om::meshDmSerial();
    if (msgSerial != lastSeenMsg || dmSerial != lastSeenDm) {
      lastSeenMsg = msgSerial;
      lastSeenDm = dmSerial;
      // EST-367: no blanket clear here. drawChat() marks read exactly through the newest message the
      // view loaded and shows (markOpenChatRead), so a chat that showed nothing keeps its unread.
      // Deliberately do NOT close the message sheet here: it holds the message id, so buildChatView
      // resolves it to the same message after the ring shifts. It closes only when that message
      // has actually fallen out of the 32-message ring.
      om::ui::ChatView v;
      buildChatView(v);
      const int grown = om::ui::chatContentHeight(v) - g_chatTotal;
      if (g_chatScroll > 0 && grown > 0) g_chatScroll += grown;
      if (uiDrawOk) drawChat();   // EST-355: never into a light a change is taking down or up
    }
  }   // a host upload takes over the serial port and reboots when done

  // EST-368: the Map's trace pump. Idle when the Map is not on screen or nothing animates; while a
  // route runs it draws at most one frame per kTraceFrameMs, from the canvas map.cpp already has.
  om::map_tab::pump(g_tab == 2 && !g_settings, uiDrawOk);

  // EST-355: a screen change owns the touch too. Nothing is read while it runs (the frame it is
  // pushing is not the one the finger is looking at), and a finger that is already down when it ends
  // must lift first: the same TouchGate the wake path uses, with the change's own short window.
  // The change is fed "no finger" for its whole duration so that latch is never lost to a stale edge.
  // EST-422: x/y start from the LAST point the panel reported, because LovyanGFX writes no coordinate
  // on a pass where the panel reports no finger (LGFXBase.hpp getTouch returns before writing x/y). So
  // on the release pass these are the last real point, and the tap rule can compare it with the press.
  uint16_t x = (uint16_t)g_tap.lastX;
  uint16_t y = (uint16_t)g_tap.lastY;
  bool rawDown = false;
  uint16_t injectedX = 0, injectedY = 0;
  bool injectedDown = false;
  const bool changing = g_change.active();
  if (changing) {
    om::ui::pressClear();   // EST-390: a change owns the frame; no stale tint survives it
    g_touchGate.accept(millis(), false);   // fed "no finger": no edge is recorded for the gate
  } else if (om::usbTouchSample(millis(), &injectedX, &injectedY, &injectedDown)) {
    x = injectedX;
    y = injectedY;
    rawDown = g_screenOn && injectedDown;
  } else {
    rawDown = g_screenOn && om::omTouch(x, y);
  }
  const bool isDown = changing ? false : g_touchGate.accept(millis(), rawDown);
  // EST-405: a finger on the glass (held included) restarts the auto-off count. It is the physical
  // sample, not the gated tap, so a press the wake gate swallows still counts as the user being
  // there. The screen being off makes rawDown false, so a dark screen never feeds the timer.
  if (rawDown) g_idle.onActivity(millis());
  if (!isDown) {
    if (g_down) {
      g_down = false;
      // EST-390: the look goes away BEFORE the action draws, so the action's own frame is never
      // pressed. If the action drew nothing (a row that only logs), one repaint takes the tint off
      // the glass.
      const bool hadPress = om::ui::pressActive();
      om::ui::pressClear();
      const uint16_t pressPush0 = om::omFramePushCount();
      g_upX = g_sx;
      g_upY = g_sy;
      g_upMs = millis();
      // EST-366: the next map gesture starts a fresh pan base (the picker's own state, EST-410).
      om::rptr_tab::endPickerDrag();
      g_ownPickDragging = false;    // EST-384: same for the Settings own-position picker
      // A spent gesture was the press that closed an overlay: its release does nothing at all (no
      // tap, no rubber band, no redraw). Only the NEXT new press acts on what was behind (EST-339).
      const bool spent = g_spent;
      const bool accent = g_accentPreview;   // the hold's bubble: the release enters that letter
      const bool setAccent = g_setAccentPreview;   // the same hold on a Settings editor (EST-352)
      g_dismiss.onRelease();
      g_spent = false;
      om::nodes_tab::holdRelease();
      g_keyHoldArmed = false;
      g_keyHold.release();
      g_accentPreview = false;
      g_setAccentPreview = false;
      if (!spent) {
        // EST-346: the release of a s/c/z hold enters the accented letter; it is not a tap, so the
        // plain letter is never typed as well.
        if (accent) {
          chatAccentCommit();
          drawChat();
        } else if (setAccent) {
          settingsEditAppendAccent();   // the name field only; the filter refuses a base64 key
          drawSettings();
        } else if (g_tap.tapAllowed((int)x, (int)y, g_drag, g_acted)) {
          // EST-422: the ONE tap rule (ui/tap_rule.h). A gesture seen only once, or seen to end away
          // from where it began, is a flick and not a tap: nothing under the finger changes.
          handleTap(g_sx, g_sy, false);
        } else if (!g_drag && !g_acted) {
          Serial.printf("[tap] %d,%d ignored: %d sample(s), last %d,%d (flick, not a tap)\n",
                        (int)g_sx, (int)g_sy, g_tap.samples, g_tap.lastX, g_tap.lastY);
        }
        // EST-348/367: a pull PAST the oldest message the view holds asks the chat's own log for the
        // next older page. The clamp below then runs against the taller content; the scroll is
        // measured from the bottom, so the page's newest messages appear where the finger already is
        // (no jump).
        if (g_tab == 1 && !g_settings && !g_kb.open && !g_selector &&
            g_chatScroll > g_chatMaxScroll) {
          loadOlderChatPage();
          drawChat();
        }
        // A rubber band needs a spring: clamp the chat back into range when the finger lifts. The
        // selector list and the emoji grid have their own scroll and only move while they are open.
        if (g_tab == 1 && !g_settings) {
          bool redraw = false;
          if (g_kb.open && g_kb.emoji()) {
            const int clamped = g_emojiScroll < 0 ? 0
                              : (g_emojiScroll > g_emojiMaxScroll ? g_emojiMaxScroll
                                                                  : g_emojiScroll);
            if (clamped != g_emojiScroll) {
              g_emojiScroll = clamped;
              redraw = true;
            }
          } else if (!g_kb.open) {
            if (g_selector) {
              // EST-414: the one snap rule (ui/layout.h listSnapScroll) for the channel list.
              g_listGive = false;
              const int clamped = om::ui::listSnapScroll(g_selScroll, g_selMaxScroll);
              if (clamped != g_selScroll) {
                g_selScroll = clamped;
                redraw = true;
              }
            } else {
              // EST-414: and for the bottom-anchored message band.
              g_listGive = false;
              const int clamped = om::ui::listSnapScroll(g_chatScroll, g_chatMaxScroll);
              if (clamped != g_chatScroll) {
                g_chatScroll = clamped;
                redraw = true;
              }
              // Back at the newest message: nothing to reset. EST-367's view keeps what it loaded (the
              // newest page) so returning from a scroll never re-reads the card.
            }
          }
          if (redraw) drawChat();
        }
        // The Info page's scroll snaps its give back the same way, and its last drawn position is
        // always painted here too (the drag may not have drawn in the last 60 ms).
        // EST-411: the Nodes list and the Info page clamp their give in screens/nodes_tab.cpp,
        // with the same 60 ms frame clock the loop used.
        if (g_tab == 0 && !g_settings && g_screenOn) om::nodes_tab::releaseSnap(g_drag);
        // EST-394: the last 60 ms of a map drag may not have been drawn. One full draw here leaves
        // the final pan on the glass with the trace projected for THAT view, and a composited canvas
        // that matches it, so the replay's 30 fps frames can resume at once after the finger lifts.
        if (g_tab == 2 && !g_settings && g_screenOn && g_drag) om::map_tab::draw();
        // The repeater list and a page's rows snap their give back the same way. The map picker has
        // no scroll of its own: its pan is applied live, so the release does nothing there.
        // EST-410: the clamp and the redraw live in screens/rptr_tab.cpp.
        if (g_tab == 3 && !g_settings) om::rptr_tab::releaseSnap(g_drag);
        // The settings list's give is snapped back the same way; the last 60 ms of a fast drag may
        // not have been drawn, so the final position is always drawn here.
        if (g_settings && !g_ownPick) {
          const int clamped = om::ui::settingsSnapScroll(g_setScroll, g_setMaxScroll);
          const bool changed = clamped != g_setScroll;
          g_setScroll = clamped;
          // EST-350: the dropdown's own scroll snaps back the same way when it was the one dragged.
          const int selClamped =
              g_setSelScroll < 0 ? 0
                                 : (g_setSelScroll > g_setSelMaxScroll ? g_setSelMaxScroll
                                                                       : g_setSelScroll);
          const bool selChanged = selClamped != g_setSelScroll;
          g_setSelScroll = selClamped;
          if (g_drag || changed || selChanged) drawSettings();
        }
      }
      if (hadPress && om::omFramePushCount() == pressPush0) redrawCurrentScreen();
    }
  } else if (!g_down) {
    g_down = true;
    g_downMs = millis();
    g_sx = x;
    g_sy = y;
    g_tap.press((int)x, (int)y);   // EST-422: the gesture's own record, sample 1 of the tap rule
    g_chatScroll0 = g_chatScroll;
    g_selScroll0 = g_selScroll;
    g_emojiScroll0 = g_emojiScroll;
    g_setScroll0 = g_setScroll;
    g_setSelScroll0 = g_setSelScroll;
    om::nodes_tab::beginDrag();   // EST-411: the Nodes list/Info drag bases
    om::rptr_tab::beginDrag();   // EST-410: the RPTR list/page drag bases
    g_drag = false;
    g_listGive = false;   // EST-414: a new gesture starts inside the lists' bounds
    g_acted = false;
    om::nodes_tab::holdDisarm();
    g_keyHoldArmed = false;
    g_accentPreview = false;
    g_accentCp = 0;
    g_setAccentPreview = false;
    g_setAccentCp = 0;
    // EST-346: any touch while a toast is showing dismisses it and is CONSUMED, exactly like the press
    // that closes an overlay (EST-339): this press, its release and any drag of it do nothing else, and
    // only the NEXT new press acts. A toast that has already run out is not showing, so its touch is
    // free (the loop's expire() has cleared it by now).
    if (om::ui::toastDismissOnPress(om::ui::toastState(), millis())) {
      g_spent = true;
      g_drag = true;
      g_acted = true;
      redrawCurrentScreen();   // the frame without the toast
      Serial.printf("[tap] %d,%d dismissed the toast, gesture spent\n", (int)x, (int)y);
    }
    // EST-342 / EST-411: a press that begins on a Nodes ROW arms the long-press rule; the test
    // and the timing live in screens/nodes_tab.cpp.
    if (!g_spent) om::nodes_tab::holdPress((int)x, (int)y, millis());
    // EST-339, the one rule for every overlay on the Chat tab: a new press INSIDE the overlay on top
    // is an ordinary gesture; a press OUTSIDE it closes the overlay on this press and spends the whole
    // gesture (its drag and its release included), so nothing behind the overlay is pressed. Only the
    // next new press may act on what is behind. The overlay is found from the same rectangles the
    // drawing used (chatOverlayPress), and the message sheet's panel from chatSheetPanel.
    bool outsideOverlay = false;
    om::ui::ChatOverlay overlay = om::ui::ChatOverlay::None;
    if (g_tab == 1 && !g_settings) {
      const om::ui::ChatOverlayPress op = chatOverlayPressAt(x, y);
      outsideOverlay = (op.overlay != om::ui::ChatOverlay::None && !op.inside);
      overlay = op.overlay;
    }
    if (!g_spent) {
      g_spent = g_dismiss.onPress(outsideOverlay);
      if (g_spent) {
        const bool closed = closeChatOverlay(overlay);
        Serial.printf("[tap] %d,%d away from %s: %s, gesture spent\n", (int)x, (int)y,
                      chatOverlayName(overlay), closed ? "closed" : "nothing to close");
        if (closed) drawChat();
        g_drag = true;    // no drag scroll and no tap on the release
        g_acted = true;
      }
    }
    // EST-342: a press outside the Nodes long-press sheet closes it and spends its gesture, the same
    // rule the chat overlays follow, so nothing behind the sheet is scrolled or tapped.
    if (!g_spent && om::nodes_tab::closeSheetAwayFrom((int)x, (int)y)) {
      g_spent = true;
      g_drag = true;
      g_acted = true;
    }
    // EST-346: a press on s, c or z on the LETTERS page arms the accent hold (the same LongPress rule
    // the node menu uses). The letter is fixed at the press, so the shift state cannot change under a
    // finger; the bubble appears when the hold passes the threshold and the release enters it.
    if (!g_spent && g_tab == 1 && !g_settings && g_kb.open && !g_kb.emoji() &&
        !g_kb.nums() && !g_selector && g_bubMenuSeq == 0) {
      const om::ui::ChatLayout kg =
          om::ui::chatLayoutFor(om::ui::l2(), true, g_replySeq != 0, false, false);
      const om::ui::KeyHit key = om::ui::keyAt(kg, false, (int)x, (int)y);
      if (key.row >= 0) {
        om::ui::KeyDef defs[10];
        const int n = om::ui::keyRow(false, key.row, defs);
        if (key.col < n && defs[key.col].kind == om::ui::KeyKind::Char) {
          const uint32_t cp = om::ui::accentCodePoint(defs[key.col].label[0], g_kb.shift);
          if (cp != 0) {
            g_keyHold.press((int)x, (int)y, millis());
            g_keyHoldArmed = true;
            g_accentRow = key.row;
            g_accentCol = key.col;
            g_accentCp = cp;
            Serial.printf("[chat] accent armed: %c -> U+%04lX\n", defs[key.col].label[0],
                          (unsigned long)cp);
          }
        }
      }
    }
    // EST-352: the same hold on a Settings text editor's sheet. Only a field that accepts accents
    // offers it (a name does, a base64 key does not), and only on the letters page, where s/c/z are.
    if (!g_spent && g_settings && g_setEditor != om::ui::SettingsEditor::None && !g_setEditNums &&
        om::ui::keyboardAccents(settingsEditField())) {
      const om::ui::KeyboardField field = settingsEditField();
      const om::ui::ChatLayout kg =
          om::ui::chatLayoutFor(om::ui::l2(), true, false, false, false, field);
      const om::ui::KeyHit key = om::ui::keyAt(kg, false, (int)x, (int)y, field);
      if (key.row >= 0) {
        om::ui::KeyDef defs[10];
        const int n = om::ui::keyRow(false, key.row, defs, field);
        if (key.col < n && defs[key.col].kind == om::ui::KeyKind::Char) {
          const uint32_t cp = om::ui::accentCodePoint(defs[key.col].label[0], g_setEditShift);
          if (cp != 0) {
            g_keyHold.press((int)x, (int)y, millis());
            g_keyHoldArmed = true;
            g_setAccentRow = key.row;
            g_setAccentCol = key.col;
            g_setAccentCp = cp;
            Serial.printf("[set] accent armed: %c -> U+%04lX\n", defs[key.col].label[0],
                          (unsigned long)cp);
          }
        }
      }
    }
    // This panel lifts between samples during a drag, so a press that lands near the previous
    // release shortly after it is treated as the same gesture (pan), not a tap. EST-416: the press
    // itself must pan by NOTHING. It only becomes the new pan base, so a fast new swipe starts
    // where the finger landed and the following moves pan by their own delta. Before this, the
    // press panned against the PREVIOUS swipe's end point (up to 80 px), and the map jumped.
    const om::ui::MapPressPan panPress =
        om::ui::mapPressPan(g_tab == 2 && !g_settings, !g_spent, g_upMs != 0, g_upMs, g_upX,
                            g_upY, millis(), (int)x, (int)y);
    if (panPress.cont) g_drag = true;
    // EST-390: the press look. A spent gesture (a toast dismissed, an overlay closed by this
    // press) and a pan continuation get nothing: the consumed-press rule is unchanged.
    if (!g_spent && !g_drag) pressArmAt((int)x, (int)y);
    g_lastX = panPress.baseX;
    g_lastY = panPress.baseY;
  } else {
    // EST-422: every pass the finger is down on is a sample of the gesture, and the last one is what
    // the release edge is compared with. (The drag latch below keeps its own, vertical-only 12 px rule
    // for the lists; the tap rule also catches a sideways flick, which never set this.)
    g_tap.sample((int)x, (int)y);
    const int dy = g_sy - (int)y;
    if (dy > 12 || dy < -12) g_drag = true;
    // A hold fires while the finger is still down: the menu opens under the finger. A spent gesture
    // never gets here (its overlay was closed on the press). On the Nodes list the timing, the
    // 12 px cancel and the "no tap after a hold" rule are the tested LongPress (EST-342).
    // EST-346: on the keyboard the same rule holds a s/c/z key: past the threshold the bubble appears
    // (and the plain letter is NOT typed), and the release enters the accented letter.
    bool accentFired = false;
    if (!g_spent && !g_acted && g_keyHoldArmed) {
      if (g_drag) {
        g_keyHold.reset();
      } else if (g_keyHold.update((int)x, (int)y, millis())) {
        g_acted = true;         // the generic hold below must not type the plain letter
        accentFired = true;
        if (g_settings) {       // EST-352: the Settings editor's sheet
          g_setAccentPreview = true;
          om::ui::pressDropPreview();   // EST-390: one bubble here, the accent letter
          Serial.printf("[set] accent preview U+%04lX\n", (unsigned long)g_setAccentCp);
          drawSettings();
        } else {                // the chat composer's sheet
          g_accentPreview = true;
          om::ui::pressDropPreview();   // EST-390: one bubble here, the accent letter
          Serial.printf("[chat] accent preview U+%04lX\n", (unsigned long)g_accentCp);
          drawChat();           // the bubble, above the held key
        }
      }
    }
    if (!accentFired && !g_spent && !g_acted && om::nodes_tab::holdArmed()) {
      if (g_drag) {
        om::nodes_tab::holdReset();
      } else if (om::nodes_tab::holdUpdate((int)x, (int)y, millis())) {
        g_acted = true;
        handleTap(x, y, true);
      }
    } else if (!accentFired && !g_spent && !g_drag && !g_acted &&
               (millis() - g_downMs) >= 450) {
      g_acted = true;
      handleTap(x, y, true);
    }
    if (g_drag && !g_spent) {
      if (g_settings && g_posChoice) {
        // EST-392: the Position choice owns the gesture. There is nothing to scroll inside a
        // two-row panel, and the page must not slide under it either.
      } else if (g_settings && g_setSelOpen) {
        // EST-350: the dropdown's list follows the fingertip with the chat selector's own sign and
        // give (selDragScroll), and the release path below snaps the stretch back.
        const int next = om::ui::selDragScroll(g_setSelScroll0, dy, g_setSelMaxScroll);
        if (next != g_setSelScroll) {
          g_setSelScroll = next;
          if (millis() - g_lastRender > 60) {
            g_lastRender = millis();
            drawSettings();
          }
        }
      } else if (g_settings && g_ownPick) {
        // EST-384: dragging the own-position picker pans the offline map under the fixed centre
        // cross, with the same first-move base as the RPTR picker so the map never jumps.
        if (!g_ownPickDragging) {
          g_ownPickDragging = true;
          g_ownPickDragX = (int)x;
          g_ownPickDragY = (int)y;
        } else {
          om::mapPan(g_ownPickDragX - (int)x, g_ownPickDragY - (int)y);
          g_ownPickDragX = (int)x;
          g_ownPickDragY = (int)y;
          ownPickCentreToDraft();
        }
        g_drag = true;
        if (millis() - g_lastRender > 60) {
          g_lastRender = millis();
          drawSettings();
        }
        g_lastX = x;
        g_lastY = y;
      } else if (g_settings) {
        // Every settings page scrolls with the finger, through the one shared drag rule
        // (settings_layout.h: the chat list's sign and give), and snaps back on release.
        const int next = om::ui::settingsDragScroll(g_setScroll0, dy, g_setMaxScroll);
        if (next != g_setScroll) {
          g_setScroll = next;
          if (millis() - g_lastRender > 60) {
            g_lastRender = millis();
            drawSettings();
          }
        }
      } else if (g_tab == 1 && g_kb.open && g_kb.emoji()) {
        // The emoji grid follows the fingertip, with the same sign and give as the selector list.
        const int next = om::ui::selDragScroll(g_emojiScroll0, dy, g_emojiMaxScroll);
        if (next != g_emojiScroll) {
          g_emojiScroll = next;
          if (millis() - g_lastRender > 60) { g_lastRender = millis(); drawChat(); }
        }
      } else if (g_tab == 1 && g_selector) {
        // The dropdown's list follows the finger: the one shared give rule (ui/layout.h
        // listGiveScroll) keeps the sign and kSelGive of stretch, and the release path snaps the
        // stretch back. The message band underneath is not touched. g_listGive tells drawChat's
        // clamp that the stretch is the scroll (EST-414).
        g_listGive = true;
        const int next = om::ui::listGiveScroll(g_selScroll0, dy, g_selMaxScroll);
        if (next != g_selScroll) {
          g_selScroll = next;
          if (millis() - g_lastRender > 60) { g_lastRender = millis(); drawChat(); }
        }
      } else if (g_tab == 1 && !g_kb.open) {
        // The message band is bottom-anchored (scroll grows as the finger goes down into history),
        // so its delta enters the shared rule with the opposite sign; the give past either end and
        // the snap-back are the same ones every list uses (EST-414: no local kGive copy any more).
        // The base is the chat's own scroll: using g_scroll0 here meant every drag started from the
        // sound picker's position, which made the chat jump when a drag began away from 0.
        g_listGive = true;
        const int next = om::ui::listGiveScroll(g_chatScroll0, -dy, g_chatMaxScroll);
        g_chatScroll = next;
        if (millis() - g_lastRender > 60) { g_lastRender = millis(); drawChat(); }
      } else if (g_tab == 2) {
        // Pan the map; redraw at most every ~60 ms (tiles come from the cache). Dragging drops a
        // follow lock and closes the callout, exactly as the mock says.
        om::map_tab::clearSelection();
        om::map_tab::setLock(false);
        om::mapPan(g_lastX - (int)x, g_lastY - (int)y);
        g_lastX = x;
        g_lastY = y;
        if (millis() - g_lastRender > 60) {
          g_lastRender = millis();
          om::map_tab::draw();
        }
      } else if (g_tab == 3 && !om::rptr_tab::keyboardOpen()) {
        // EST-410: the picker's pan and the list/page drag live in screens/rptr_tab.cpp. The
        // 60 ms render clock is the shell's and is stamped there, exactly where the loop did.
        om::rptr_tab::dragMove(x, y, dy, g_drag, g_lastX, g_lastY, g_lastRender);
      } else if (g_tab == 0 && !g_settings) {
        // EST-411: the Info page's and the list's scroll (and the 60 ms render clock) live in
        // screens/nodes_tab.cpp; the sign and the give are the same tested rules.
        om::nodes_tab::dragMove(dy, g_lastRender);
      }
    }
    // EST-390: the look stays only while the finger is on the element. Sliding off clears it (one
    // repaint); the ACTION rule is untouched, so the release does exactly what it did before.
    if (om::ui::pressMove((int)x, (int)y)) redrawCurrentScreen();
  }

  // EST-412: the Grove keyboard, from this task only. The gate inside cardKbStep() is the ticket's:
  // switch on, the probe found 0x5F, and a text field is open on this screen right now. With the
  // switch off nothing here calls the bus at all.
  cardKbStep(millis());

  // EST-405: the auto-off timer's once-per-pass step, AFTER this pass's touch sample and USB poll so
  // both are already in. The timer only decides; screenSleep() is the wake button's own transition,
  // so an auto-off and a button sleep look and behave the same. `screenOn` false makes step() a no-op.
  if (g_idle.step(millis(), g_screenOn, idleBlockersNow())) {
    screenSleep("idle", true);
    // The message that is on the glass is NOT the reason to stay awake: a new message pop-up keeps
    // the screen on for its own 5 s only while the screen was already on. It never wakes an
    // auto-off screen; the wake button and the chime are the alerts (the ticket says so).
  }

  // EST-365: charge the frame (compose then SPI push) to the pass it happened in. A frame composes
  // inside the block that drew it, so the tile decode is taken out of Draw to keep the parts from
  // double-counting it; the push has its own measured number from board.cpp.
  if (om::omFramePushCount() != passPush0) {
    const uint32_t pushUs = om::omFrameLastPushUs();
    const uint32_t composeUs = om::omFrameLastComposeUs();   // draw + overlay, push excluded
    om::radio::addPart(om::radio::Part::FramePush, pushUs);
    const uint32_t mapUs = om::radio::passPartUs(om::radio::Part::MapDecode);
    const uint32_t drawUs = composeUs > mapUs ? composeUs - mapUs : 0;
    om::radio::addPart(om::radio::Part::Draw, drawUs);
  }
  // EST-390: the pressed look's worst case, once a minute, like the other timings.
  {
    uint32_t worstUs = 0, presses = 0;
    if (g_pressLatency.tick(millis(), &worstUs, &presses)) {
      Serial.printf("[press] latency worst=%lu ms over %lu presses in 60 s\n",
                    (unsigned long)(worstUs / 1000UL), (unsigned long)presses);
    }
  }
  // EST-399: the emoji Recent row's one NVS write goes out when the emoji page is gone (however it was
  // left) or after 30 s without a pick. EST-422: the delete arms' tick went away with the arms.
  emojiPersistStep(g_tab == 1 && !g_settings && g_kb.open && g_kb.emoji(), millis());
  om::radio::endPass(micros(), millis());
  // While the backlight ramps, tick at ~1 ms so the 8-bit PWM gets many real levels over the 300 ms
  // fade-in (150 ms out); otherwise keep the old 20 ms loop (mesh, touch, draw). EST-355: a screen
  // change's 40 ms out and 60 ms in need the same ~1 ms cadence.
  // EST-422: while a finger is DOWN the panel is sampled every ~2 ms. The 20 ms loop plus an 11 ms
  // frame push was a blind window long enough for a quick flick to begin and end in it: no sample ever
  // crossed the 12 px drag test, so the release tapped the press point. At ~2 ms the finger cannot
  // travel 12 px unseen (a hard flick is about 2 px/ms), so the flick is a drag before it lifts; and a
  // real tap of any human length is seen many times, which is what the one-sample rule needs.
  const uint32_t idleDelay = g_down ? 2 : 20;
  delay((g_fade.active() || g_change.active()) ? 1 : idleDelay);
}

// ------------------------------------------------------------------- app_shell (EST-371)
// The USB command module reads the shell's buffers through this small interface; it never writes
// them. Keeping the buffers here is the point: the screens and the commands see one copy.
namespace om {
namespace app {

int nodeCount() { return om::nodes_tab::count(); }
const ui::NodeItem& node(int i) { return om::nodes_tab::item(i); }
void refreshNodesNow() { om::nodes_tab::refresh(); }
int unreadTotal() { return ::unreadTotal(); }

void refreshChatsNow() { refreshChats(); }
int chatChannel(int chat) { return ::chatChannel(chat); }
int chatThread(int chat) { return ::chatThread(chat); }
int chatCount() { return g_chatCount; }
const ui::ChatEntry& chat(int i) { return g_chats[i]; }
int chatSel() { return g_chatSel; }
int viewCount() { return g_viewCount; }
const history::Msg& viewMsg(int i) { return g_viewMsgs[i]; }
bool viewLoading() { return g_viewLoading; }
int viewChat() { return g_viewChat; }

MeshDm* dmScratch() { return g_dmScratch; }

ChatShownInfo chatShown(int i) {
  ChatShownInfo out;
  if (i < 0 || i >= om::ui::kMaxChats) return out;
  out.key = g_chatShown[i].key;
  out.shown = g_chatShown[i].shown;
  out.openUs = g_chatShown[i].openUs;
  out.windows = g_chatShown[i].windows;
  out.newestLogId = g_chatShown[i].newestLogId;
  out.newestWall = g_chatShown[i].newestWall;
  out.newestUp = g_chatShown[i].newestUp;
  out.newestReal = g_chatShown[i].newestReal;
  return out;
}

}  // namespace app
}  // namespace om

